## kconfigs/Kconfig.hypervisor
```kconfig
config HYPERVISOR_TUNING
	bool "Enable kernel hypervisor tunings"
	default y if KDEVOPS_FIRST_RUN
	help
	  If you are going to be using a kernel-ci setup with virtualization
	  it means you will end up with many guests using the same software
	  and running the same binaries. And so a few kernel tuning options
	  can be enabled to help save memory pressure on your host.

	  Enabling this will enable you to select which recommended kernel
	  tunings to enable on your host if it is running Linux. To be clear,
	  these tunings are set on the localhost where kdevops is cloned.

if HYPERVISOR_TUNING

config HYPERVISOR_TUNING_KSM
	bool "Enable Kernel same page merging on the host"
	default y if VAGRANT
	help
	  Enabling KSM can save tons of memory, in some kernel-ci systems with
	  about 60 guests it has saved about 135 GiB of RAM. If you enable this
	  option what we will do is run the following on your host:

	  # echo 1 > /sys/kernel/mm/ksm/run

	  For more information about KSM read:

	  https://www.kernel.org/doc/html/latest/admin-guide/mm/ksm.html

config HYPERVISOR_TUNING_ZSWAP
	bool "Enable zswap on the host"
	default y if VAGRANT
	help
	  Zswap is a lightweight compressed cache for swap pages
	  Although in theory designed for swap, you can enable zswap and still
	  never touch disk, and only use the benefit of zswap for compressing
	  certain amount of memory. This holds true so long as zswap doesn’t
	  actually evict pages from memory to disk. We can verify this as
	  follows on a Linux host:

	  # cat /sys/kernel/debug/zswap/written_back_pages
	  0

	  In this case, 0 indicates that there is nothing from zswap touching
	  disk. If you enable this option what we will run is the following on
	  your host:

	  # echo 1 > /sys/module/zswap/parameters/enabled

	  For more information about zswap refer to:

	  https://www.kernel.org/doc/html/latest/vm/zswap.html

config HYPERVISOR_TUNING_ZSWAP_MAX_POOL_PERCENT
	int "Zswap max pool percentage"
	default 90
	depends on HYPERVISOR_TUNING_ZSWAP
	help
	  Zswap's default max pool percentage is set to 20%. This means zswap
	  will use up to 20% of compressed pool in-memory total, and once the
	  amount of compressed pool in-memory used by zswap passes this
	  threshold it will start evicting to memory disk. We want to avoid
	  evicting to disk as much as possible, and so we highly recommend
	  increasing this to 90%.

	  With the defaults you would see:

	  # cat /sys/module/zswap/parameters/max_pool_percent
	  # 20

	  Enabling zswap tuning, we'll modify this as follows for you:

	  # echo 90 > /sys/module/zswap/parameters/max_pool_percent

endif
```

## kconfigs/Kconfig.kdevops
```kconfig
config HAVE_DISTRO_SUSE
	bool
	default n

config HAVE_CUSTOM_DISTRO_HOST_PREFIX
	bool
	default n

config HAVE_DISTRO_PREFERS_CUSTOM_HOST_PREFIX
	bool
	default n

config HAVE_DISTRO_LACKS_SUPPORT_FOR_NVME
	bool
	default n

config HAVE_DISTRO_LACKS_SUPPORT_FOR_VIRTIO_DRIVE
	bool
	default n

config HAVE_DISTRO_REQUIRES_CUSTOM_SSH_KEXALGORITHMS
	bool
	default n

config CUSTOM_DISTRO_HOST_PREFIX
	string
	depends on HAVE_CUSTOM_DISTRO_HOST_PREFIX
	default VAGRANT_DEBIAN_BOX_SHORT if VAGRANT_DEBIAN
	default VAGRANT_OPENSUSE_BOX_SHORT if VAGRANT_OPENSUSE

config CUSTOM_SSH_KEXALGORITHMS
	string
	depends on HAVE_DISTRO_REQUIRES_CUSTOM_SSH_KEXALGORITHMS
	default VAGRANT_SUSE_CUSTOM_SSH_KEXALGORITHMS if VAGRANT_SUSE

config KDEVOPS_USE_DISTRO_HOSTS_PREFIX
	bool "Use a distribution release code name as prefix for hosts"
	default y if HAVE_DISTRO_PREFERS_CUSTOM_HOST_PREFIX
	default n if !HAVE_DISTRO_PREFERS_CUSTOM_HOST_PREFIX
	help
	  Enable this option to use a short distribution release name for the
	  target hosts. This is useful, if for example, you are using
	  kdevops to run different hosts with different configurations and
	  you want to distinguish each target with its specific release name.
	  The preferred distribution release name is set per distribution and
	  per release.

	  Say yes here if you want to distinguish the relase you are using,
	  and let the distribution selection pick the prefix for you
	  instead of using the generic "kdevops" as the prefix.

config KDEVOPS_HOSTS_PREFIX
	string "The hostname prefix to use for nodes"
	default "kdevops" if !KDEVOPS_USE_DISTRO_HOSTS_PREFIX
	default CUSTOM_DISTRO_HOST_PREFIX if KDEVOPS_USE_DISTRO_HOSTS_PREFIX
	  help
	  Each node used has an associated hostname. We use a prefix to
	  help distinguish projects / goals for a set of nodes. You can use
	  this to override the hostname prefix used.

config KDEVOPS_CUSTOM_SSH_KEXALGORITHMS
	string "The custom ssh config KexAlgorithms string to use"
	depends on HAVE_DISTRO_REQUIRES_CUSTOM_SSH_KEXALGORITHMS
	default CUSTOM_SSH_KEXALGORITHMS
	  help
	  Some distributions, such as older distributions, may require a custom
	  ssh configuration entry for the KexAlgorithms parameter.

config KDEVOPS_BASELINE_AND_DEV
	bool "Enable both a baseline and development system per target test"
	default n
	help
	  By default kdevops will only spawn a baseline target node (local
	  virtualization or cloud node) for your Linux kernel testing and
	  development. If you have spare resources though it is useful to
	  spawn two nodes per target test though, one to track the basline
	  and another for development purposes or to help you reproduce issues
	  should an issue be found on the baseline. You can enable the spare
	  node by enabling this option. This allows you to for example
	  to keep baseline testing moving forward as soon as an issue is found,
	  so you can use the spare dev node to try to reproduce the issue.

	  The spare dev nodes can also be useful to for example to enable
	  developers in an ecosystem to login to instances with the target
	  distribution / kernel release as well.

	  If enabled, the host baseline will be created as well as the
	  development host, the development hostname is the same as the baseline
	  host but with an added "-dev" postfix.

	  You are encouraged to leave this option disabled unles you really
	  know you have spare resources for the additional dev nodes and know
	  they are immediatey useful to you.

config HAVE_DISTRO_SUPPORTS_EXTRA_ADDON
	bool
	default n

config HAVE_DISTRO_PREFERS_EXTRA_ADDON
	bool
	default n

config HAVE_DISTRO_SUPPORTS_REGISTRATION
	bool
	default n

config HAVE_DISTRO_PREFERS_REGISTRATION
	bool
	default n

config HAVE_DISTRO_REG_METHOD_TWOLINE
	bool
	default n

choice
	prompt "Kdevops enterprise distro post-bringup work"
	default KDEVOPS_ENABLE_DISTRO_REGISTRATION if HAVE_DISTRO_PREFERS_REGISTRATION
	default KDEVOPS_ENABLE_DISTRO_EXTRA_ADDONS if HAVE_DISTRO_PREFERS_EXTRA_ADDON
	depends on HAVE_DISTRO_SUPPORTS_REGISTRATION || HAVE_DISTRO_SUPPORTS_EXTRA_ADDON

config KDEVOPS_ENABLE_DISTRO_REGISTRATION
	bool "Enable distribution registration"
	depends on HAVE_DISTRO_SUPPORTS_REGISTRATION
	help
	  Some distributions have a registration system which can be used to
	  update the system or must be used to make a distribution useful.
	  For those distributions this option can be enabled to complete the
	  registration. Registration is handled by the kdevops devconfig ansible
	  role.

config KDEVOPS_ENABLE_DISTRO_EXTRA_ADDONS
	bool "Enable distribution extra addons"
	depends on HAVE_DISTRO_SUPPORTS_EXTRA_ADDON
	help
	  Some distributions have private internal URLs for package repositories
	  as an alternative to registration. This is useful for R&D of some
	  Enterprise Linux distributions.

endchoice

if KDEVOPS_ENABLE_DISTRO_REGISTRATION

choice
	prompt "Kdevops distribution registration method"
	default KDEVOPS_DISTRO_REG_METHOD_TWOLINE

config KDEVOPS_DISTRO_REG_METHOD_TWOLINE
	bool "Twoline registration system"
	help
	  The kdevops devconfig ansible role is used for the "twoline"
	  distribution registration method. This method consists of depending
	  on two lines on a playbooks/secret.yml file which we will generate,
	  one line which enables the twoline registration method, and another
	  line which contains the registration code to be used.

endchoice

endif # KDEVOPS_ENABLE_DISTRO_REGISTRATION

if KDEVOPS_DISTRO_REG_METHOD_TWOLINE

menu "Distribution twoline method registration configuration"
source "kconfigs/Kconfig.reg_twoline"
endmenu

endif # KDEVOPS_DISTRO_REG_METHOD_TWOLINE

if KDEVOPS_ENABLE_DISTRO_EXTRA_ADDONS

config KDEVOPS_EXTRA_ADDON_SOURCE
	string
	depends on HAVE_DISTRO_SUSE
	default VAGRANT_SUSE_EXTRA_ADDON_SOURCE if VAGRANT

endif # KDEVOPS_ENABLE_DISTRO_EXTRA_ADDONS

menu "Ansible post-bring up provisioning configuration"
source "kconfigs/Kconfig.ansible_provisioning"
endmenu

menu "Kernel continous integration configuration"
source "kconfigs/Kconfig.kernel-ci"
endmenu
```
