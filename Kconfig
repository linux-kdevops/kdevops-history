## kconfigs/Kconfig.mirror
```kconfig
if !TERRAFORM

config ENABLE_LOCAL_LINUX_MIRROR
	bool "Enable kdevops to use your localhost as a git mirror for Linux"
	default $(shell, scripts/check_mirror.sh ENABLE_LOCAL_LINUX_MIRROR)
	help
	  When doing build on Linux one of the most timely consuming operations
	  is doing a git clone on Linux. This is whether you are doing a local
	  build on your system or on the guest, either way, a git clone
	  operation on a Linux tree takes forever. You can optimize the build
	  process by using a local mirror.

	  Enabling this option let's you either just pick a locally setup up
	  mirror or let's kdevops go ahead and set up the new mirror for you.

	  Enable this option if if you want to save time with building Linux.

if ENABLE_LOCAL_LINUX_MIRROR

config USE_LOCAL_LINUX_MIRROR
	bool "Use local linux mirror"
	default $(shell, scripts/check_mirror.sh USE_LOCAL_LINUX_MIRROR)
	help
	  If you have a local Linux mirror already set up, or want to use
	  the one which kdevops lets you set up, enable this option so that
	  build targets can use it.

config INSTALL_LOCAL_LINUX_MIRROR
	bool "Install local mirror setup"
	default $(shell, scripts/check_mirror.sh INSTALL_LOCAL_LINUX_MIRROR)
	help
	  If you enable this kdevops will git clone the main Linux repos needed
	  for Linux as bare git repositories and then install systemd units
	  to keep these properly updated. The repositories will be placed
	  into /mirror/ directory:

	  Kernel development trees:
	    /mirror/linux.git
	    /mirror/linux-stable.git
	    /mirror/linux-next.git
	    /mirror/kdevops-linus.git
	    /mirror/mcgrof-next.git
	    /mirror/mcgrof-linus.git

	  kdevops specific trees and kdevops git alternatives:
	    /mirror/kdevops.git
	    /mirror/kdevops/fstests.git

	  Tools:
	    /mirror/fstests.git
	    /mirror/blktests.git

	  Enabling this even if you already have the repositories does nothing
	  so it is safe to keep this enabled even after your first linux-mirror
	  setup. You can however safely also disable this option after your
	  first linux-mirror setup and just use USE_LOCAL_LINUX_MIRROR so to
	  make use of the mirror.

config MIRROR_GIT_WORKS
	bool
	default $(shell, ./scripts/test_git_firewall.sh)

choice
	prompt "kdevops mirror source"
	default MIRROR_KDEVOPS_HTTPS_GITHUB
	depends on INSTALL_LOCAL_LINUX_MIRROR

config MIRROR_KDEVOPS_HTTPS_GITHUB
	bool "HTTPS (github)"
	help
	  If you enable this option then Github HTTPS will be used as the
	  source of the mirror. The URL is:

	  https://github.com/linux-kdevops/kdevops.git

config MIRROR_KDEVOPS_HTTPS_GITLAB
	bool "HTTPS (GitLab)"
	help
	  If you enable this option then GitLab HTTPS will be used as the
	  source of the mirror. The URL is:

	  https://gitlab.com/linux-kdevops/kdevops.git

endchoice

config MIRROR_KDEVOPS_URL
	string
	default "https://github.com/linux-kdevops/kdevops.git" if MIRROR_KDEVOPS_HTTPS_GITHUB
	default "https://gitlab.com/linux-kdevops/kdevops.git" if MIRROR_KDEVOPS_HTTPS_GITLAB

choice
	prompt "Linux mirror protocol"
	default MIRROR_TORVALDS_GIT if MIRROR_GIT_WORKS
	default MIRROR_TORVALDS_HTTPS if !MIRROR_GIT_WORKS
	depends on INSTALL_LOCAL_LINUX_MIRROR

config MIRROR_TORVALDS_HTTPS
	bool "HTTPS"
	help
	  If you enable this option then HTTPS will be used as the source
	  of the mirror. The URL is:

	  https://git.kernel.org/pub/scm/linux/kernel/git/stable/linux.git

config MIRROR_TORVALDS_HTTPS_GOOGLE
	bool "HTTPS (Google)"
	help
	  If you enable this option then HTTPS will be used as the source
	  of the mirror and Google URL will be chosen. The URL is:

	  https://kernel.googlesource.com/pub/scm/linux/kernel/git/stable/linux.git

config MIRROR_TORVALDS_GIT
	bool "Git"
	depends on MIRROR_GIT_WORKS
	help
	  If you enable this option then git:// protocol will be used as the
	  source of the mirror. The URL is:

	  git://git.kernel.org/pub/scm/linux/kernel/git/stable/linux.git

endchoice

config MIRROR_TORVALDS_URL
	string
	default "git://git.kernel.org/pub/scm/linux/kernel/git/torvalds/linux.git" if MIRROR_TORVALDS_GIT
	default "https://git.kernel.org/pub/scm/linux/kernel/git/torvalds/linux.git" if MIRROR_TORVALDS_HTTPS
	default "https://kernel.googlesource.com/pub/scm/linux/kernel/git/torvalds/linux.git" if MIRROR_TORVALDS_HTTPS_GOOGLE

choice
	prompt "Linux kdevops's linux fork protocol/source"
	default MIRROR_KDEVOPS_LINUS_HTTPS
	depends on INSTALL_LOCAL_LINUX_MIRROR

config MIRROR_KDEVOPS_LINUS_HTTPS
	bool "HTTPS"
	help
	  If you enable this option then HTTPS will be used as the source
	  of the mirror. The URL is:

	  https://git.kernel.org/pub/scm/linux/kernel/git/mcgrof/linux-next.git

endchoice

config MIRROR_KDEVOPS_LINUS_URL
	string
	default "https://github.com/linux-kdevops/linux.git" if MIRROR_KDEVOPS_LINUS_HTTPS

choice
	prompt "Linux Next mirror protocol/source"
	default MIRROR_NEXT_GIT if MIRROR_GIT_WORKS
	default MIRROR_NEXT_HTTPS if !MIRROR_GIT_WORKS
	depends on INSTALL_LOCAL_LINUX_MIRROR

config MIRROR_NEXT_HTTPS
	bool "HTTPS"
	help
	  If you enable this option then HTTPS will be used as the source
	  of the mirror. The URL is:

	  https://git.kernel.org/pub/scm/linux/kernel/git/next/linux-next.git

config MIRROR_NEXT_HTTPS_GOOGLE
	bool "HTTPS (Google)"
	help
	  If you enable this option then HTTPS will be used as the source
	  of the mirror and Google URL will be chosen. The URL is:

	  https://kernel.googlesource.com/pub/scm/linux/kernel/git/stable/linux.git

config MIRROR_NEXT_GIT
	bool "Git"
	depends on MIRROR_GIT_WORKS
	help
	  If you enable this option then Git protocol will be used as the
	  source of the mirror. The URL is:

	  git://git.kernel.org/pub/scm/linux/kernel/git/next/linux-next.git

endchoice

config MIRROR_NEXT_URL
	string
	default "git://git.kernel.org/pub/scm/linux/kernel/git/next/linux-next.git" if MIRROR_NEXT_GIT
	default "https://git.kernel.org/pub/scm/linux/kernel/git/next/linux-next.git" if MIRROR_NEXT_HTTPS
	default "https://kernel.googlesource.com/pub/scm/linux/kernel/git/next/linux-next.git" if MIRROR_NEXT_HTTPS

choice
	prompt "Linux mcgrof's linux-next fork protocol/source"
	default MIRROR_MCGROF_GIT if MIRROR_GIT_WORKS
	default MIRROR_MCGROF_HTTPS if !MIRROR_GIT_WORKS
	depends on INSTALL_LOCAL_LINUX_MIRROR

config MIRROR_MCGROF_HTTPS
	bool "HTTPS"
	help
	  If you enable this option then HTTPS will be used as the source
	  of the mirror. The URL is:

	  https://git.kernel.org/pub/scm/linux/kernel/git/mcgrof/linux-next.git

config MIRROR_MCGROF_HTTPS_GOOGLE
	bool "HTTPS (Google)"
	help
	  If you enable this option then HTTPS will be used as the source
	  of the mirror and Google URL will be chosen. The URL is:

	  https://kernel.googlesource.com/pub/scm/linux/kernel/git/mcgrof/linux-next.git

config MIRROR_MCGROF_GIT
	bool "Git"
	depends on MIRROR_GIT_WORKS
	help
	  If you enable this option then Git protocol will be used as the
	  source of the mirror. The URL is:

	  git://git.kernel.org/pub/scm/linux/kernel/git/mcgrof/linux-next.git

endchoice

config MIRROR_MCGROF_URL
	string
	default "git://git.kernel.org/pub/scm/linux/kernel/git/mcgrof/linux-next.git" if MIRROR_MCGROF_GIT
	default "https://git.kernel.org/pub/scm/linux/kernel/git/mcgrof/linux-next.git" if MIRROR_MCGROF_HTTPS
	default "https://kernel.googlesource.com/pub/scm/linux/kernel/git/mcgrof/linux-next.git" if MIRROR_MCGROF_HTTPS_GOOGLE

choice
	prompt "Linux mcgrof's linux fork protocol/source"
	default MIRROR_MCGROF_LINUS_GIT if MIRROR_GIT_WORKS
	default MIRROR_MCGROF_LINUS_HTTPS if !MIRROR_GIT_WORKS
	depends on INSTALL_LOCAL_LINUX_MIRROR

config MIRROR_MCGROF_LINUS_HTTPS
	bool "HTTPS"
	help
	  If you enable this option then HTTPS will be used as the source
	  of the mirror. The URL is:

	  https://git.kernel.org/pub/scm/linux/kernel/git/mcgrof/linux-next.git

config MIRROR_MCGROF_LINUS_HTTPS_GOOGLE
	bool "HTTPS (Google)"
	help
	  If you enable this option then HTTPS will be used as the source
	  of the mirror and Google URL will be chosen. The URL is:

	  https://kernel.googlesource.com/pub/scm/linux/kernel/git/mcgrof/linux-next.git

config MIRROR_MCGROF_LINUS_GIT
	bool "Git"
	depends on MIRROR_GIT_WORKS
	help
	  If you enable this option then Git protocol will be used as the
	  source of the mirror. The URL is:

	  git://git.kernel.org/pub/scm/linux/kernel/git/mcgrof/linux-next.git

endchoice

config MIRROR_MCGROF_LINUS_URL
	string
	default "git://git.kernel.org/pub/scm/linux/kernel/git/mcgrof/linux.git" if MIRROR_MCGROF_LINUS_GIT
	default "https://git.kernel.org/pub/scm/linux/kernel/git/mcgrof/linux.git" if MIRROR_MCGROF_LINUS_HTTPS
	default "https://kernel.googlesource.com/pub/scm/linux/kernel/git/mcgrof/linux.git" if MIRROR_MCGROF_LINUS_HTTPS_GOOGLE

choice
	prompt "Linux stable mirror protocol/source"
	default MIRROR_STABLE_GIT if MIRROR_GIT_WORKS
	default MIRROR_STABLE_HTTPS if !MIRROR_GIT_WORKS
	depends on INSTALL_LOCAL_LINUX_MIRROR

config MIRROR_STABLE_HTTPS
	bool "HTTPS"
	help
	  If you enable this option then HTTPS will be used as the source
	  of the mirror. The URL is:

	  https://git.kernel.org/pub/scm/linux/kernel/git/stable/linux.git

config MIRROR_STABLE_HTTPS_GOOGLE
	bool "HTTPS (Google)"
	help
	  If you enable this option then HTTPS will be used as the source
	  of the mirror and Google URL will be chosen. The URL is:

          https://kernel.googlesource.com/pub/scm/linux/kernel/git/stable/linux.git

config MIRROR_STABLE_GIT
	bool "Git"
	depends on MIRROR_GIT_WORKS
	help
	  If you enable this option then Git protocol will be used as the
	  source of the mirror. The URL is:

	  git://git.kernel.org/pub/scm/linux/kernel/git/stable/linux.git

endchoice

config MIRROR_STABLE_URL
	string
	default "git://git.kernel.org/pub/scm/linux/kernel/git/stable/linux.git" if MIRROR_STABLE_GIT
	default "https://git.kernel.org/pub/scm/linux/kernel/git/stable/linux.git" if MIRROR_STABLE_HTTPS
	default "https://kernel.googlesource.com/pub/scm/linux/kernel/git/stable/linux.git" if MIRROR_STABLE_HTTPS_GOOGLE

choice
	prompt "QEMU mirror protocol/source"
	default MIRROR_QEMU_HTTPS_GITLAB
	depends on INSTALL_LOCAL_LINUX_MIRROR

config MIRROR_QEMU_HTTPS_GITLAB
	bool "HTTPS (GitLab)"
	help
	  If you enable this option then GitLab HTTPS will be used as the
	  source of the mirror. The URL is:

	  https://gitlab.com/qemu-project/qemu.git

config MIRROR_QEMU_SSH_GITLAB
	bool "SSH (GitLab)"
	help
	  If you enable this option then GitLab SSH will be used as the source
	  of the mirror. The URL is:

	  ssh://git@gitlab.com:qemu-project/qemu.git

config MIRROR_QEMU_HTTPS_GITHUB
	bool "HTTPS (GitHub)"
	help
	  If you enable this option then GitHub HTTPS will be used as the
	  source of the mirror. The URL is:

	  https://github.com/qemu/qemu.git

config MIRROR_QEMU_SSH_GITHUB
	bool "SSH (GitHub)"
	help
	  If you enable this option then GitHub SSH will be used as the source
	  of the mirror. The URL is:

	  ssh://git@github.com:qemu/qemu.git
endchoice

config MIRROR_QEMU_URL
	string
	default "https://github.com/qemu/qemu.git" if MIRROR_QEMU_HTTPS_GITHUB
	default "ssh://git@github.com:qemu/qemu.git" if MIRROR_QEMU_SSH_GITHUB
	default "https://gitlab.com/qemu-project/qemu.git" if MIRROR_QEMU_HTTPS_GITLAB
	default "ssh://git@gitlab.com:qemu-project/qemu.git" if MIRROR_QEMU_SSH_GITLAB

choice
	prompt "QEMU jic23 mirror protocol/source"
	default MIRROR_QEMU_JIC23_HTTPS_GITLAB
	depends on INSTALL_LOCAL_LINUX_MIRROR

config MIRROR_QEMU_JIC23_HTTPS_GITLAB
	bool "HTTPS (GitLab)"
	help
	  If you enable this option then GitLab HTTPS will be used as the
	  source of the mirror. The URL is:

	  https://gitlab.com/jic23/qemu.git

config MIRROR_QEMU_JIC23_SSH_GITLAB
	bool "SSH (GitLab)"
	help
	  If you enable this option then GitLab SSH will be used as the source
	  of the mirror. The URL is:

	  ssh://git@gitlab.com:jic23/qemu.git

config MIRROR_QEMU_JIC23_HTTPS_GITHUB
	bool "HTTPS (GitHub)"
	help
	  If you enable this option then GitHub HTTPS will be used as the
	  source of the mirror. The URL is:

	  https://github.com/jic23/qemu.git

config MIRROR_QEMU_JIC23_SSH_GITHUB
	bool "SSH (GitHub)"
	help
	  If you enable this option then GitHub SSH will be used as the source
	  of the mirror. The URL is:

	  ssh://git@github.com:jic23/qemu.git
endchoice

config MIRROR_QEMU_JIC23_URL
	string
	default "https://github.com/jic23/qemu.git" if MIRROR_QEMU_JIC23_HTTPS_GITHUB
	default "ssh://git@github.com:jic23/qemu.git" if MIRROR_QEMU_JIC23_SSH_GITHUB
	default "https://gitlab.com/jic23/qemu.git" if MIRROR_QEMU_JIC23_HTTPS_GITLAB
	default "ssh://git@gitlab.com:jic23/qemu.git" if MIRROR_QEMU_JIC23_SSH_GITLAB

choice
	prompt "Tools - xfstests-dev.git mirror protocol/source"
	default MIRROR_FSTESTS_GIT if MIRROR_GIT_WORKS
	default MIRROR_FSTESTS_HTTPS if !MIRROR_GIT_WORKS
	depends on INSTALL_LOCAL_LINUX_MIRROR

config MIRROR_FSTESTS_GIT
	bool "Git"
	depends on MIRROR_GIT_WORKS
	help
	  If you enable this option then git:// protocol will be used as the
	  source of the mirror. The URL is:

	  git://git.kernel.org/pub/scm/fs/xfs/xfstests-dev.git

config MIRROR_FSTESTS_HTTPS
	bool "HTTPS"
	help
	  If you enable this option then GitLab HTTPS will be used as the
	  source of the mirror. The URL is:

	  https://git.kernel.org/pub/scm/fs/xfs/xfstests-dev.git

config MIRROR_FSTESTS_HTTPS_GOOGLE
	bool "HTTPS (Google)"
	help
	  If you enable this option then Google HTTPS will be used as the source
	  of the mirror. The URL is:

	  https://kernel.googlesource.com/pub/scm/fs/xfs/xfstests-dev.git

endchoice

config MIRROR_FSTESTS_URL
	string
	default "git://git.kernel.org/pub/scm/fs/xfs/xfstests-dev.git" if MIRROR_FSTESTS_GIT
	default "https://git.kernel.org/pub/scm/fs/xfs/xfstests-dev.git" if MIRROR_FSTESTS_HTTPS
	default "https://kernel.googlesource.com/pub/scm/fs/xfs/xfstests-dev.git" if MIRROR_FSTESTS_HTTPS_GOOGLE

choice
	prompt "Tools - kdevops/fstests.git mirror protocol/source"
	default MIRROR_KDEVOPS_FSTESTS_HTTPS_GITHUB
	default MIRROR_KDEOVPS_FSTESTS_HTTPS_GITLAB
	depends on INSTALL_LOCAL_LINUX_MIRROR

config MIRROR_KDEVOPS_FSTESTS_HTTPS_GITHUB
	bool "HTTPS (GitHub)"
	help
	  If you enable this option then GitHub HTTPS will be used as the
	  source of the mirror. The URL is:

	  https://github.com/linux-kdevops/fstests.git

config MIRROR_KDEVOPS_FSTESTS_HTTPS_GITLAB
	bool "HTTPS (GitLab)"
	help
	  If you enable this option then GitLab HTTPS will be used as the
	  source of the mirror. The URL is:

	  https://gitlab.com/linux-kdevops/fstests.git

endchoice

config MIRROR_KDEVOPS_FSTESTS_URL
	string
	default "https://github.com/linux-kdevops/fstests.git" if MIRROR_KDEVOPS_FSTESTS_HTTPS_GITHUB
	default "https://gitlab.com/linux-kdevops/fstests.git" if MIRROR_KDEVOPS_FSTESTS_HTTPS_GITLAB

config MIRROR_BLKTESTS_URL
	string
	default "https://github.com/osandov/blktests.git"

config MIRROR_XFSPROGS_URL
	string
	default DEFAULT_XFSPROGS_URL

endif # ENABLE_LOCAL_LINUX_MIRROR
endif # TERRAFORM
```
