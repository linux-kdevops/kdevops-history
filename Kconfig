## Kconfig
```kconfig
# SPDX-License-Identifier: copyleft-next-0.3.1
#
# For a description of the syntax of this configuration file, see:
# https://www.kernel.org/doc/Documentation/kbuild/kconfig-language.txt

mainmenu "$(PROJECT) $(PROJECTRELEASE)"

config HAVE_KDEVOPS_CUSTOM_DEFAULTS
	bool
	default n

config NEEDS_LOCAL_DEVELOPMENT_PATH
	bool
	default n

config KDEVOPS_FIRST_RUN
	bool "Is this your first time running kdevops on this system?"
	default n
	help
	  When you run kdevops for the first time we can enable options
	  to help you install software you may need, as well as do sanity
	  checks for you. Enabling this option will set to the default to "y"
	  for a series of entries which will help you with this first run.
	  Enabling these are not required, they do however help.

source "kconfigs/Kconfig.distro"

menu "Target architecture"
source "kconfigs/arch/Kconfig"
endmenu

menu "SSH update configuration"
source "kconfigs/Kconfig.ssh"
endmenu

source "kconfigs/Kconfig.extra_storage"
source "kconfigs/Kconfig.git_sources"
source "kconfigs/Kconfig.email"
source "kconfigs/Kconfig.hypervisor"
source "kconfigs/Kconfig.mirror"

config LOCAL_DEVELOPMENT_PATH
	string "The path to place source code on localhost if we building things"
	default $(shell, echo $HOME/devel/)
	depends on NEEDS_LOCAL_DEVELOPMENT_PATH
	help
	  The path where kdevops should put code we need to compile.

menu "Bring up methods"
source "kconfigs/Kconfig.bringup"
endmenu

menu "Bring up goals"
source "kconfigs/Kconfig.bringup.goals"
endmenu

menu "Node sysctl configuration"
source "kconfigs/Kconfig.sysctl"
endmenu

menu "Target workflows"
source "kconfigs/workflows/Kconfig"
endmenu

menu "Kdevops configuration"
source "kconfigs/Kconfig.kdevops"
endmenu
```

## kconfigs/Kconfig.ansible_provisioning
```kconfig
if !KDEVOPS_ANSIBLE_PROVISION_ENABLE

config KDEVOPS_PLAYBOOK_DIR
	string
	default $(shell, echo $KDEVOPS_PLAYBOOKS_DIR)
	help
	  The directory where ansible playbooks are found.

endif # KDEVOPS_ANSIBLE_PROVISION_ENABLE

config HAVE_DISTRO_PREFERS_DISABLE_ANSIBLE
	bool
	default n

config KDEVOPS_ANSIBLE_PROVISION_ENABLE
	bool "Enable ansible provisioning"
	default n if HAVE_DISTRO_PREFERS_DISABLE_ANSIBLE || !KDEVOPS_TRY_REFRESH_REPOS
	default y if !HAVE_DISTRO_PREFERS_DISABLE_ANSIBLE || KDEVOPS_TRY_REFRESH_REPOS
	help
	  If enabled we will provision the target hosts with ansible as a last
	  last step after bringup. This playbook used to provision is
	  configurable refer to CONFIG_KDEVOPS_ANSIBLE_INVENTORY_FILE.

if KDEVOPS_ANSIBLE_PROVISION_ENABLE

config KDEVOPS_ANSIBLE_PROVISION_PLAYBOOK
	string "The name of the ansible playbook file to use when provisioning"
	default "devconfig.yml"
	  help
	  The final provisioned playbook to run after bringup. We try to not do
	  much on bringup, for this reason we only allow specifying one
	  playbook to do provisioning. If users want to add more playbooks,
	  new make targets can be added to kdevops for more workflows.

config KDEVOPS_DEVCONFIG_ENABLE
	bool
	default y
	depends on KDEVOPS_ANSIBLE_PROVISION_PLAYBOOK="devconfig.yml"

config KDEVOPS_DEVCONFIG_ENABLE_CONSOLE
	bool "Enable console setup"
	default y
	depends on KDEVOPS_DEVCONFIG_ENABLE
	  help
	  Enable this so that we configure and enable console serial settings
          for you on /etc/default/grub.

if KDEVOPS_DEVCONFIG_ENABLE_CONSOLE

config KDEVOPS_DEVCONFIG_KERNEL_CONSOLE_SETTINGS
	string "Kernel command line console kernel parameters to use"
	default "console=tty0 console=tty1 console=ttyS0,115200n8"
	  help
          Linux kernel console kernel parameters to use. This will be appended
	  to the GRUB configuration file /etc/default/grub on the variable
          GRUB_CMDLINE_LINUX_DEFAULT, if and only if you did not have any
          console settings already set.

config KDEVOPS_DEVCONFIG_GRUB_SERIAL_COMMAND
	string "GRUB specific serial settings"
	default "serial --speed=115200 --unit=0 --parity=no --stop=1"
	  help
          GRUB console settings to use. This will be appended to the GRUB
          configuration file /etc/default/grub on the variable
          GRUB_SERIAL_COMMAND, if and only if we did change the your console
          settings as per the above configured kernel parameters passed.

config KDEVOPS_GRUB_TIMEOUT
	int "GRUB timeout"
	default 2
	  help
          GRUB timeout to wait for user interaction to let you pick another
          kernel or boot options.

endif # KDEVOPS_DEVCONFIG_ENABLE_CONSOLE

config KDEVOPS_DEVCONFIG_ENABLE_SYSTEMD_WATCHDOG
	bool "Enable systemd watchdog setup"
	default y
	depends on KDEVOPS_DEVCONFIG_ENABLE
	  help
	  Enable this to allow you to configure your systemd watchdog configuration.
	  For details refer to: https://www.freedesktop.org/software/systemd/man/systemd-system.conf.html

if KDEVOPS_DEVCONFIG_ENABLE_SYSTEMD_WATCHDOG

config KDEVOPS_DEVCONFIG_SYSTEMD_WATCHDOG_TIMEOUT_RUNTIME
	string "Configures the RuntimeWatchdogSec settting"
	default "5min"
	  help
          Configures the systemd watchdog RuntimeWatchdogSec setting.

config KDEVOPS_DEVCONFIG_SYSTEMD_WATCHDOG_TIMEOUT_REBOOT
	string "Configures the RebootWatchdogSec settting"
	default "10min"
	  help
          Configures the systemd watchdog RebootWatchdogSec setting.

config KDEVOPS_DEVCONFIG_SYSTEMD_WATCHDOG_TIMEOUT_KEXEC
	string "Configures the KexecWatchdogSec settting"
	default "5min"
	  help
          Configures the systemd watchdog KexecWatchdogSec setting.

endif # KDEVOPS_DEVCONFIG_ENABLE_SYSTEMD_WATCHDOG

config KDEVOPS_PLAYBOOK_DIR
	string "The directory for the ansible playbooks to use"
	default $(shell, echo $KDEVOPS_PLAYBOOKS_DIR)
	help
	  The directory where ansible playbooks are found.

config KDEVOPS_ANSIBLE_INVENTORY_FILE
	string "The ansible inventory file to use"
	default $(shell, echo $KDEVOPS_HOSTFILE)
	help
	  The file to use for the ansible inventory.

config HAVE_DISTRO_PREFERS_ANSIBLE_PYTHON2
	bool
	default n

config KDEVOPS_PYTHON_INTERPRETER
	string "Which default python interpreter to use"
	default "/usr/bin/python2" if HAVE_DISTRO_PREFERS_ANSIBLE_PYTHON2
	default "/usr/bin/python3" if !HAVE_DISTRO_PREFERS_ANSIBLE_PYTHON2
	help
	  The python interpreter must be specified clearly for each host when
	  using ansible, otherwise you will run into odd issues if the
	  heuristics used by ansible are incorrect. Specify the default
	  python interpreter we should use on the target hosts. You shouldn't
	  need to modify unless you are going to be working with a distribution
	  which we have not yet added support for. You can also instead use
	  the old interpreter in your file if you know you are working with
	  old hosts.

config KDEVOPS_PYTHON_OLD_INTERPRETER
	string "Which python interpreter to use for old systems"
	default "/usr/bin/python2"
	help
	  The default python interpreter may be python3 but we need something
	  so that we can specify it on older systems. You can then use the
	  KDEVOPSPYTHONOLDINTERPRETER value on your hosts.in file on old
	  systems so that this gets properly placed.

config DEVCONFIG_ENABLE_SYSTEMD_JOURNAL_REMOTE
	bool "Set up remote systemd-journal-remote"
	default n
	select DEVCONFIG_ENABLE_SYSTEMD_TIMESYNCD
	select DEVCONFIG_ENABLE_SYSTEMD_TIMESYNCD_TIMEZONE
	select DEVCONFIG_ENABLE_SYSTEMD_TIMESYNCD_NTP
	help
          It is a pain to have to ssh to target nodes one is testing to check
          for kernel logs. Enable this to allow us to set up the host with
	  systemd-journal-remote.service on then we will also congigure all
	  test nodes with systemd-journal-upload.service so to upload their
	  systemd journal to the host. By default we rely on insecure http
	  on the default port 19532 on the host.

	  The journal logs will be placed on the host on

	  /var/log/journal/remote/remote-*test-node*.journal

	  By default a reverse lookup is tried, if that does not work the IP
	  address of incoming test node is used. Note that if you install and
	  enable libnss-libvirt (Fedora libvirt-nss) you will only get DNS
	  resolution, but not reverse lookups so by default we will only have
	  IP addresses. A way to overcome this is to edit the host /etc/hosts
	  file, however that is instrusive. A post process make target for
	  kdevops will be developed which will create symlinks to the respective
	  test node IP addresses.

	  For more details see:
	  https://www.freedesktop.org/software/systemd/man/latest/systemd-journal-remote.service.html
	  https://www.freedesktop.org/software/systemd/man/latest/systemd-journal-upload.service.html
	  https://www.freedesktop.org/software/systemd/man/latest/journal-upload.conf.html

	  The systemd journal format:
	  https://systemd.io/JOURNAL_EXPORT_FORMATS/

	  libvirt nss module:
	  https://libvirt.org/nss.html

if DEVCONFIG_ENABLE_SYSTEMD_JOURNAL_REMOTE

config DEVCONFIG_SYSTEMD_JOURNAL_USE_HTTP
	bool "Use simple insecure http"
	default y
	help
          For a simple setup you don't want to set up SSL cert files.
          If you disable this you are on your own for now on setting up the
	  SSL cert files. For cloud environments you may want to have a
	  command and control server within the network on the nodes, and assign
	  that node as the systemd service.

config DEVCONFIG_SYSTEMD_JOURNAL_REMOTE_URL
	string "systemd-remote URL"
	default "http://192.168.124.1" if VAGRANT
	default GUESTFS_DEFAULT_BRIDGE_IP if GUESTFS
	help
          This is used for the client /etc/systemd/journal-upload.conf URL line.
          By default we won't use SSL for now. If you should make sure the
	  IP address used here matches what the node should use. If using
	  libvirt then ensure it is the same for your virtualization setup.
	  If you are using vagrant on debian on the host it would seem the
	  current default should work.

endif # DEVCONFIG_ENABLE_SYSTEMD_JOURNAL_REMOTE

config DEVCONFIG_ENABLE_SYSTEMD_TIMESYNCD
	bool "Set up systemd-timesyncd"
	default n
	help
          It if often useful to have the host and target nodes on the same
	  time. This is usefult to optimize watchdogs so that we can use on
	  local time instead of remote time for a sense of how much time has
	  lapsed. Enable this if you want to benefit from this.

if DEVCONFIG_ENABLE_SYSTEMD_TIMESYNCD

config DEVCONFIG_ENABLE_SYSTEMD_TIMESYNCD_TIMEZONE
	bool "Enable changing timezone using systemd-timesyncd"
	default n
	help
          Set the timezone with timedatectl. Without this then we'd leave all
	  nodes with whatever time zone they were installed with. The value in
	  using the same time is so we can simplify watchdogs and so having the
	  same timezone over the command and control server and remote clients
	  is very valuable. Enable this to set the timezone on the host and
	  remote clients.

	  You can grow this list by looking at the output of:

	    timedatectl list-timezones

	  We can likely grow this list automatically later with kdevops
	  make dynconfig, so the timezone entries are automatically created.

	  Disable this if you know you don't need to do this.

if DEVCONFIG_ENABLE_SYSTEMD_TIMESYNCD_TIMEZONE

choice
	prompt "Timezone to set with timedatectl"
	default DEVCONFIG_SYSTEMD_TIMESYNCD_TIMEZONE_UTC

config DEVCONFIG_SYSTEMD_TIMESYNCD_TIMEZONE_UTC
	bool "UTC"
	help
	  This will use the UTC timezone. You should consider using UTC.

config DEVCONFIG_SYSTEMD_TIMESYNCD_TIMEZONE_US_PACIFIC
	bool "US/Pacific"
	help
	  This will use the US/Pacific timezone.

config DEVCONFIG_SYSTEMD_TIMESYNCD_TIMEZONE_CUSTOM
	bool "Custom timezone"
	help
	  This will let you specify the timezone yourself"

endchoice


config DEVCONFIG_SYSTEMD_TIMESYNCD_TIMEZONE_CUSTOM_STRING
	string "Timezone to use"
	default "UTC"
	help
	  Set this to a value which is allowed from the output of the command:

	    timedatectl list-timezones

config DEVCONFIG_SYSTEMD_TIMESYNCD_TIMEZONE
	string
	default "UTC" if DEVCONFIG_SYSTEMD_TIMESYNCD_TIMEZONE_UTC
	default "US/Pacific" if DEVCONFIG_SYSTEMD_TIMESYNCD_TIMEZONE_US_PACIFIC
	default DEVCONFIG_SYSTEMD_TIMESYNCD_TIMEZONE_CUSTOM_STRING if DEVCONFIG_SYSTEMD_TIMESYNCD_TIMEZONE_CUSTOM

endif # DEVCONFIG_ENABLE_SYSTEMD_TIMESYNCD_TIMEZONE

config DEVCONFIG_ENABLE_SYSTEMD_TIMESYNCD_NTP
	bool "Enable systemd-timesyncd NTP"
	default y
	help
          Enable NTP service using systemd-timesyncd.

if DEVCONFIG_ENABLE_SYSTEMD_TIMESYNCD_NTP

choice
	prompt "NTP servers to use"
	default DEVCONFIG_ENABLE_SYSTEMD_TIMESYNCD_NTP_GOOGLE_DEBIAN

config DEVCONFIG_ENABLE_SYSTEMD_TIMESYNCD_NTP_GOOGLE
	bool "Google NTP servers"
	help
	  This will use Google NTP servers.

config DEVCONFIG_ENABLE_SYSTEMD_TIMESYNCD_NTP_DEBIAN
	bool "Debian NTP servers"
	help
	  This will use Debian NTP servers.

config DEVCONFIG_ENABLE_SYSTEMD_TIMESYNCD_NTP_GOOGLE_DEBIAN
	bool "Google as primary and Debian as fallback"
	help
	  This will use Google NTP servers as the main ones and Bebian NTP
	  servers as a fallback.

endchoice

endif # DEVCONFIG_ENABLE_SYSTEMD_TIMESYNCD_NTP

endif # DEVCONFIG_ENABLE_SYSTEMD_TIMESYNCD

if KDEVOPS_DEVCONFIG_ENABLE

config KDEVOPS_DEVCONFIG_ENABLE_CUSTOM_REPOS
	bool "Allow user to add custom repositories and install packages from them"
	default n
	help
          Enable Kconfig options to allow user to add custom package
          repositories and to also specify packages to be installed
          from them.

config KDEVOPS_DEVCONFIG_CUSTOM_REPOS
	string "Comma separated list of custom repositories to be enabled"
	default ""
	depends on KDEVOPS_DEVCONFIG_ENABLE_CUSTOM_REPOS=y
	help
	  Comma separated list of custom repositories to be enabled

config KDEVOPS_DEVCONFIG_CUSTOM_PACKAGES
	string "Comma separated list of custom packages to be installed"
	default ""
	depends on KDEVOPS_DEVCONFIG_ENABLE_CUSTOM_REPOS=y
	help
	  Comma separated list of custom packages to be installed

endif # KDEVOPS_DEVCONFIG_ENABLE

endif # KDEVOPS_ANSIBLE_PROVISION_ENABLE
```
