## kconfigs/Kconfig.bringup
```kconfig
config BRINGUP_SUPPORTS_CXL
	bool

choice
	prompt "Node bring up method"
	default VAGRANT

config VAGRANT
	bool "Vagrant for local virtualization (KVM / VirtualBox)"
	select KDEVOPS_SSH_CONFIG_UPDATE_STRICT
	select EXTRA_STORAGE_SUPPORTS_ZNS
	select EXTRA_STORAGE_SUPPORTS_LARGEIO
	select BRINGUP_SUPPORTS_CXL
	depends on TARGET_ARCH_X86_64
	help
	  This option will enable use of Vagrant. Enable this if you want to
	  use local virtualization technologies such as KVM with libvirt or
	  VirtualBox. Enabling this feature will enable you to select which
	  target guests to use, and configures things for you. It will also
	  ensure dependencies are installed for Vagrant when running:

	    make deps

config GUESTFS
	bool "Use guestfs-tools for local virtualization via KVM and libvirt (EXPERIMENTAL)"
	select EXTRA_STORAGE_SUPPORTS_LARGEIO
	help
	  This option will use libguestfs utilities instead of Vagrant to build
	  guest images and spin them up using libvirt with KVM.

config TERRAFORM
	bool "Terraform for cloud environments"
	select EXTRA_STORAGE_SUPPORTS_512
	select EXTRA_STORAGE_SUPPORTS_1K
	select EXTRA_STORAGE_SUPPORTS_2K
	select EXTRA_STORAGE_SUPPORTS_4K
	help
	  This option will enable use of Vagrant. Enable this if you want to
	  use terraform to create nodes on a cloud environment such as:

	    * Azure
	    * AWS
	    * OpenStack
	    * GCE

	  Enabling this option will enable installing terraform dependencies
	  when you run:

	    make deps

	  If you are not using a cloud environment just disable this.

config SKIP_BRINGUP
	bool "Skip bring up - bare metal or existing nodes"
	select EXTRA_STORAGE_SUPPORTS_512
	select EXTRA_STORAGE_SUPPORTS_1K
	select EXTRA_STORAGE_SUPPORTS_2K
	select EXTRA_STORAGE_SUPPORTS_4K
	help
	  This option will skip bring up, as you already have existing
	  systems up and available and ssh'able. This might be the case
	  if you are working with bare metal systems or systems you may
	  have already provisioned through other means.

endchoice

if GUESTFS

choice
	prompt "Guestfs Linux distribution to use"
	default GUESTFS_FEDORA

config GUESTFS_FEDORA
	bool "Fedora (or derived distro)"
	select HAVE_DISTRO_XFS_PREFERS_MANUAL if FSTESTS_XFS
	select HAVE_DISTRO_BTRFS_PREFERS_MANUAL if FSTESTS_BTRFS
	select HAVE_DISTRO_EXT4_PREFERS_MANUAL if FSTESTS_EXT4
	select HAVE_DISTRO_PREFERS_FSTESTS_WATCHDOG if KDEVOPS_WORKFLOW_ENABLE_FSTESTS
	select HAVE_DISTRO_PREFERS_FSTESTS_WATCHDOG_KILL if KDEVOPS_WORKFLOW_ENABLE_FSTESTS
	help
	  This option will set the target guest to be a distro in the Fedora family.
	  For example, Fedora, RHEL, etc.

config GUESTFS_DEBIAN
	bool "Debian"
	select HAVE_CUSTOM_DISTRO_HOST_PREFIX
	select HAVE_DISTRO_XFS_PREFERS_MANUAL if FSTESTS_XFS
	select HAVE_DISTRO_BTRFS_PREFERS_MANUAL if FSTESTS_BTRFS
	select HAVE_DISTRO_EXT4_PREFERS_MANUAL if FSTESTS_EXT4
	select HAVE_DISTRO_PREFERS_CUSTOM_HOST_PREFIX
	select HAVE_DISTRO_PREFERS_FSTESTS_WATCHDOG if KDEVOPS_WORKFLOW_ENABLE_FSTESTS
	select HAVE_DISTRO_PREFERS_FSTESTS_WATCHDOG_KILL if KDEVOPS_WORKFLOW_ENABLE_FSTESTS
	help
	  This option will set the target guest to Debian.

endchoice

config VIRT_BUILDER_OS_VERSION
       string "virt-builder os-version"
       default "fedora-39" if GUESTFS_FEDORA
       default "debian-12" if GUESTFS_DEBIAN
       help
         Have virt-builder use this os-version string to
         build a root image for the guest. Run "virt-builder -l"
         to get a list of operating systems and versions supported
         by guestfs.

if GUESTFS_DEBIAN

config GUESTFS_DEBIAN_BOX_SHORT
        string
        default "debian12" if GUESTFS_DEBIAN

endif

endif # GUESTFS

config LIBVIRT
	bool
	depends on VAGRANT_LIBVIRT_SELECT || GUESTFS
	default y

source "vagrant/Kconfig"
source "terraform/Kconfig"
if LIBVIRT
source "kconfigs/Kconfig.libvirt"
endif
```

## kconfigs/Kconfig.bringup.goals
```kconfig
config HAVE_DISTRO_PREFERS_REFRESH
	bool
	default n

config HAVE_DISTRO_PREFERS_UPDATE
	bool
	default n

config HAVE_DISTRO_PREFERS_INSTALL_KDEVTOOLS
	bool
	default n

config KDEVOPS_TRY_REFRESH_REPOS
	bool "Try to refresh repositories on bringup?"
	default n if !HAVE_DISTRO_PREFERS_REFRESH
	default y if HAVE_DISTRO_PREFERS_REFRESH
	help
	  Bring up typically just consists of having the systems accessible
	  via ssh. However, most of these systems are pretty bare bones and
	  useless right after bring up, likely with stale repositories or
	  software. Enabling this option will only try to update the
	  repositories. If you require registration to update your repositories
	  that implies we will try to register your system if you enable that.
	  You will need to enable this option to install any packages through
	  the automated system on kdevops.

	  Disabling this is a good idea if all you want to do is test raw
	  bring up of kdevops.

config RHEL_REGISTER
	bool "Register the guests with Red Hat?"
	default n
	help
	  Official RHEL installations require a subscription before you can download
	  packages from their core repos. Enable this if you're deploying an official
	  RHEL cloud image (e.g. generic/rhel9).

config RHEL_ORG_ID
	string "Red Hat Organization Identifier"
	depends on RHEL_REGISTER
	default ""
	help
	  Enter the Red Hat Organizational ID for your subscription here.

config RHEL_ACTIVATION_KEY
	string "Red Hat Activation Key"
	depends on RHEL_REGISTER
	default ""
	help
	  Enter the Activation Key to use when registering systems.

config KDEVOPS_CUSTOM_YUM_REPOFILE
	string "Custom yum repo file"
	default ""
	help
	  Add a custom yum repo file to /etc/yum.repos.d before updating? Leave blank to
	  disable this feature or set to repofile path on local machine.

config KDEVOPS_TRY_UPDATE_SYSTEMS
	bool "Try to update target hosts on bringup?"
	depends on KDEVOPS_TRY_REFRESH_REPOS
	default n if !HAVE_DISTRO_PREFERS_UPDATE
	default y if HAVE_DISTRO_PREFERS_UPDATE
	help
	  Bring up typically just consists of having the systems accessible
	  via ssh. However, most of these systems are pretty bare bones and
	  useless right after bring up. Enabling this will try to update your
	  target systems to their respective latest.

config KDEVOPS_TRY_INSTALL_KDEV_TOOLS
	bool "Try to install kernel development tools on bringup?"
	depends on KDEVOPS_TRY_REFRESH_REPOS
	default n if !HAVE_DISTRO_PREFERS_INSTALL_KDEVTOOLS
	default y if HAVE_DISTRO_PREFERS_INSTALL_KDEVTOOLS
	help
	  Enabling this will try to install a slew of known packages which
	  most kernel developers might prefer to have installed on target
	  systems.

config KDEVOPS_SETUP_SIW
	bool "Configure soft iWARP on all test systems"
	default n
	help
	  Configure software-emulated RDMA on all target hosts via the
	  kernel siw.ko driver. siw can be used with any standard
	  Ethernet device, including virtio-net devices.

	  Because siw is currently not enabled in most Linux distro
	  kernels, this option defaults to N.

config KDEVOPS_SETUP_KTLS
	bool "Configure ktls on the hosts with self-signed CA"
	default n
	help
	  Enabling this will have kdevops create a self-signed certificate
	  authority, and configure tlshd on the hosts to use it. This is
	  necessary for testing RPC over TLS, or NVMe over TCP.

source "kconfigs/Kconfig.nfsd"
source "kconfigs/Kconfig.krb5"
```

## kconfigs/Kconfig.defaults
```kconfig
# Please keep in alphabetical order

config DEFAULT_BLKTRACE_URL
	string
	default "https://git.kernel.dk/blktrace"

config DEFAULT_DBENCH_URL
	string
	default "https://github.com/linux-kdevops/dbench.git"

config DEFAULT_XFSDUMP_URL
	string
	default "https://github.com/linux-kdevops/xfsdump-dev.git"

config DEFAULT_XFSPROGS_URL
	string
	default "https://git.kernel.org/pub/scm/fs/xfs/xfsprogs-dev.git"
```

## kconfigs/Kconfig.distro
```kconfig
config DISTRO_DEBIAN
	bool
	default $(shell, scripts/os-release-check.sh debian)

config DISTRO_FEDORA
	bool
	default $(shell, scripts/os-release-check.sh fedora)

config DISTRO_OPENSUSE
	bool
	default $(shell, scripts/os-release-check.sh opensuse)

config DISTRO_REDHAT
	bool
	default $(shell, scripts/os-release-check.sh redhat)

config DISTRO_SUSE
	bool
	default $(shell, scripts/os-release-check.sh suse)

config DISTRO_UBUNTU
	bool
	default $(shell, scripts/os-release-check.sh ubuntu)
```

## kconfigs/Kconfig.email
```kconfig
config SETUP_POSTFIX_EMAIL_RELAY
	bool "Set postfix relayhost localy to send emails reports"
	default n if !HAVE_KDEVOPS_CUSTOM_DEFAULTS
	default KDEVOPS_DEFAULT_SETUP_POSTFIX_RELAY if HAVE_KDEVOPS_CUSTOM_DEFAULTS
	help
	  The most secure and easiest way to send email reports is to
	  configure a relayhost on on your postfix configuration. A relayhost
	  is set up by just modifying /etc/postfix/main.cf with the variable:

	  relayhost = foo.host.com

	  And then we'd restart postfix. Say y here only if its your first
	  time configuring your hypervisor. This is not needed after the first
	  setup.

if SETUP_POSTFIX_EMAIL_RELAY

config SETUP_POSTFIX_EMAIL_RELAY_HOST
	string "The relayhost string to use"
	default "test.com" if !HAVE_KDEVOPS_CUSTOM_DEFAULTS
	default KDEVOPS_DEFAULT_SETUP_POSTFIX_RELAY_HOST if HAVE_KDEVOPS_CUSTOM_DEFAULTS
	help
	  The SSH configuration file we should update, for each of the systems
	  created.

endif
```

## kconfigs/Kconfig.extra_storage
```kconfig
config EXTRA_STORAGE_SUPPORTS_512
	bool
	default n

config EXTRA_STORAGE_SUPPORTS_1K
	bool
	default n

config EXTRA_STORAGE_SUPPORTS_2K
	bool
	default n

config EXTRA_STORAGE_SUPPORTS_4K
	bool
	default n
```

## kconfigs/Kconfig.git_sources
```kconfig
config GIT_ALTERNATIVES
	bool "Use git trees from sources which we know only work"
	default y
	help
	  A few supported workflows require additional software to be installed.
	  An example is the fstests git tree when testing with fstests. Another
	  is the nbd (network block device) git tree which is required when
	  using blktests to allow you to compile and install the nbd server and
	  client on some distributions where these binaries not available for
	  the distribution.

	  Ideally you want to be using the latest and greatest from the
	  respective upstream project's git trees. However, sometimes using
	  the respective upstream project's git trees means you have to deal
	  with build issues. This is specially true for projects which don't
	  really have stable releases like fstests. Running into these issues
	  as developers is acceptable, we just try to fix those issues and
	  move on with life. However, if you are working to do automation of
	  testing then running into any new silly compile issues is a huge
	  detriment to your efforts.

	  To help with this, the kdevops project also has forked a few of the
	  needed repositories and keeps its own respective tree master branches
	  in a working state, so to ensure that users won't run into oddball
	  build issues. These git trees would not exist unless an issue is
	  known to exist with an existing upstream project, and so these trees
	  may also contain a small delta of fixes to address these changes.
	  The kdevops project commits to ensuring that all delta carried in
	  these trees are already submitted to their respective upstream project.

	  The kdevops project relies on two mirrors for its alternative git
	  trees:

	    * GitHub
	    * GitLab

	  We default to using kdevop's GitHub mirror.

	  The list of projects which kdevops currently forks is maintained
	  below:

	   * fstests

	  If you don't see a git tree above, it means that this option
	  (GIT_ALTERNATIVES) will not affect how we use that tree.

	  If you are a kernel developer and don't mind running into the
	  all the bumps in the road with using all upstream projects then you
	  should just disable this. You can always disable this without
	  running 'make menuconfig' by just using the latest kernel-hacking
	  defconfig:

	    make defconfig-kernel-hacking

	  Likewise to ensure you always use the conservative options you can
	  use the kernel-testing defconfig:

	    make defconfig-kernel-testing

choice
	prompt "Alternative git tree sources"
	default GIT_LINUX_KDEVOPS_GITHUB
	depends on GIT_ALTERNATIVES

config GIT_LINUX_KDEVOPS_GITHUB
	bool "Use kdevops' GitHub trees"
	help
	  If you enable this option then GitHub will be used as the source
	  of the mirrored kdevops alternative trees. The list of trees
	  on GitHub are listed here:

	  https://github.com/linux-kdevops/

config GIT_LINUX_KDEVOPS_GITLAB
	bool "Use kdevops' GitLab trees"
	help
	  If you enable this option then GitLab will be used as the source
	  of the mirrored kdevops alternative trees. The list of trees
	  on GitLab are listed here:

	  https://gitlab.com/linux-kdevops/

endchoice
```

## kconfigs/Kconfig.guestfs
```kconfig
if GUESTFS

choice
	prompt "Guestfs Linux distribution to use"
	default GUESTFS_FEDORA

config GUESTFS_FEDORA
	bool "Fedora (or derived distro)"
	select HAVE_DISTRO_XFS_PREFERS_MANUAL if FSTESTS_XFS
	select HAVE_DISTRO_BTRFS_PREFERS_MANUAL if FSTESTS_BTRFS
	select HAVE_DISTRO_EXT4_PREFERS_MANUAL if FSTESTS_EXT4
	select HAVE_DISTRO_PREFERS_FSTESTS_WATCHDOG if KDEVOPS_WORKFLOW_ENABLE_FSTESTS
	select HAVE_DISTRO_PREFERS_FSTESTS_WATCHDOG_KILL if KDEVOPS_WORKFLOW_ENABLE_FSTESTS
	help
	  This option will set the target guest to be a distro in the Fedora family.
	  For example, Fedora, RHEL, etc.

config GUESTFS_DEBIAN
	bool "Debian"
	select HAVE_CUSTOM_DISTRO_HOST_PREFIX
	select HAVE_DISTRO_XFS_PREFERS_MANUAL if FSTESTS_XFS
	select HAVE_DISTRO_BTRFS_PREFERS_MANUAL if FSTESTS_BTRFS
	select HAVE_DISTRO_EXT4_PREFERS_MANUAL if FSTESTS_EXT4
	select HAVE_DISTRO_PREFERS_CUSTOM_HOST_PREFIX
	select HAVE_DISTRO_PREFERS_FSTESTS_WATCHDOG if KDEVOPS_WORKFLOW_ENABLE_FSTESTS
	select HAVE_DISTRO_PREFERS_FSTESTS_WATCHDOG_KILL if KDEVOPS_WORKFLOW_ENABLE_FSTESTS
	help
	  This option will set the target guest to Debian.

endchoice

config VIRT_BUILDER_OS_VERSION
       string "virt-builder os-version"
       default "fedora-39" if GUESTFS_FEDORA
       default "debian-12" if GUESTFS_DEBIAN
       help
         Have virt-builder use this os-version string to
         build a root image for the guest. Run "virt-builder -l"
         to get a list of operating systems and versions supported
         by guestfs.

if GUESTFS_DEBIAN

config GUESTFS_DEBIAN_BOX_SHORT
        string
        default "debian12" if GUESTFS_DEBIAN

endif

endif # GUESTFS
```
