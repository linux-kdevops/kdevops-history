## kconfigs/Kconfig.kernel-ci
```kconfig
config HAVE_KERNEL_CI_CUSTOM_DEFAULTS
	bool
	default n

if !HAVE_KERNEL_CI_CUSTOM_DEFAULTS

config KERNEL_CI_DEFAULT_STEADY_STATE_GOAL
	int
	default 100

endif

config KERNEL_CI
	bool "Enable kernel continous integration"
	default y
	help
	  If you have the goal to run a test not just once but in an ongoing
	  basis to verify if you have found a regression by updating your kernel
	  in between each test loop you are essentially doing kernel continous
	  integration (kernel-ci) and can enable this to assist you with this.
	  Enabling this will allow you to run test loops per workflow, for
	  instance, if such workflows support kernel-ci. Workflows support
	  kernel-ci by implementing a Makefile target for a test with a "loop"
	  postfix. For instance, to run the fstests kernel-ci loop you would
	  just run:

	    make fstests-baseline-loop

	  Enable this option if you want to enable and configure certain
	  kernel-ci features.

if KERNEL_CI

config KERNEL_CI_ENABLE_STEADY_STATE
	bool "Bound kernel-ci tests with a steady-state goal"
	default y
	help
	  Enable this so that tests don't run forever in a loop if no issues
	  are found, instead, the kernel-ci loop will bail once a certain number
	  of full loops have passed without failures. We refer to this goal as
	  a kernel-ci steady-state test goal. Although the goal can be workflow
	  specific, for now we define a generic goal which can be used by all
	  workflows.

	  If you don't enable this, and the test you are running won't ever run
	  into a failure, you'll have the test run forever.

if KERNEL_CI_ENABLE_STEADY_STATE

config KERNEL_CI_STEADY_STATE_GOAL
	int "Generic kernel-ci steady-state goal"
	default 100 if !HAVE_KERNEL_CI_CUSTOM_DEFAULTS
	default KERNEL_CI_DEFAULT_STEADY_STATE_GOAL if HAVE_KERNEL_CI_CUSTOM_DEFAULTS
	help
	  The maximum number of possitive successes to have before bailing out
	  a kernel-ci loop and report success. This value is currently used for
	  all workflows. A value of 100 means 100 tests will run before we
	  bail out and report we have achieved steady state for the workflow
	  being tested.

endif # KERNEL_CI_ENABLE_STEADY_STATE

config KERNEL_CI_EMAIL_REPORT
	bool "Enable sending a report on failure"
	default n if !HAVE_KERNEL_CI_CUSTOM_DEFAULTS
	default KERNEL_CI_DEFAULT_ENABLE_EMAIL_REPORT if HAVE_KERNEL_CI_CUSTOM_DEFAULTS
	help
	  Enable this so that a report will be emailed in case of a failure.

if KERNEL_CI_EMAIL_REPORT

config KERNEL_CI_ADD_CUSTOM_SUBJECT_TOPIC
	bool "Enable a custom kernel-ci subject topic for email reports"
	default y if BOOTLINUX || VAGRANT
	help
	  Enable this so that you can customize the subject slightly for
	  kernel-ci email reports. The email subject prefix will always
	  start with "kernel-ci: ", if this is enabled we allow you to
	  slightly configure this. Otherwise the standard "kernel-ci: "
	  subject prefix will be used.

	  You want to enable this if you are using kernel-ci for different
	  things, such as testing a distribution kernel but also a stable
	  or linux-next kernel, so that you can distinguish for which kernel
	  the report is for.

if KERNEL_CI_ADD_CUSTOM_SUBJECT_TOPIC

config KERNEL_CI_SUBJECT_TOPIC
	string "Main email subject topic prefix to use"
	default "" if !BOOTLINUX && !VAGRANT
	default VAGRANT_PREFERRED_KERNEL_CI_SUBJECT_TOPIC if !BOOTLINUX && VAGRANT
	default BOOTLINUX_TREE_NAME if BOOTLINUX
	help
	  Email kernel-ci subject will include the git tree name you are using.
	  This is set in the BOOTLINUX_TREE_NAME kconfig variable. For instance,
	  if you decided to build and boot into a linux stable tree the
	  subject for the kernel-ci email will start with:

	    kernel-ci linux-stable:

config KERNEL_CI_ADD_CUSTOM_SUBJECT_TOPIC_TAG
	bool "Add git tag to kernel-ci subject topic"
	default y if BOOTLINUX
	depends on BOOTLINUX
	help
	  Enable this so that the kernel-ci subject topic will also have
	  the git tag used. For intance, if you have enabled to build and
	  boot  into linux-next tag next-20210126, and you also enabled this
	  option, the KERNEL_CI_SUBJECT_TOPIC will be set to "linux-next" and
	  the subject for the kernel-ci email will start with:

	    kernel-ci linux-next next-20210126:

	  If you do not enable this, then the subject for the kernel-ci email
	  will start only with:

	    kernel-ci linux-next:

endif # KERNEL_CI_ADD_CUSTOM_SUBJECT_TOPIC

choice
	prompt "kernel-ci email sending method"
	default KERNEL_CI_EMAIL_METHOD_SSH

config KERNEL_CI_EMAIL_METHOD_LOCAL
	bool "Send email by running mail command locally"
	help
	  Assume smtp is configured already on the localhost where kdevops is
	  running and that we can rely on the mail command to send emails.

config KERNEL_CI_EMAIL_METHOD_SSH
	bool "Send email by running ssh and mail command"
	select KDEVOPS_SSH_CONFIG_UPDATE_STRICT
	help
	  Instead of configuring the localhost where kdevops is running
	  with smtp to send mail you can choose this option to instead ssh
	  into a target host which has smtp configured so you can send an
	  email report from it. You are highly encouraged to set up a
	  password protected ssh key, and for you to unlock that key
	  only for the shell instance where kdevops will run. You can do
	  this for example as follows, assuming you are running the
	  fstests kernel-ci baseline loop:

	    ssh-agent bash
	    ssh-add ~/.ssh/target
	    make fstests-baseline-loop

endchoice

if KERNEL_CI_EMAIL_METHOD_SSH

config KERNEL_CI_EMAIL_SSH_HOST
	string "The name of the host to ssh to send email report"
	default "localhost" if !HAVE_KERNEL_CI_CUSTOM_DEFAULTS
	default KERNEL_CI_DEFAULT_EMAIL_SSH_HOST if HAVE_KERNEL_CI_CUSTOM_DEFAULTS
	  help
	  The host to use to ssh into to send an email report. You should
	  ideally have the host configured to log into using a password
	  protected ssh key, and prior to running your kernel-ci loop
	  you should unlock the key using ssh-agent, and ssh-add. For instance
	  if testing the fstests baseline loop you would use:

	    ssh-agent bash
	    ssh-add ~/.ssh/target
	    make fstests-baseline-loop

endif # KERNEL_CI_EMAIL_METHOD_SSH

config KERNEL_CI_EMAIL_MODIFY_FROM
	bool "Modify default from address"
	select KDEVOPS_SSH_CONFIG_UPDATE_STRICT
	default n if !HAVE_KERNEL_CI_CUSTOM_DEFAULTS
	default KERNEL_CI_DEFAULT_EMAIL_MODIFY_FROM if HAVE_KERNEL_CI_CUSTOM_DEFAULTS
	help
	  If you would like to modify the default from address used to send
	  the report enable this.

config KERNEL_CI_EMAIL_FROM
	string "Who to send the email from"
	depends on KERNEL_CI_EMAIL_MODIFY_FROM
	default $(shell, echo $USER) if !HAVE_KERNEL_CI_CUSTOM_DEFAULTS
	default KERNEL_CI_DEFAULT_EMAIL_FROM if HAVE_KERNEL_CI_CUSTOM_DEFAULTS
	  help
	  The email to pass on to mailx -S from="" setting. This will be used
	  to modify the from address of the email report sent.

config KERNEL_CI_EMAIL_RCPT
	string "Who to send email report to"
	default $(shell, echo $USER) if !HAVE_KERNEL_CI_CUSTOM_DEFAULTS
	default KERNEL_CI_DEFAULT_EMAIL_RCPT if HAVE_KERNEL_CI_CUSTOM_DEFAULTS
	  help
	  Comma separated list of users to send the kernel-ci loop email
	  report to. These are the recipients of the kernel-ci test loop
	  report.

endif # KERNEL_CI_EMAIL_REPORT

endif # KERNEL_CI
```

## kconfigs/Kconfig.krb5
```kconfig
config KDEVOPS_SETUP_KRB5
	bool "Set up KRB5"
	default n
	help
	  Configure and bring up a MIT Kerberos V5 KDC.

if KDEVOPS_SETUP_KRB5

menu "Configure the KRB5 KDC"

config KRB5_REALM
	string "KRB5 Realm"
	default "KDEVOPS"
	help
	  Kerberos realm to create.

config KRB5_ADMIN_PW
	string "KRB5 admin password"
	default "kdevops"
	help
	  Password to use for the 'root/admin' principal.

endmenu

endif
```
