## kconfigs/Kconfig.nfsd
```kconfig
# FIXME: need defaults for terraform hosts
config NFSD_EXPORT_DEVICE_PREFIX
	string "The device prefix to use for LVM PVs"
	default "/dev/disk/by-id/nvme-QEMU_NVMe_Ctrl_kdevops" if LIBVIRT && LIBVIRT_EXTRA_STORAGE_DRIVE_NVME
	default "/dev/disk/by-id/virtio-kdevops" if LIBVIRT && LIBVIRT_EXTRA_STORAGE_DRIVE_VIRTIO
	default "/dev/disk/by-id/ata-QEMU_HARDDISK_kdevops" if LIBVIRT && LIBVIRT_EXTRA_STORAGE_DRIVE_IDE
	default ""
	help
	  To set up nfsd for testing, we give it filesystems to export. This string
	  will be the prefix for the block devices used as PVs for LVM.

config NFSD_EXPORT_DEVICE_COUNT
	int "Number of devices to add as LVM PVs"
	default 3 if LIBVIRT
	help
	  The number of disk devices to dedicate as LVM PVs. In general, we
	  avoid using device index 0 as that is used for /data.

choice
	prompt "Type of filesystem to export"
	default NFSD_EXPORT_FSTYPE_BTRFS

config NFSD_EXPORT_FSTYPE_BTRFS
	bool "btrfs"

config NFSD_EXPORT_FSTYPE_XFS
	bool "xfs"

config NFSD_EXPORT_FSTYPE_EXT4
	bool "ext4"

config NFSD_EXPORT_FSTYPE_TMPFS
	bool "tmpfs"

endchoice

config NFSD_EXPORT_FSTYPE
	string
	default "btrfs" if NFSD_EXPORT_FSTYPE_BTRFS
	default "xfs" if NFSD_EXPORT_FSTYPE_XFS
	default "ext4" if NFSD_EXPORT_FSTYPE_EXT4
	default "tmpfs" if NFSD_EXPORT_FSTYPE_TMPFS

config NFSD_EXPORT_PATH
	string "The path under which to mount the devices to be exported."
	default "/export"
	help
	  This is the path that will be exported from the nfsd server. The
	  export devices are mounted here under numbered directories starting
	  with 0.

config NFSD_EXPORT_OPTIONS
	string "The export options to use for the exported fs"
	default "rw,insecure,no_root_squash"
	help
	  The export options that the export should have

config NFSD_THREADS
	int "Number of nfsd threads to spawn"
	default 8
	help
	  Number of nfsd threads to start up for testing.

config NFSD_LEASE_TIME
	int "NFSv4 lease time and grace period, in seconds"
	default 90
	help
	  Time, in seconds, that the NFS server will wait before expiring
	  a client lease. Production servers typically use 90 seconds to
	  allow a large client cohort enough time to recover their open
	  and lock state. But a shorter lease time helps certain tests
	  complete faster.
```

## kconfigs/Kconfig.reg_twoline
```kconfig
config KDEVOPS_REG_TWOLINE_ENABLE_STRING
	string "Enabling string"
	default "suse_register_system" if HAVE_DISTRO_SUSE
	help
	  The twoline method will create a file playbooks/secret.yml, the
	  string set here is the name of the enabler variable which will be
	  set to the value of 'True'.

config KDEVOPS_REG_TWOLINE_REGCODE_VAR
	string "Registration code variable name"
	default "suse_registration_code" if HAVE_DISTRO_SUSE
	help
	  The twoline method will create a file playbooks/secret.yml, the
	  string set here is the name of the variable which will be used
	  to define the registration code.

config KDEVOPS_REG_TWOLINE_REGCODE
	string "Registration code"
	default "KDEVOPS-UNSET-REGCODE"
	help
	  The twoline method will create a file playbooks/secret.yml, the
	  string set here is the actual registration code value.
```

## kconfigs/Kconfig.ssh
```kconfig
config KDEVOPS_SSH_CONFIG_UPDATE
	bool "Update your SSH configuration for you?"
	default y
	depends on !SKIP_BRINGUP
	help
	  If enabled, your SSH configuration file will be updated for you based
	  on the results obtained from the bring up. This is useful in case
	  it is not clear what the IP address of the hosts just created are.

	  This is enabled by default, as this is the promise by kdevops, to be
	  easy to use with sensible but careful deafults. If you are concerned
	  for mistakes know that we do a backup of your SSH configuration for
	  you just in case.

	  You are encourated to leave this enabled, uness you really don't trust
	  this code.

if KDEVOPS_SSH_CONFIG_UPDATE

config KDEVOPS_SSH_CONFIG
	string "The ssh configuration file to update for systems created"
	default "~/.ssh/config"
	help
	  The ssh configuration file we should update, for each of the systems
	  created.

config KDEVOPS_SSH_CONFIG_UPDATE_STRICT
	bool "Use strict configuration settings when adding each host"
	default y
	help
	  If enabled when we update your ssh host we will add the following
	  few more lines to each entry:

	     UserKnownHostsFile /dev/null
	     StrictHostKeyChecking no
	     PasswordAuthentication no
	     IdentitiesOnly yes
	     LogLevel FATAL

	  You are encouraged to use this. Vagrant does this, and so you can't
	  disable this if you are using Vagrant.

config KDEVOPS_SSH_CONFIG_UPDATE_BACKUP
	bool "Create a backup when updating your SSH config file"
	default y
	help
	  This will create a backup of your SSH configuration file prior to
	  doing the update for you. The filename for the backup will be:

	    ~/.ssh/config.backup.kdevops.$method

	  where $method is either Vagrant or terraform.

endif # KDEVOPS_SSH_CONFIG_UPDATE
```

## kconfigs/Kconfig.sysctl
```kconfig
config SYSCTL_TUNING
	bool "Enable sysctl knob tuning"
	default n
	help
	  Enable this to let you set specific sysctls on the target nodes
	  after bootup. This step is done during bring up once. The sysctls
	  are written to so they are persistent.

if SYSCTL_TUNING

config SYSCTL_TUNING_CONF
	string "The syctl file to use"
	default "/etc/sysctl.conf"
	help
	  Specifies the absolute path to sysctl.conf to use to write syctl
	  values.

config SYSCTL_TUNING_MM_OVERCOMMIT_MEMORY_ENABLE
	bool "Enable overwriting vm.overcommit_memory"
	default n
	help
	  Enable this to let you override the default sysctl setting for
	  vm.overcommit_memory. This can be used to customize the method
	  for kernel memory overcommitment.

if SYSCTL_TUNING_MM_OVERCOMMIT_MEMORY_ENABLE

choice
	prompt "How to tune vm.overcommit_memory"
	default SYSCTL_TUNING_MM_OVERCOMMIT_MEMORY_0

config SYSCTL_TUNING_MM_OVERCOMMIT_MEMORY_0
	bool "Set vm.overcommit_memory=0"
	help
	  This is the default, when vm.overcommit_memory=0 the kernel attempts
	  to estimate the amount free memory left when userspace requests more
	  memory. This is what userspace typically expects.

config SYSCTL_TUNING_MM_OVERCOMMIT_MEMORY_1
	bool "Set vm.overcommit_memory=1"
	help
	  This sets vm.overcommit_memory=1, and with this kernel pretends that
	  there is always enough memory until it actually runs out. This is
	  very useful to proove odd kernel failures with tests which have a low
	  failure rate where you suspect the issue can be triggered due to OOM
	  situations. Enabling this will surely trigger the OOM killer but
	  will also force the kernel to OOM faster in areas where otherwise
	  it would not have triggered faster. It also useful to proove or
	  not faster when userspace triggers the OOM.

	  It helps to provide an example where this can be useful. The fstests
	  test xfs/074 is known to require a lot of memory due to its use of
	  xfs_scratch. xfs_scratch has also long been obsolete and so it is
	  disabled by default via fstests commit 591c8fb57d07 ("common/xfs:
	  skip xfs_check unless the test runner forces us to"). The OOMs
	  with xfs/074 can more easily be triggered by enabling
	  vm.overcommit_memory=1.

config SYSCTL_TUNING_MM_OVERCOMMIT_MEMORY_2
	bool "Set vm.overcommit_memory=2"
	help
	  This will set vm.overcommit_memory=2. When this is set the kernel
	  uses a "never overcommit" policy which attempts to prevent any
	  overcommit of memory. Note that user_reserve_kbytes affects this
	  policy.

endchoice

config SYSCTL_TUNING_MM_OVERCOMMIT_MEMORY
	int "The value to set for vm.overcommit_memory"
	default 0 if SYSCTL_TUNING_MM_OVERCOMMIT_MEMORY_0
	default 1 if SYSCTL_TUNING_MM_OVERCOMMIT_MEMORY_1
	default 2 if SYSCTL_TUNING_MM_OVERCOMMIT_MEMORY_2
	help
	  The value to use for vm.overcommit_memory. Setting this value to
	  something other than vm.overcommit_memory=0 is very useful because
	  there are a lot of programs that malloc() huge amounts of memory
	  "just-in-case" but don't use much of it. It is also useful to
	  trigger OOMs in the kernel faster.

endif # SYSCTL_TUNING_MM_OVERCOMMIT_MEMORY_ENABLE

endif # SYSCTL_TUNING
```

## kconfigs/arch/Kconfig
```kconfig
choice
	prompt "Target architecture"
	default $(shell,scripts/get_target_arch.sh)
	help
	  Choose the generic platfrom architecture to target during testing.
	  This setting enables features and workflows for that architecture
	  and sets sensible defaults.

	  The target host Instruction Set Architecture is selected in the
	  "Bring up methods" menu.

config TARGET_ARCH_X86_64
	bool "x86_64"
	help
	  Enabling this will enable all features / workflows which depend on
	  the x86_64 architecture.

config TARGET_ARCH_ARM64
	bool "arm64"
	select HAVE_ARCH_64K_PAGES
	help
	  Enabling this will enable all features / workflows which depend on
	  the arm64 architecture.

config TARGET_ARCH_PPC64LE
	bool "ppc64le"
	select HAVE_ARCH_64K_PAGES
	help
	  Enabling this will enable all features / workflows which depend on
	  the ppc64le architecture.

endchoice

# Note: this means you have something like this on your target architecture
# and respective kernel configuration:
#
# CONFIG_PPC_64K_PAGES=y
# CONFIG_ARM64_64K_PAGES=y
#
# x86_64 currently lacks support for 64k pages. This HAVE_ARCH_64K_PAGES is
# a kdevops'ism, it does not exist on the Linux kernel.
config HAVE_ARCH_64K_PAGES
        bool
```

## kconfigs/workflows/Kconfig
```kconfig
config WORKFLOWS
	bool "Enable different target workflows"
	default y
	select KDEVOPS_ANSIBLE_PROVISION_ENABLE
	help
	  If you want to do something other than just bring up of target systems
	  enable this option. For instance, you may want to easily boot linux
	  and/or run fstests.

if WORKFLOWS

menu "Shared workflow configuration"
source "kconfigs/workflows/Kconfig.shared"
endmenu

choice
	prompt "Target Linux kernel to use"
	default WORKFLOW_LINUX_DISTRO

config WORKFLOW_LINUX_DISTRO
	bool "Distro kernel"
	help
	help
	  If you are targetting a workflow to run on a distribution kernel
	  enable this.

config WORKFLOW_LINUX_CUSTOM
	bool "Upstream Linux or custom kernel"
	select BOOTLINUX
	help
	  If you are targetting a workflow to run on a vanilla upstream
	  linux, linux-stable, linux-next, or a custom kernel you want to
	  build and install enable this.

endchoice

if WORKFLOW_LINUX_CUSTOM
menu "Get and install Linux from git"
config BOOTLINUX
	bool "Enable getting and installing Linux from git"
	default n
	help
	  This option will allow the 'make linux' target be usable for you
	  to just get Linux from git, or to install it as well.

	  Say y unless you don't want to have 'make linux' do anything.

source "kconfigs/workflows/bootlinux/Kconfig"
endmenu
endif # WORKFLOW_LINUX_CUSTOM

config WORKFLOWS_TESTS
	bool "Enable selection of test workflows"
	default n

if WORKFLOWS_TESTS

config WORKFLOWS_TESTS_DEMOS
	bool "Enable demo workflows"
	help
	 If you are a new developer to kdevops this is where you can look at
	 for simple examples of workflows. Although these are considered
	 hello-world simple in nature, some of them are actually useful tests.

if WORKFLOWS_TESTS_DEMOS
source "kconfigs/workflows/Kconfig.demo"
endif

config WORKFLOWS_LINUX_TESTS
	bool "Linux subsystem tests"
	help
	 Enable this to allow let you select which Linux test frameworks you
	 want to enable. These are tests for specific subsystems.

if WORKFLOWS_LINUX_TESTS

config WORKFLOWS_DEDICATED_WORKFLOW
	bool "Are you only targetting one subsystem test?"
	default y
	help
	 Enable this to if you are only wanting to test one main Linux
	 subsystem. If you enable this, a subsystem test in kdevops might
	 then allow you to grow the number of nodes you are to use to cover
	 all aspects of that subsystem. If you want to test two major subsystems
	 then you'd end up spawning nodes for both subsystems and we don't
	 support that yet. But if you do want to test more than one subsystem,
	 and disable this dedicated workflow option, you'd only get two default
	 nodes spawned.

	 If you disable this you the respective subsystem target test baseline
	 targets may not work as they are intended to work with a node setup
	 dedicated to only one subsystem test. In other words, if you disable
	 this option you are on your own, good luck!

if WORKFLOWS_DEDICATED_WORKFLOW

choice
	prompt "Dedicated target Linux test workflow"
	default KDEVOPS_WORKFLOW_ENABLE_NONE

config KDEVOPS_WORKFLOW_ENABLE_NONE
	bool "None"
	help
	 This essentially disables all workflow tests.

config KDEVOPS_WORKFLOW_DEDICATE_FSTESTS
	bool "fstests"
	select KDEVOPS_WORKFLOW_ENABLE_FSTESTS
	help
	  This will dedicate your configuration only to fstests.

	  Select this option if you are doing filesystem development and want
	  to target development for a filesystem and enable fstests so that
	  you can test the filesystem.

	  The fstests git tree will be cloned, and set up for you, and
	  you will be able to run create a baseline for your target filesystem,
	  and also test to ensure you don't regress that baseline. If a baseline
	  already exists against your distribution you will be able to ensure
	  you don't regress against development changes on your kernel.

config KDEVOPS_WORKFLOW_DEDICATE_BLKTESTS
	bool "blktests"
	select KDEVOPS_WORKFLOW_ENABLE_BLKTESTS
	help
	  This will dedicate your configuration only to blktests.

endchoice

endif

if !WORKFLOWS_DEDICATED_WORKFLOW

config KDEVOPS_WORKFLOW_NOT_DEDICATED_ENABLE_FSTESTS
	bool "fstests"
	select KDEVOPS_WORKFLOW_ENABLE_FSTESTS
	help
	  Select this option if you are doing filesystem development and want
	  to target development for a filesystem and enable fstests so that
	  you can test the filesystem.

	  The fstests git tree will be cloned, and set up for you, and
	  you will be able to run create a baseline for your target filesystem,
	  and also test to ensure you don't regress that baseline. If a baseline
	  already exists against your distribution you will be able to ensure
	  you don't regress against development changes on your kernel.

config KDEVOPS_WORKFLOW_NOT_DEDICATED_ENABLE_BLKTESTS
	bool "blktests"
	select KDEVOPS_WORKFLOW_ENABLE_BLKTESTS
	help
	  Select this option if you are doing block layer development and want
	  to run blktests. The git tree for blktests will be git clone and
	  setup for you.

endif # !WORKFLOWS_DEDICATED_WORKFLOW

config KDEVOPS_WORKFLOW_ENABLE_FSTESTS
	bool
	default y if KDEVOPS_WORKFLOW_NOT_DEDICATED_ENABLE_FSTESTS || KDEVOPS_WORKFLOW_DEDICATE_FSTESTS

if KDEVOPS_WORKFLOW_ENABLE_FSTESTS
menu "Configure and run fstests"
source "workflows/fstests/Kconfig"
endmenu
endif # KDEVOPS_WORKFLOW_ENABLE_FSTESTS

config KDEVOPS_WORKFLOW_ENABLE_BLKTESTS
	bool
	default y if KDEVOPS_WORKFLOW_NOT_DEDICATED_ENABLE_BLKTESTS || KDEVOPS_WORKFLOW_DEDICATE_BLKTESTS

if KDEVOPS_WORKFLOW_ENABLE_BLKTESTS
menu "Configure and run blktests"
source "workflows/blktests/Kconfig"
endmenu
endif # KDEVOPS_WORKFLOW_ENABLE_BLKTESTS

config KDEVOPS_WORKFLOW_GIT_CLONES_KDEVOPS_GIT
	bool
	default y if KDEVOPS_WORKFLOW_ENABLE_FSTESTS || KDEVOPS_WORKFLOW_ENABLE_BLKTESTS

endif # WORKFLOWS_LINUX_TESTS

endif # WORKFLOWS_TESTS

endif # WORKFLOWS
```
