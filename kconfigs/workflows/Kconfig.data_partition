## terraform/azure/Kconfig
```kconfig
if TERRAFORM_AZURE

choice
	prompt "Choose Azure resource location to use"
	default TERRAFORM_AZURE_WEST_US

config TERRAFORM_AZURE_WEST_US
	bool "westus"
	help
	  This option will set the azure resource location to westus.

endchoice

config TERRAFORM_AZURE_RESOURCE_LOCATION
	string "Azure resource location"
	default "westus" if TERRAFORM_AZURE_WEST_US
	help
	  This option will set the azure resource location.

choice
	prompt "Azure vmsize"
	default TERRAFORM_AZURE_VM_SIZE_STANDARD_DS3_V2

config TERRAFORM_AZURE_VM_SIZE_STANDARD_DS1_V2
	bool "Standard_DS1_v2"
	depends on TARGET_ARCH_X86_64
	help
	  This option will set the azure vm image size to Standard_DS1_v2.

config TERRAFORM_AZURE_VM_SIZE_STANDARD_DS3_V2
	bool "Standard_DS3_v2"
	depends on TARGET_ARCH_X86_64
	help
	  This option will set the azure vm image size to Standard_DS3_v2.

endchoice

config TERRAFORM_AZURE_VM_SIZE
	string "Azure vm size"
	default "Standard_DS1_v2" if TERRAFORM_AZURE_VM_SIZE_STANDARD_DS1_V2
	default "Standard_DS3_v2" if TERRAFORM_AZURE_VM_SIZE_STANDARD_DS3_V2
	help
	  This option will set the azure vm image size.

choice
	prompt "Azure managed disk type"
	default TERRAFORM_AZURE_MANAGED_DISK_PREMIUM_LRS

config TERRAFORM_AZURE_MANAGED_DISK_PREMIUM_LRS
	bool "Premium_LRS"
	help
	  This option will set the azure vm image size to Standard_DS1_v2.

endchoice

config TERRAFORM_AZURE_MANAGED_DISK_TYPE
	string "Azure managed disk type"
	default "Premium_LRS" if TERRAFORM_AZURE_MANAGED_DISK_PREMIUM_LRS
	help
	  This option will set azure managed disk type.

choice
	prompt "Azure image publisher"
	default TERRAFORM_AZURE_IMAGE_PUBLISHER_DEBIAN

config TERRAFORM_AZURE_IMAGE_PUBLISHER_DEBIAN
	bool "Debian"
	help
	  This option will set the image publisher to Debian.

endchoice

config TERRAFORM_AZURE_IMAGE_PUBLISHER
	string "The azure image publisher"
	default "Debian" if TERRAFORM_AZURE_IMAGE_PUBLISHER_DEBIAN
	help
	  This option will set path to the image publisher.

if TERRAFORM_AZURE_IMAGE_PUBLISHER_DEBIAN

choice
	prompt "Azure image offer"
	default TERRAFORM_AZURE_IMAGE_OFFER_DEBIAN_10 if DISTRO_DEBIAN

config TERRAFORM_AZURE_IMAGE_OFFER_DEBIAN_10
	bool "debian-10"
	depends on TARGET_ARCH_X86_64
	help
	  This option sets the image offer from credativ to debian-10.

endchoice

if TERRAFORM_AZURE_IMAGE_OFFER_DEBIAN_10

choice
	prompt "Azure debian image SKU"
	default TERRAFORM_AZURE_IMAGE_DEBIAN_SKU_10

config TERRAFORM_AZURE_IMAGE_DEBIAN_SKU_10
	bool "10"
	help
	  This option sets the image sku to 10.

endchoice

endif # TERRAFORM_AZURE_IMAGE_OFFER_DEBIAN_10

endif

config TERRAFORM_AZURE_IMAGE_OFFER
	string "Azure image offer to use"
	default "debian-10" if TERRAFORM_AZURE_IMAGE_OFFER_DEBIAN_10
	help
	  This option will set image offer. For more debian offers read:

	  https://wiki.debian.org/Cloud/MicrosoftAzure

config TERRAFORM_AZURE_IMAGE_SKU
	string "Azure image SKU"
	default "10" if TERRAFORM_AZURE_IMAGE_DEBIAN_SKU_10
	help
	  This option will set azure image sku to use.

config TERRAFORM_AZURE_IMAGE_VERSION
	string "Azure image version"
	default "latest"
	help
	  This option will set azure image version to use. Its a good idea to
	  use "latest" here.

config TERRAFORM_AZURE_CLIENT_CERT_PATH
	string "Azure client certificate path"
	default "./service-principal.pfx"
	help
	  Path to the service principal PFX file for this application. For
	  details on how to create this and associate it with your account
	  read this:

	  https://www.terraform.io/docs/providers/azurerm/auth/service_principal_client_certificate.html
	  https://github.com/terraform-providers/terraform-provider-azurerm.git

	  But the skinny of of how to create it:

	  openssl req -newkey rsa:4096 -nodes -keyout "service-principal.key" -out "service-principal.csr"
	  openssl x509 -signkey "service-principal.key" -in "service-principal.csr" -req -days 365 -out "service-principal.crt"
	  openssl pkcs12 -export -out "service-principal.pfx" -inkey "service-principal.key" -in "service-principal.crt"

	  Then use the documentation to get your tentant ID, the applicaiton id,
	  the subscription ID.

config TERRAFORM_AZURE_CLIENT_CERT_PASSWD
	string "Azure client certificate password"
	default "some-password"
	help
	  The password to the service principal PFX file.

config TERRAFORM_AZURE_SUBSCRIPTION_ID
	string "Azure subscription ID"
	default "anotherGUID"
	help
	  The subscription ID to use.

config TERRAFORM_AZURE_TENANT_ID
	string "Azure tenant ID"
	default "anotherGUID"
	help
	  The tentant ID to use.

config TERRAFORM_AZURE_APPLICATION_ID
	string "Azure client application ID"
	default "someGUID"
	help
	  The application ID to use.

config TERRAFORM_AZURE_DATA_VOLUME_DEVICE_FILE_NAME
	string "/dev/sdc"

endif # TERRAFORM_AZURE
```

## terraform/gce/Kconfig
```kconfig
if TERRAFORM_GCE

config TERRAFORM_GCE_PROJECT_NAME
	string "GCE Project name"
	default "kdevops"
	help
	  This option will set the GCE project name. This name must match
	  the actual name of the project you have created using the
	  GCE interface.

config TERRAFORM_GCE_REGION_LOCATION
	string "GCE region location"
	default "us-west2-c"
	help
	  This option will set the GCE region location. For more examples:
	  https://cloud.google.com/compute/docs/regions-zones/

	  Documentation: https://registry.terraform.io/providers/hashicorp/google/latest/docs/resources/compute_instance#zone

choice
	prompt "Choose GCE Machine type"
	default TERRAFORM_GCE_MACHINE_N1_STANDARD_8

config TERRAFORM_GCE_MACHINE_N1_STANDARD_1
	bool "n1-standard-1"
	depends on TARGET_ARCH_X86_64
	help
	  This option will set the GCE machine type to n1-standard-1.

config TERRAFORM_GCE_MACHINE_N1_STANDARD_8
	bool "n1-standard-8"
	depends on TARGET_ARCH_X86_64
	help
	  This option will set the GCE machine type to n1-standard-8.

endchoice

config TERRAFORM_GCE_MACHINE_TYPE
	string
	default "n1-standard-1" if TERRAFORM_GCE_MACHINE_N1_STANDARD_1
	default "n1-standard-8" if TERRAFORM_GCE_MACHINE_N1_STANDARD_8
	help
	  This option will set the GCE machine type. For other machine types,
	  refer to this page:

	  https://cloud.google.com/compute/docs/machine-types

	  Documentation: https://registry.terraform.io/providers/hashicorp/google/latest/docs/resources/compute_instance#machine_type

config TERRAFORM_GCE_SCRATCH_DISK_INTERFACE
	string "GCE scratch disk interface to use"
	default "NVME"
	help
	  This option will set GCE scratch disk interface.

	  Documentation: https://registry.terraform.io/providers/hashicorp/google/latest/docs/resources/compute_instance#scratch_disk

config TERRAFORM_GCE_IMAGE
	string "GCE image to use"
	default "debian-cloud/debian-10"
	help
	  This option will set GCE image to debian-cloud/debian-10.

	  Documentation: https://registry.terraform.io/providers/hashicorp/google/latest/docs/resources/compute_instance#image

config TERRAFORM_GCE_JSON_CREDENTIALS_PATH
	string "GCE json credential file path"
	default "account.json"
	help
	  Path to the GCE json credentials file. Refer to the following links
	  for documentation about this:

	    o https://www.terraform.io/docs/providers/google/getting_started.html
	    o https://www.terraform.io/docs/providers/google/index.html
	    o https://cloud.google.com/community/tutorials/getting-started-on-gcp-with-terraform
	    o https://cloud.google.com/iam/docs/creating-managing-service-account-keys
	    o https://cloud.google.com/iam/docs/granting-roles-to-service-accounts#granting_access_to_a_service_account_for_a_resource

config TERRAFORM_GCE_DATA_VOLUME_DEVICE_FILE_NAME
	string
	default "/dev/nvme0n1"

endif # TERRAFORM_GCE
```

## terraform/oci/Kconfig
```kconfig
if TERRAFORM_OCI

config TERRAFORM_OCI_REGION
	string "OCI Region"
	help
	  This option will set the OCI resource location.
	  Read this:
	  https://docs.oracle.com/en-us/iaas/Content/API/SDKDocs/terraformproviderconfiguration.htm

config TERRAFORM_OCI_TENANCY_OCID
	string "OCI tenant OCID"
	help
	  The OCI ID of the tenancy to use.
	  Read this:
	  https://docs.oracle.com/en-us/iaas/Content/API/SDKDocs/terraformproviderconfiguration.htm

config TERRAFORM_OCI_USER_OCID
	string "OCI user OCID"
	help
	  The OCI ID of the user to use.
	  Read this:
	  https://docs.oracle.com/en-us/iaas/Content/API/SDKDocs/terraformproviderconfiguration.htm

config TERRAFORM_OCI_USER_PRIVATE_KEY_PATH
	string "OCI user private key path"
	help
	  Path to the file containing the private key of the user.
	  Read this:
	  https://docs.oracle.com/en-us/iaas/Content/API/SDKDocs/terraformproviderconfiguration.htm

config TERRAFORM_OCI_USER_FINGERPRINT
	string "OCI user fingerprint"
	help
	  Fingerprint for the key pair being used.
	  Read this:
	  https://docs.oracle.com/en-us/iaas/Content/API/SDKDocs/terraformproviderconfiguration.htm

config TERRAFORM_OCI_AVAILABLITY_DOMAIN
	string "OCI availablity domain"
	help
	  The name of the availability domain.
	  Read this:
	  https://docs.oracle.com/en-us/iaas/Content/API/SDKDocs/terraformproviderconfiguration.htm

config TERRAFORM_OCI_COMPARTMENT_OCID
	string "OCI compartment OCID"
	help
	  The OCI ID of user's compartment.
	  Read this:
	  https://docs.oracle.com/en-us/iaas/Content/API/SDKDocs/terraformproviderconfiguration.htm

config TERRAFORM_OCI_SHAPE
	string "OCI shape name"
	help
	  The name of the shape
	  Read this:
	  https://docs.oracle.com/en-us/iaas/Content/API/SDKDocs/terraformproviderconfiguration.htm

config TERRAFORM_OCI_OS_IMAGE_OCID
	string "OCI OS image OCID"
	help
	  The OCI ID of the OS image to use.
	  Read this:
	  https://docs.oracle.com/en-us/iaas/Content/API/SDKDocs/terraformproviderconfiguration.htm

config TERRAFORM_OCI_SUBNET_OCID
	string "OCI Subnet OCID"
	help
	  The OCI ID of the subnet.
	  Read this:
	  https://docs.oracle.com/en-us/iaas/Content/API/SDKDocs/terraformproviderconfiguration.htm

config TERRAFORM_OCI_DATA_VOLUME_DISPLAY_NAME
	string "Display name to use for the data volume"
	help
	  Human readable data volume instance name
	  Read this:
	  https://docs.oracle.com/en-us/iaas/Content/API/SDKDocs/terraformproviderconfiguration.htm

config TERRAFORM_OCI_DATA_VOLUME_DEVICE_FILE_NAME
	string "Data volume's device file name"
	help
	  Data volume's device file name
	  Read this:
	  https://docs.oracle.com/en-us/iaas/Content/API/SDKDocs/terraformproviderconfiguration.htm

config TERRAFORM_OCI_SPARSE_VOLUME_DISPLAY_NAME
	string "Display name to use for the sparse volume"
	help
	  Human readable sparse volume instance name
	  Read this:
	  https://docs.oracle.com/en-us/iaas/Content/API/SDKDocs/terraformproviderconfiguration.htm

config TERRAFORM_OCI_SPARSE_VOLUME_DEVICE_FILE_NAME
	string "Sparse volume's device file name"
	help
	  Sparse volume's device file name
	  Read this:
	  https://docs.oracle.com/en-us/iaas/Content/API/SDKDocs/terraformproviderconfiguration.htm

endif # TERRAFORM_OCI
```

## terraform/openstack/Kconfig
```kconfig
if TERRAFORM_OPENSTACK

config TERRAFORM_TERRAFORM_OPENSTACK_CLOUD_NAME
	string "OpenStack cloud name on your clouds.yaml"
	default "minicloud"
	help
	  This option sets the name of the cloud you will use which has
	  configuration settings described on the file clouds.yaml.

config TERRAFORM_TERRAFORM_OPENSTACK_INSTANCE_PREFIX
	string "Openstack instance prefix name for resources"
	default "example"
	help
	  This option will set a prefix name for openstack_compute_secgroup_v2.
	  This will likely be removed or replaced in the future. This is only
	  useful to distinguish one resource name right now.

choice
	prompt "Choose flavor name (machine type)"
	default TERRAFORM_OPENSTACK_MINICLOUD_TINY

config TERRAFORM_OPENSTACK_MINICLOUD_TINY
	bool "minicloud.tiny"
	depends on TARGET_ARCH_PPC64LE
	help
	  This option will set the Openstack flavor to minicloud.tiny.

endchoice

config TERRAFORM_OPENSTACK_FLAVOR
	string "OpenStack flavor"
	default "minicloud.tiny" if TERRAFORM_OPENSTACK_MINICLOUD_TINY
	help
	  This option will set the OpenStack flavor name.

choice
	prompt "Choose OpenStack image name"
	default TERRAFORM_OPENSTACK_IMAGE_DEBIAN_10_PPC64LE

config TERRAFORM_OPENSTACK_IMAGE_DEBIAN_10_PPC64LE
	bool "Debian 10 ppc64le"
	depends on TARGET_ARCH_PPC64LE
	help
	  This option sets the image name to Debian 10 ppc64le.

endchoice

config TERRAFORM_OPENSTACK_IMAGE_NAME
	string "OpenStack image name"
	default "Debian 10 ppc64le" if TERRAFORM_OPENSTACK_IMAGE_DEBIAN_10_PPC64LE && DISTRO_DEBIAN
	help
	  This option will set OpenStack image name to use.

config TERRAFORM_OPENSTACK_SSH_PUBKEY_NAME
	string "Name of already existing pubkey uploaded"
	default "kdevops-pubkey"
	help
	  Name of already existing pubkey or the new one you are about to
	  upload, this must be set

config TERRAFORM_OPENSTACK_PUBLIC_NETWORK_NAME
	string "Name of the public network"
	default "public"
	help
	  Name of an already existing public network in the cluster.
endif # TERRAFORM_OPENSTACK
```
