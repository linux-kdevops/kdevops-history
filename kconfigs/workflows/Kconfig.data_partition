## terraform/aws/Kconfig
```kconfig
if TERRAFORM_AWS

choice
	prompt "AWS region to use"
	default TERRAFORM_AWS_US_WEST_2

config TERRAFORM_AWS_US_WEST_1
	bool "us-west-1 - North California"
	help
	  This option will set the AWS region to us-west-1.

config TERRAFORM_AWS_US_WEST_2
	bool "us-west-2 - Oregon"
	help
	  This option will set the AWS region to us-west-2.

	  If you wish to expand on this list send a patch after reading
	  this list:

	  https://docs.aws.amazon.com/general/latest/gr/rande.html

	  Note that if you change region the AMI may change as well even
	  for the same distribution. At least that applies to Amazon EC2
	  optimized images. Use the AWS console, to set that up it will
	  ask you for your credentials and then a region. Before adding
	  an entry for ami image be sure you are on the region and then
	  query with something like:

	  aws ec2 describe-images --image-ids ami-0efa651876de2a5ce

	  For instance, this AMI belongs to us-west-2 only. us-east* have
	  other AMIs for the same Amazon 2023 EC2 image. The output from
	  here tells me:

	  "OwnerId": "137112412989"

	  And that is what vaule to use for that ami-0efa651876de2a5ce
	  for the TERRAFORM_AWS_AMI_OWNER. To get the ami-* for your regions
	  just go to your EC2 console, that console will be associated with
	  a region already. You have to change regions if you want to look
	  for AMIs in other regions. There are for example two different
	  ami-* values for Amazon Linux 2023 for different regions. However
	  they values can be same. For example below are the us-west-2 queries
	  for Amazon Linux 2023 for x86_64 and then for ARM64.

	  aws ec2 describe-images --image-ids ami-0efa651876de2a5ce | grep OwnerId
	    "OwnerId": "137112412989",
	  aws ec2 describe-images --image-ids ami-0699f753302dd8b00 | grep OwnerId
	    "OwnerId": "137112412989",

endchoice

config TERRAFORM_AWS_REGION
	string
	default "us-west-2" if TERRAFORM_AWS_US_WEST_2
	default "us-west-1" if TERRAFORM_AWS_US_WEST_1

if TERRAFORM_AWS_US_WEST_2

choice
	prompt "AWS West 2 AV region to use"
	default TERRAFORM_AWS_AV_REGION_WEST_2B

config TERRAFORM_AWS_AV_REGION_WEST_1B
	bool "us-west-1b"
	help
	  This option will set the AWS AV region to us-west-1b.
	  This option will set the AWS availablity region to the specified
	  value.

	  If you wish to expand on this list send a patch after reading this
	  list:

	  https://docs.aws.amazon.com/AmazonRDS/latest/UserGuide/Concepts.RegionsAndAvailabilityZones.html
	  https://gist.github.com/neilstuartcraig/0ccefcf0887f29b7f240

config TERRAFORM_AWS_AV_REGION_WEST_2B
	bool "us-west-2b"
	help
	  This option will set the AWS AV region to us-west-2b.

config TERRAFORM_AWS_AV_REGION_WEST_2D
	bool "us-west-2d"
	help
	  This option will set the AWS AV region to us-west-2d.

endchoice

endif # TERRAFORM_AWS_US_WEST_2

config TERRAFORM_AWS_AV_REGION
	string
	default "us-west-1b" if TERRAFORM_AWS_AV_REGION_WEST_1B
	default "us-west-2b" if TERRAFORM_AWS_AV_REGION_WEST_2B
	default "us-west-2d" if TERRAFORM_AWS_AV_REGION_WEST_2D

choice
	prompt "AWS AMI owner"
	default TERRAFORM_AWS_AMI_AMAZON_X86_64 if TARGET_ARCH_X86_64
	default TERRAFORM_AWS_AMI_AMAZON_ARM64 if TARGET_ARCH_ARM64

config TERRAFORM_AWS_AMI_DEBIAN
	bool "Debian"
	help
	  This option will set AWS AMI owner to Debian.

config TERRAFORM_AWS_AMI_AMAZON_X86_64
	bool "Amazon Linux 2023 x86_64 - ami-0efa651876de2a5ce"
	depends on TARGET_ARCH_X86_64 && TERRAFORM_AWS_US_WEST_2
	help
	  This option will set AWS AMI owner to Amazon EC2 images for x86_64.

config TERRAFORM_AWS_AMI_AMAZON_ARM64
	bool "Amazon Linux 2023 ARM64 - ami-0699f753302dd8b00"
	depends on TARGET_ARCH_ARM64 && TERRAFORM_AWS_US_WEST_2
	help
	  This option will set AWS AMI owner to Amazon EC2 images for arm64.

config TERRAFORM_AWS_RHEL9_X86_64
	bool "RHEL9 x86_64 - ami-0dda7e535b65b6469"
	depends on TARGET_ARCH_X86_64 && TERRAFORM_AWS_US_WEST_2
	help
	  This option will set AWS AMI owner to RHEL9 for x86_64.

config TERRAFORM_AWS_RHEL9_ARM64
	bool "RHEL9 x86_64 - ami-08911268ee09cb08e"
	depends on TARGET_ARCH_ARM64 && TERRAFORM_AWS_US_WEST_2
	help
	  This option will set AWS AMI owner to RHEL9 for ARM64

config TERRAFORM_AWS_SLE15_SP4_X86_64
	bool "SUSE Linux Enterprise Server 15 SP4 x86_64 - ami-079ba66a5e9f2b70e"
	depends on TARGET_ARCH_X86_64 && TERRAFORM_AWS_US_WEST_2
	help
	  This option will set AWS AMI owner to SLE15-SP4 for x86_64.

config TERRAFORM_AWS_SLE15_SP4_ARM64
	bool "SUSE Linux Enterprise Server 15 SP4 ARM64 - ami-00f902c807805f51a"
	depends on TARGET_ARCH_ARM64 && TERRAFORM_AWS_US_WEST_2
	help
	  This option will set AWS AMI owner to SLE15-SP4 for arm64.

endchoice

if TERRAFORM_AWS_AMI_DEBIAN

choice
	prompt "AWS debian release to use"
	default TERRAFORM_AWS_NS_DEBIAN_12_X86_64 if TARGET_ARCH_X86_64
	default TERRAFORM_AWS_NS_DEBIAN_12_ARM64 if TARGET_ARCH_ARM64

config TERRAFORM_AWS_NS_DEBIAN_12_X86_64
	bool "Debian 12 - Bookworm x86_64"
	depends on TARGET_ARCH_X86_64
	help
	  This option will set aws name search to debian-12-hvm-amd64-*
	  Note, to expand on this get the AMI owner ID and then you can
	  see what is available with something like this:

	  aws ec2 describe-images --owners 136693071363  --query 'Images[*].[Description]'

	  In theory we should be able to just automate Kconfig language then
	  for AWS for a distro using 'make dynconfig' on kdevops.

config TERRAFORM_AWS_NS_DEBIAN_12_ARM64
	bool "Debian 12 - Bookworm ARM64"
	depends on TARGET_ARCH_ARM64
	help
	  This option will set aws name search to debian-12-hvm-arm64-*

config TERRAFORM_AWS_NS_DEBIAN_11_X86_64
	bool "Debian 11 - Bullseye x86_64"
	depends on TARGET_ARCH_X86_64
	help
	  This option will set aws name search to debian-11-hvm-amd64-*

config TERRAFORM_AWS_NS_DEBIAN_11_ARM64
	bool "Debian 11 - Bullseye arm64"
	depends on TARGET_ARCH_ARM64
	help
	  This option will set aws name search to debian-11-hvm-arm64-*

config TERRAFORM_AWS_NS_DEBIAN_STRETCH_X86_64
	bool "debian-stretch-hvm-x86_64-"
	depends on TARGET_ARCH_X86_64
	help
	  This option will set aws name search to debian-stretch-hvm-x86_64-*
	  This is no longer supported by the debian community.

config TERRAFORM_AWS_NS_DEBIAN_STRETCH_ARM64
	bool "debian-stretch-hvm-arm64-"
	depends on TARGET_ARCH_ARM64
	help
	  This option will set aws name search to debian-stretch-hvm-arm64-*
	  This is no longer supported by the debian community.

endchoice

config TERRAFORM_AWS_AMI_DEBIAN_OWNER
	string
	default "136693071363" if TERRAFORM_AWS_NS_DEBIAN_12_X86_64 || TERRAFORM_AWS_NS_DEBIAN_12_ARM64
	default "136693071363" if TERRAFORM_AWS_NS_DEBIAN_11_X86_64 || TERRAFORM_AWS_NS_DEBIAN_11_ARM64
	default "379101102735" if TERRAFORM_AWS_NS_DEBIAN_STRETCH_X86_64 || TERRAFORM_AWS_NS_DEBIAN_STRETCH_ARM64

endif

config TERRAFORM_AWS_AMI_OWNER
	string
	default TERRAFORM_AWS_AMI_DEBIAN_OWNER if TERRAFORM_AWS_AMI_DEBIAN
	default "137112412989" if TERRAFORM_AWS_AMI_AMAZON_X86_64 || TERRAFORM_AWS_AMI_AMAZON_ARM64
	default "309956199498" if TERRAFORM_AWS_RHEL9_X86_64 || TERRAFORM_AWS_RHEL9_ARM64
	default "013907871322" if TERRAFORM_AWS_SLE15_SP4_X86_64 || TERRAFORM_AWS_SLE15_SP4_ARM64
	help
	  This option will set AWS AMI owner.

config TERRAFORM_AWS_NS
	string
	default "debian-12-amd64-*" if TERRAFORM_AWS_NS_DEBIAN_12_X86_64
	default "debian-12-arm64-*" if TERRAFORM_AWS_NS_DEBIAN_12_ARM64
	default "debian-11-amd64-*" if TERRAFORM_AWS_NS_DEBIAN_11_X86_64
	default "debian-11-arm64-*" if TERRAFORM_AWS_NS_DEBIAN_11_ARM64
	default "debian-stretch-hvm-x86_64-*" if TERRAFORM_AWS_NS_DEBIAN_STRETCH_X86_64
	default "debian-stretch-hvm-arm64-*" if TERRAFORM_AWS_NS_DEBIAN_STRETCH_ARM64
	default "al2023-*-x86_64" if TARGET_ARCH_X86_64 && TERRAFORM_AWS_AMI_AMAZON_X86_64
	default "al2023-*-arm64" if TARGET_ARCH_ARM64 && TERRAFORM_AWS_AMI_AMAZON_ARM64
	default "RHEL-9.*x86_64-*" if TARGET_ARCH_X86_64 && TERRAFORM_AWS_RHEL9_X86_64
	default "RHEL-9.*arm64-*" if TARGET_ARCH_ARM64 && TERRAFORM_AWS_RHEL9_ARM64
	default "suse-sles-15-sp4-*x86_64" if TARGET_ARCH_X86_64 && TERRAFORM_AWS_SLE15_SP4_X86_64
	default "suse-sles-15-sp4-*arm64" if TARGET_ARCH_ARM64 && TERRAFORM_AWS_SLE15_SP4_ARM64
	help
	  This option will set aws image search to use. Using this filter glob
	  lets us get the latest ami for this owner / release.

	  For debian updates you can use this list for AMI updates:

	  https://wiki.debian.org/Cloud/AmazonEC2Image/Stretch

	  If you want to expand on this list or just use a value yourself here
	  read:

	  https://letslearndevops.com/2018/08/23/terraform-get-latest-centos-ami/

	  To get filter values you can first setup aws cli:

	  https://docs.aws.amazon.com/cli/latest/userguide/cli-chap-configure.html#cli-quick-configuration

	  Get your image ami id, for debian 9 amd64 on the us-west1 this is
	  ami-0adbaf2e0ce044437 so you can run:

	  aws ec2 describe-images --image-ids ami-0adbaf2e0ce044437 | grep Name

	  For details:

	  https://docs.aws.amazon.com/cli/latest/reference/ec2/describe-images.html

config TERRAFORM_AWS_VIRT_TYPE
	string "AWS virt type"
	default "hvm"
	help
	  This option will set AWS virt type. It must match your your
	  preferred image filter used above for name search.

choice
	prompt "AWS instance type"
	default TERRAFORM_AWS_INSTANCE_M5AD_4XLARGE if TARGET_ARCH_X86_64
	default TERRAFORM_AWS_INSTANCE_IS4GEN_MEDIUM if TARGET_ARCH_ARM64

config TERRAFORM_AWS_INSTANCE_M5AD_4XLARGE
	bool "m5ad.4xlarge - $0.824 per Hour"
	depends on TARGET_ARCH_X86_64
	help
	  61 GiB RAM, 16 vcpus, 1 8 GiB main drive, and two additional
	  300 GiB NVMe drives.

config TERRAFORM_AWS_INSTANCE_IS4GEN_MEDIUM
	bool "is4gen.medium"
	depends on TARGET_ARCH_ARM64
	help
	  6 GiB RAM, 1vCPU, 1 x 937 GiB NVMe SSD, 25 Gbps Net, 9.6 Gbps EBS.
	  https://aws.amazon.com/ec2/instance-types/i4g/

config TERRAFORM_AWS_INSTANCE_IS4GEN_8XLARGE
	bool "is4gen.8xlarge"
	depends on TARGET_ARCH_ARM64
	help
	  192 GiB RAM, 32 vCPUs, 4 x 7500 GiB NVMe SSD, 50 Gbps Net, 19 Gbps EBS.
	  https://aws.amazon.com/ec2/instance-types/i4g/

config TERRAFORM_AWS_INSTANCE_IS4GEN_8XLARGE
	bool "is4gen.8xlarge"
	depends on TARGET_ARCH_ARM64
	help
	  192 GiB RAM, 32 vCPUs, 4 x 7500 NVMe SSD, 50 Gbps Net, 19 Gbps EBS.
	  https://aws.amazon.com/ec2/instance-types/i4g/

config TERRAFORM_AWS_INSTANCE_IM4GN_LARGE
	bool "im4gn.large"
	depends on TARGET_ARCH_ARM64
	help
	  8 GiB RAM, 2vCPUs, 1 x 937 GiB NVMe SSD, 25 Gbps Net, 9.5 Gbps EBS.
	  https://aws.amazon.com/ec2/instance-types/i4g/

config TERRAFORM_AWS_INSTANCE_IM4GN_4XLARGE
	bool "im4gn.4xlarge"
	depends on TARGET_ARCH_ARM64
	help
	  64 GiB RAM, 16 vcpus, 1 x 7500 NVMe SSD, 25 Gbps Net, 9.5 Gbps EBS.
	  https://aws.amazon.com/ec2/instance-types/i4g/

config TERRAFORM_AWS_INSTANCE_IM4GN_4XLARGE
	bool "im4gn.4xlarge"
	depends on TARGET_ARCH_ARM64
	help
	  64 GiB RAM, 16 vcpus, 1 x 7500 NVMe SSD, 25 Gbps Net, 9.5 Gbps EBS.
	  https://aws.amazon.com/ec2/instance-types/i4g/

config TERRAFORM_AWS_INSTANCE_I4I_LARGE
	bool "i4i.large"
	depends on TARGET_ARCH_X86_64
	help
	  16 GiB RAM, 2 vcpus, 1 x 468 AWS Nitro SSD, 10 Gbps Net, 10 Gbps EBS.
	  https://aws.amazon.com/ec2/instance-types/i4i/

config TERRAFORM_AWS_INSTANCE_I4I_METAL
	depends on TARGET_ARCH_X86_64
	bool "i4i.metal"
	help
	  1024 GiB RAM, 128 real cpus?, 8 x 3,750 AWS Nitro SSD,
	  75 Gbps Net, 40 Gbps EBS. The bees' knees I guess.
	  https://aws.amazon.com/ec2/instance-types/i4i/

config TERRAFORM_AWS_INSTANCE_C7A_METAL_48XL
	depends on TARGET_ARCH_X86_64 && TERRAFORM_AWS_AV_REGION_WEST_2D
	bool "c7a.metal-48xl"
	help
	  192 core, 384 GiB RAM, EBS drive.
	  https://aws.amazon.com/ec2/instance-types/c7a/

endchoice

config TERRAFORM_AWS_INSTANCE_TYPE
	string
	default "m5ad.4xlarge" if TERRAFORM_AWS_INSTANCE_M5AD_4XLARGE
	default "is4gen.medium" if TERRAFORM_AWS_INSTANCE_IS4GEN_MEDIUM
	default "is4gen.8xlarge" if TERRAFORM_AWS_INSTANCE_IS4GEN_8XLARGE
	default "im4gn.4xlarge" if TERRAFORM_AWS_INSTANCE_IM4GN_4XLARGE
	default "is4gen.8xlarge" if TERRAFORM_AWS_INSTANCE_IS4GEN_8XLARGE
	default "im4gn.large" if TERRAFORM_AWS_INSTANCE_IM4GN_LARGE
	default "im4gn.4xlarge" if TERRAFORM_AWS_INSTANCE_IM4GN_4XLARGE
	default "im4gn.4xlarge" if TERRAFORM_AWS_INSTANCE_IM4GN_4XLARGE
	default "i4i.large" if TERRAFORM_AWS_INSTANCE_I4I_LARGE
	default "i4i.metal" if TERRAFORM_AWS_INSTANCE_I4I_METAL
	default "c7a.metal-48xl" if TERRAFORM_AWS_INSTANCE_C7A_METAL_48XL
	help
	  This sets the aws instance type. There are many options, so go
	  read this if you want to expand on this list or just set the value
	  here:

	  https://aws.amazon.com/ec2/instance-types/

	  The AWS free trial limits you to 750 hours of only t2.micro.

config TERRAFORM_AWS_ENABLE_EBS_VOLUMES
	bool "Enable EBS volumes"
	help
	  Enable this to enable EBS volumes.

if TERRAFORM_AWS_ENABLE_EBS_VOLUMES

choice
	prompt "Number of EBS volumes"
	default TERRAFORM_AWS_EBS_NUM_VOLUMES_PER_INSTANCE_4

config TERRAFORM_AWS_EBS_NUM_VOLUMES_PER_INSTANCE_1
	bool "1"
	help
	  Use 1 EBS volumes on instances.

config TERRAFORM_AWS_EBS_NUM_VOLUMES_PER_INSTANCE_2
	bool "2"
	help
	  Use 2 EBS volumes on instances.

config TERRAFORM_AWS_EBS_NUM_VOLUMES_PER_INSTANCE_3
	bool "3"
	help
	  Use 3 EBS volumes on instances.

config TERRAFORM_AWS_EBS_NUM_VOLUMES_PER_INSTANCE_4
	bool "4"
	help
	  Use 4 volumes on instances.

config TERRAFORM_AWS_EBS_NUM_VOLUMES_PER_INSTANCE_5
	bool "5"
	help
	  Use 5 volumes on instances.

config TERRAFORM_AWS_EBS_NUM_VOLUMES_PER_INSTANCE_6
	bool "6"
	help
	  Use 6 volumes on instances.

config TERRAFORM_AWS_EBS_NUM_VOLUMES_PER_INSTANCE_7
	bool "7"
	help
	  Use 7 volumes on instances.

config TERRAFORM_AWS_EBS_NUM_VOLUMES_PER_INSTANCE_8
	bool "8"
	help
	  Use 8 EBS volumes on instances.

config TERRAFORM_AWS_EBS_NUM_VOLUMES_PER_INSTANCE_9
	bool "9"
	help
	  Use 9 EBS volumes on instances.

config TERRAFORM_AWS_EBS_NUM_VOLUMES_PER_INSTANCE_10
	bool "10"
	help
	  Use 10 EBS volumes on instances.

endchoice

config TERRAFORM_AWS_EBS_NUM_VOLUMES_PER_INSTANCE
	int
	default 1 if TERRAFORM_AWS_EBS_NUM_VOLUMES_PER_INSTANCE_1
	default 2 if TERRAFORM_AWS_EBS_NUM_VOLUMES_PER_INSTANCE_2
	default 3 if TERRAFORM_AWS_EBS_NUM_VOLUMES_PER_INSTANCE_3
	default 4 if TERRAFORM_AWS_EBS_NUM_VOLUMES_PER_INSTANCE_4
	default 5 if TERRAFORM_AWS_EBS_NUM_VOLUMES_PER_INSTANCE_5
	default 6 if TERRAFORM_AWS_EBS_NUM_VOLUMES_PER_INSTANCE_6
	default 7 if TERRAFORM_AWS_EBS_NUM_VOLUMES_PER_INSTANCE_7
	default 8 if TERRAFORM_AWS_EBS_NUM_VOLUMES_PER_INSTANCE_8
	default 9 if TERRAFORM_AWS_EBS_NUM_VOLUMES_PER_INSTANCE_9
	default 10 if TERRAFORM_AWS_EBS_NUM_VOLUMES_PER_INSTANCE_10

choice
	prompt "Volume size to for all EBS volumes"
	default TERRAFORM_AWS_EBS_VOLUME_SIZE_32G

config TERRAFORM_AWS_EBS_VOLUME_SIZE_2G
	bool "2G"
	help
	  Use 2 GiB EBS volumes.

config TERRAFORM_AWS_EBS_VOLUME_SIZE_4G
	bool "4G"
	help
	  Use 4 GiB EBS volumes.

config TERRAFORM_AWS_EBS_VOLUME_SIZE_8G
	bool "8G"
	help
	  Use 8 GiB EBS volumes.

config TERRAFORM_AWS_EBS_VOLUME_SIZE_16G
	bool "16G"
	help
	  Use 16 GiB EBS volumes.

config TERRAFORM_AWS_EBS_VOLUME_SIZE_32G
	bool "32G"
	help
	  Use 32 GiB EBS volumes.

config TERRAFORM_AWS_EBS_VOLUME_SIZE_64G
	bool "64G"
	help
	  Use 64 GiB EBS volumes.

config TERRAFORM_AWS_EBS_VOLUME_SIZE_128G
	bool "128G"
	help
	  Use 128 GiB EBS volumes.

config TERRAFORM_AWS_EBS_VOLUME_SIZE_256G
	bool "256G"
	help
	  Use 256 GiB EBS volumes.

config TERRAFORM_AWS_EBS_VOLUME_SIZE_512G
	bool "512G"
	help
	  Use 512 GiB EBS volumes.

config TERRAFORM_AWS_EBS_VOLUME_SIZE_1024G
	bool "1024G"
	help
	  Use 1024 GiB EBS volumes.

config TERRAFORM_AWS_EBS_VOLUME_SIZE_2048G
	bool "2048G"
	help
	  Use 2048 GiB EBS volumes.

config TERRAFORM_AWS_EBS_VOLUME_SIZE_3078G
	bool "3078G"
	help
	  Use 3078 GiB EBS volumes.

config TERRAFORM_AWS_EBS_VOLUME_SIZE_4096G
	bool "4096G"
	help
	  Use 4096 GiB EBS volumes.

endchoice

config TERRAFORM_TERRAFORM_AWS_EBS_VOLUME_SIZE
	int
	default 2 if TERRAFORM_AWS_EBS_VOLUME_SIZE_2G
	default 4 if TERRAFORM_AWS_EBS_VOLUME_SIZE_4G
	default 8 if TERRAFORM_AWS_EBS_VOLUME_SIZE_8G
	default 16 if TERRAFORM_AWS_EBS_VOLUME_SIZE_16G
	default 32 if TERRAFORM_AWS_EBS_VOLUME_SIZE_32G
	default 64 if TERRAFORM_AWS_EBS_VOLUME_SIZE_64G
	default 128 if TERRAFORM_AWS_EBS_VOLUME_SIZE_128G
	default 256 if TERRAFORM_AWS_EBS_VOLUME_SIZE_255G
	default 512 if TERRAFORM_AWS_EBS_VOLUME_SIZE_512G
	default 1024 if TERRAFORM_AWS_EBS_VOLUME_SIZE_1024G
	default 2048 if TERRAFORM_AWS_EBS_VOLUME_SIZE_2048G
	default 3078 if TERRAFORM_AWS_EBS_VOLUME_SIZE_3078G
	default 4096 if TERRAFORM_AWS_EBS_VOLUME_SIZE_4096G

endif # TERRAFORM_AWS_ENABLE_EBS_VOLUMES

endif # TERRAFORM_AWS
```
