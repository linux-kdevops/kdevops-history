## kconfigs/workflows/Kconfig.data_partition
```kconfig
config WORKFLOW_DATA_DEVICE
	string "The device to use to create the workflow data parition"
	default "/dev/nvme0n1" if VAGRANT
	default "/dev/nvme1n1" if TERRAFORM_AWS_INSTANCE_M5AD_4XLARGE
	default "/dev/nvme0n1" if TERRAFORM_GCE
	default "/dev/sdc" if TERRAFORM_AZURE
	default TERRAFORM_OCI_DATA_VOLUME_DEVICE_FILE_NAME if TERRAFORM_OCI
	help
	  Workflows require data to be passed onto each target host. When doing
	  development or testing on target workflows you often want to keep
	  around the data so you can reinstall the OS on a target host without
	  loosing your workflow data. To help with this, workflow data is
	  stored in a parition specifally designed to outlive the Operating
	  System install. This lets you easily re-OS a system and keep the
	  data workflow around.

	  This options lets you specify the device name to use to create the
	  workflow data partition used. The type of data placed on this
	  partition conists of git trees cloned, for example the Linux kernel
	  sources if you are developing on Linux, or the fstests git tree if
	  you are testing fstests. Additionally configuration data used for
	  your target workflows.

config WORKFLOW_DATA_PATH
	string "Directory path to place data for workflows"
	default "/data"
	help
	  The data workflow is kept then in a location other than your default
	  user home directory. Use this option to specify the path which we
	  will use to place your workflow data. This will be the mount point
	  for the new worfklow data partition created.

config WORKFLOW_INFER_USER_AND_GROUP
	bool "Infer user and group to use for the workflow data partition"
	default y
	help
	  We place all target workflow data on a partition we create. We
	  typically set the username and group ownership of that partition
	  based on passed manual settings. Providing a good guess as defaults
	  through kconfig about what the target user and group should be for the
	  data partition for systems created with vagrant is easy, but this is
	  not as easy when users are using terraform or bare metal. Instead of
	  extending the possible sensible defaults for the target username and
	  group to use for the data partition based the mechanism used for
	  bringup or Linux distribution chosen, we also provide support to infer
	  your target username and group settings based on the login user on the
	  target system.

	  You can safely enable this feature so we can do this inference. This
	  helps not have to extend our defaults for a manual settings when
	  users are using terraform.

if !WORKFLOW_INFER_USER_AND_GROUP

config WORKFLOW_DATA_USER
	string "The username to use to chown on the target data workflow directory"
	default "vagrant" if VAGRANT
	default TERRAFORM_SSH_CONFIG_USER if TERRAFORM
	help
	  Manual setting for the username to chown the data workflow path.

config WORKFLOW_DATA_GROUP
	string "The group to use to chown on the target data workflow directory"
	default "vagrant" if VAGRANT
	default TERRAFORM_SSH_CONFIG_USER if TERRAFORM_AWS_AMI_DEBIAN || TERRAFORM_AZURE_IMAGE_PUBLISHER_DEBIAN
	default "users" if !TERRAFORM_AWS_AMI_DEBIAN && !TERRAFORM_AZURE_IMAGE_PUBLISHER_DEBIAN
	default "root" if !VAGRANT && !TERRAFORM_AWS_AMI_DEBIAN && !TERRAFORM_AZURE_IMAGE_PUBLISHER_DEBIAN
	help
	  Manual setting for the group to chgrp the data workflow path.

	  We default to "vagrant" if you are using vagrant, otherwise we rely
	  on the the assumption your distribution has the "users" group created
	  for distributions where we are certain of that. If on debian based
	  systems we assume the same group exists with the username you used
	  to log in.

	  This mechanism if not ideal for supporting all systems and so simply
	  user the workflow user and group inference mechansim to support more
	  distributions or images, and don't extend the defaults we provide for
	  WORKFLOW_DATA_USER and WORKLOAD_DATA_GROUP.

endif # WORKFLOW_INFER_USER_AND_GROUP

choice
	prompt "Filesystem for the workflow data partition"
	default WORKFLOW_DATA_FSTYPE_BTRFS

config WORKFLOW_DATA_FSTYPE_XFS
	bool "xfs"
	help
	  Use the xfs filesystem.

config WORKFLOW_DATA_FSTYPE_EXT4
	bool "ext4"
	help
	  Use the ext4 filesystem.

config WORKFLOW_DATA_FSTYPE_BTRFS
	bool "btrfs"
	help
	  Use the btrfs filesystem.

endchoice

config WORKFLOW_DATA_FSTYPE
	string "The filesystem target to use"
	default "xfs" if WORKFLOW_DATA_FSTYPE_XFS
	default "ext4" if WORKFLOW_DATA_FSTYPE_EXT4
	default "btrfs" if WORKFLOW_DATA_FSTYPE_BTRFS
	help
	  The filesystem to use for the workflow data partition.

config WORKFLOW_DATA_LABEL
	string "The filesystem label to use"
	default "data"
	help
	  The filesystem label to create and later use to mount the partition on
	  the /etc/fstab file for the workflow data partition. Since the target
	  device used to create the parition can vary system to system we use a
	  label to ensure we find the partition.
```

## kconfigs/workflows/Kconfig.shared
```kconfig
menu "Shared workflow data partition"
source "kconfigs/workflows/Kconfig.data_partition"
endmenu

menu "Shared workflow software"
source "kconfigs/workflows/Kconfig.shared_software"
endmenu

config HAVE_CUSTOM_KDEVOPS_GIT
	bool
	default n

config HAVE_CUSTOM_KDEVOPS_GIT_DATA
	bool
	default n

config HAVE_CUSTOM_KDEVOPS_DIR
	bool
	default n

config WORKFLOW_MAKE_CMD_OVERRIDE
	bool "Override default make command"
	default n
	help
	  We support different workflows which use the make command to build
	  source code on the target systems. You can override here the default
	  make command used to build on the target systems. By default we use:

	    {{ make }} -j{{ ansible_processor_vcpus }}

	  However this is known to not work as expected with containers.
	  The fix is in commit 34db57a47f875d11c4068567b9ec7ace174ec4cf
	  ("introduce fact "ansible_processor_nproc": number of usable
	  vcpus #66569") but it will be a while before we see this propagate.
	  This will be needed for containers. In the meantime you can
	  override the make command with this option.

if WORKFLOW_MAKE_CMD_OVERRIDE

config WORKFLOW_MAKE_CMD
	string "The make command to use when building"
	default "make -j 16" if TERRAFORM_AWS_INSTANCE_M5AD_4XLARGE
	default "make -j 1" if TERRAFORM_AZURE_VM_SIZE_STANDARD_DS1_V2
	default "make -j 4" if TERRAFORM_AZURE_VM_SIZE_STANDARD_DS3_V2
	default "make -j 8" if VAGRANT
	help
	  The actual make command to use when building Linux. You want to
	  optimize this as per the number of cores you have.

endif

config WORKFLOW_KDEVOPS_GIT
	string "Git tree of kdevops to clone on targets"
	default "https://github.com/mcgrof/kdevops.git" if !HAVE_CUSTOM_KDEVOPS_GIT
	default CUSTOM_KDEVOPS_GIT if HAVE_CUSTOM_KDEVOPS_GIT
	help
	  Some workflows want to also clone a version of kdevops on each target.
	  An example of this is when using the fstests workflow, which carries
	  a set of expunge lists to track known failures. Upon new failures the
	  local expunge list grows, and so a 'git diff' against the kdevops git
	  tree will reveal if there are any regressions against the known
	  baseline.

config WORKFLOW_KDEVOPS_GIT_DATA
	string "The destination directory where to clone the git tree"
	default "{{data_path}}/kdevops" if !HAVE_CUSTOM_KDEVOPS_GIT_DATA
	default CUSTOM_KDEVOPS_GIT_DATA if HAVE_CUSTOM_KDEVOPS_GIT_DATA
	help
	  This is the target location of where to clone the above git tree.
	  Note that {{data_path}} corresponds to the location set by the
	  configuration option CONFIG_WORKFLOW_DATA_PATH above.

config WORKFLOW_KDEVOPS_DIR
	string
	default WORKFLOW_KDEVOPS_GIT_DATA if !HAVE_CUSTOM_KDEVOPS_DIR
	default CUSTOM_KDEVOPS_DIR if HAVE_CUSTOM_KDEVOPS_DIR

config WORKFLOW_KOTD_ENABLE
	bool "Enable KOTD - Kernel of the day reving"
	depends on WORKFLOW_LINUX_DISTRO
	default n
	help
	  When doing target testing on a Linux distribution it is often useful
	  to be able to update the distribution kernel to the latest available
	  version for a release. This may be as simple as an update of a package
	  however distributions may also have special repositories designed to
	  be updated more regularly than the general release repository.
	  Enabling this option will add such kotd repository if the distribution
	  had one, and as a last step will try to install the very latest kernel
	  available for the distribution.

	  This may be useful in combination of using a kdevops kernel-ci loop:
	  once steady state has been achieved one can simply update the kernel
	  and re-run the kernel-ci loop to ensure no regressions have been
	  found on the latest kernel.

config HAVE_DISTRO_CUSTOM_KOTD_REPO
	bool
	default n

config CUSTOM_DISTRO_KOTD_REPO
	string "Distribution KOTD repository"
	depends on WORKFLOW_KOTD_ENABLE
	depends on HAVE_DISTRO_CUSTOM_KOTD_REPO
	default VAGRANT_SUSE_KOTD_REPO if VAGRANT_SUSE

config CUSTOM_DISTRO_KOTD_REPO_NAME
	string "Distribution KOTD repository name"
	depends on HAVE_DISTRO_CUSTOM_KOTD_REPO
	default VAGRANT_SUSE_KOTD_REPO_NAME if VAGRANT_SUSE
```

## kconfigs/workflows/Kconfig.shared_software
```kconfig
config WORKFLOW_EXTRA_SOFTWARE
	bool "Allow the installation and configuration of additional software"
	default n if VAGRANT_DEBIAN
	default y if !VAGRANT_DEBIAN
	help
	  Enabling this option will allow you to install and configure extra
	  software on the target system which may be useful for a slew of
	  different workflows. These are typical software which you typically
	  end up having to install for one reason or another for different
	  types of workflows.

	  For instance, you may want to install and configure postfix so that
	  a target system may send emails to you if an issue is found.

if WORKFLOW_EXTRA_SOFTWARE

config WORKFLOW_EXTRA_SOFTWARE_POSTFIX
	bool "Install and configure postfix"
	default y
	help
	  Enabling this option will install and configure postfix on the
	  targets systems. We'll also install mailx to allow users to easily
	  test if postfix settings are set up correctly.

config WORKFLOW_EXTRA_SOFTWARE_WATCHDOG
	bool "Install watchhdog"
	default y
	help
	  Enabling this option will install a watchdog, and allow you to
	  configure it. This is useful if you want to have triggers of things
	  to do if the system is no longer reachable, for instance, it crashed.

endif # WORKFLOW_EXTRA_SOFTWARE
```
