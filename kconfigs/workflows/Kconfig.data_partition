## kconfigs/workflows/bootlinux/Kconfig
```kconfig
if BOOTLINUX

config BOOTLINUX_9P
	bool "Use 9p to build Linux"
	depends on VAGRANT_LIBVIRT
	depends on LIBVIRT_MACHINE_TYPE_Q35
	default LIBVIRT_MACHINE_TYPE_Q35
	help
	  This will let you choose use 9p to build Linux. What this does is
	  use your localhost to git clone Linux under the assumption your
	  host is more powerful than the guests you are going to instantiate.
	  The localhost then will be used to build Linux using all threads
	  possible. The installation of Linux on the guest is done only with
	  the install target, the guest gets read-only access to the host's
	  path where Linux is closed using 9p.

	  You should not have to modify any default 9p settings except maybe
	  where your localhost path for your git tree is. You should keep
	  the other settings as-is unless you know what you are doing.

if BOOTLINUX_9P

menu "Modify default 9p configuration"
config BOOTLINUX_9P_HOST_PATH
	string "9p host path"
	default $(shell, echo $PWD/linux)
	help
	  This sets the 9p host path that will be used. This is the path
	  that has your or we'll clone the respective linux git tree.
	  If you have no git tree present there we'll git clone Linux there
	  for you. Otherwise we'll just reset the tree for you and build Linux
	  there for you. We build Linux only once.

config BOOTLINUX_9P_MSIZE
	int "9p msize"
	default 131072
	help
	  This sets the msize value. Prior to v5.15 this was set to 8 KiB as
	  default, however this is reported to have produced pretty terrible
	  performance, and so this was bumped 128 KiB as default after v5.15.
	  The qemu wiki [0] seems to suggest to use a range between 10-100 MiB
	  for SATA and howver that is a lie as 500 KiB (512000) is the maximum
	  value possible. Also, using the max value possible I get a different
	  value for sha1sum on files! So let's just stick to the default
	  of 128 KiB (131072). If you are going to update the default value
	  for msize on kdevops please make sure you test this and it works.

	  [0] https://wiki.qemu.org/Documentation/9psetup

config BOOTLINUX_9P_FSDEV
	string "9p fsdev"
	default "kdevops_9p_fsdev"
	help
	  This sets the 9p fsdev ID. This is used by libvirt if that is enabled,
	  and then by the respective mount command.

config BOOTLINUX_9P_SECURITY_MODEL
	string "9p security model"
	default "none"
	help
	  The security model to use.

config BOOTLINUX_9P_DRIVER
	string "9p driver to use"
	default "virtio-9p-pci"
	help
	  The security model to use.

config BOOTLINUX_9P_MOUNT_TAG
	string "9p mount tag"
	default "kdevops_9p_bootlinux"
	help
	  This sets the 9p mount tag to use.

endmenu

endif # BOOTLINUX_9P


choice
	prompt "Type of development version of Linux to use"
	default BOOTLINUX_DEV

config BOOTLINUX_STABLE
	bool "Stable Linux releases"
	help
	  This will let you choose from stable Linux trees only.

config BOOTLINUX_DEV
	bool "Development Linux releases"
	help
	  This will let you choose from development Linux trees only.

endchoice

source "kconfigs/workflows/bootlinux/Kconfig.stable"
source "kconfigs/workflows/bootlinux/Kconfig.dev"

config BOOTLINUX_TREE_NAME
	string "Linux tree name"
	default "linux" if BOOTLINUX_TREE_LINUS
	default "linux-stable" if BOOTLINUX_TREE_STABLE
	default "linux-next" if BOOTLINUX_TREE_NEXT
	default "btrfs-devel" if BOOTLINUX_TREE_BTRFS_DEVEL
	default "mcgrof-next" if BOOTLINUX_TREE_MCGROF_NEXT

config BOOTLINUX_TREE
	string "Linux git tree URL"
	default "https://git.kernel.org/pub/scm/linux/kernel/git/torvalds/linux.git" if BOOTLINUX_TREE_LINUS && !USE_LOCAL_LINUX_MIRROR
	default "https://git.kernel.org/pub/scm/linux/kernel/git/stable/linux.git" if BOOTLINUX_TREE_STABLE && !USE_LOCAL_LINUX_MIRROR
	default "https://git.kernel.org/pub/scm/linux/kernel/git/next/linux-next.git" if BOOTLINUX_TREE_NEXT && !USE_LOCAL_LINUX_MIRROR
	default "git://192.168.124.1/mirror/linux.git" if BOOTLINUX_TREE_LINUS && USE_VAGRANT_LIBVIRT_MIRROR && !BOOTLINUX_9P
	default "git://192.168.124.1/mirror/linux-stable.git" if BOOTLINUX_TREE_STABLE && USE_VAGRANT_LIBVIRT_MIRROR && !BOOTLINUX_9P
	default "git://192.168.124.1/mirror/linux-next.git" if BOOTLINUX_TREE_NEXT && USE_VAGRANT_LIBVIRT_MIRROR && !BOOTLINUX_9P
	default "/mirror/linux.git" if BOOTLINUX_TREE_LINUS && USE_VAGRANT_LIBVIRT_MIRROR && BOOTLINUX_9P
	default "/mirror/linux-stable.git" if BOOTLINUX_TREE_STABLE && USE_VAGRANT_LIBVIRT_MIRROR && BOOTLINUX_9P
	default "/mirror/linux-next.git" if BOOTLINUX_TREE_NEXT && USE_VAGRANT_LIBVIRT_MIRROR && BOOTLINUX_9P
	default "https://github.com/kdave/btrfs-devel.git" if BOOTLINUX_TREE_BTRFS_DEVEL
	default "https://git.kernel.org/pub/scm/linux/kernel/git/mcgrof/linux-next.git" if BOOTLINUX_TREE_MCGROF_NEXT
	help
	  The Linux git tree to use.

config BOOTLINUX_TEST_MESSAGE_ID
	bool "Test mailing list message ID"
	default n
	depends on KDEVOPS_BASELINE_AND_DEV
	select BOOTLINUX_TEST_MESSAGE_ID_INSTALL_B4 if BOOTLINUX_TEST_MESSAGE_ID
	help
	  When enabled, the b4 command from public-inbox will rebase the patches
	  contained in the message-id on top of a baseline kernel and install it
	  in the development box. A baseline kernel without the patches will be
	  installed in the baseline box. The effects of the patch on the tests
	  can then be seen as the difference between the baseline and development
	  test runs.

config BOOTLINUX_TEST_MESSAGE_ID_THREAD_ID
	string "The message ID"
	default ""
	depends on BOOTLINUX_TEST_MESSAGE_ID
	help
	  The message id that will be rebased on top of the baseline kernel in
	  the development box.

config BOOTLINUX_TEST_MESSAGE_ID_INSTALL_B4
	bool
	default n
	depends on BOOTLINUX_TEST_MESSAGE_ID
	prompt "Install b4 on development system" if BOOTLINUX_TEST_MESSAGE_ID
	help
	  When enabled, b4 will be installed using pip

config BOOTLINUX_TREE_TAG
	string "Git tree branch / tag / sha1sum to use"
	default "v4.19" if BOOTLINUX_TREE_LINUS
	default "v4.19.133" if BOOTLINUX_STABLE_V419
	default "v5.4.210" if BOOTLINUX_STABLE_V54
	default "v5.10.105" if BOOTLINUX_STABLE_V510
	default "v5.14.4" if BOOTLINUX_STABLE_V514
	default "v5.17-rc7" if BOOTLINUX_STABLE_V517
	default "v5.19-rc4" if BOOTLINUX_STABLE_V519
	default "v6.0.9" if BOOTLINUX_STABLE_V60
	default "linux-6.1.y" if BOOTLINUX_STABLE_V61
	default "next-20230421" if BOOTLINUX_TREE_NEXT
	default "for-next" if BOOTLINUX_TREE_BTRFS_DEVEL
	default "large-block-20230421" if BOOTLINUX_TREE_MCGROF_NEXT
	help
	  The git branch / tag or sha1sum to use.

config BOOTLINUX_TREE_LOCALVERSION
	string "Linux local version to use"
	help
	  The Linux local version to use (for uname).

config BOOTLINUX_SHALLOW_CLONE
	bool "Shallow git clone"
	default n
	help
	  If enabled the git tree cloned with be cloned using a shallow tree
	  with history truncated. You want to enable this if you really don't
	  care about the git history on the targets which will clone Linux.
	  Using a full shallow tree will save you about 5 minutes in time.
	  You want to say no here (the default) if you are using the targets
	  for actual kernel development. You want to enable this if you are
	  just using the targets as dummy target runners and don't expect to
	  be using 'git log' on the target guests.

config BOOTLINUX_SHALLOW_CLONE_DEPTH
	int "Shallow git clone depth"
	default 1
	depends on BOOTLINUX_SHALLOW_CLONE
	help
	  Create a shallow clone with a history truncated to the specified
	  number or revisions. The minimum possible value is 1, otherwise
	  ignored. Needs git>=1.9.1 to work correctly.

endif # BOOTLINUX
```

## kconfigs/workflows/bootlinux/Kconfig.dev
```kconfig
if BOOTLINUX_DEV

choice
	prompt "Linux development tree to use"
	default BOOTLINUX_TREE_NEXT if !QEMU_ENABLE_EXTRA_DRIVE_LARGEIO
	default BOOTLINUX_TREE_MCGROF_NEXT if QEMU_ENABLE_EXTRA_DRIVE_LARGEIO

config BOOTLINUX_TREE_NEXT
	bool "linux-next"
	help
	  Use the linux-next tree.

config BOOTLINUX_TREE_BTRFS_DEVEL
	bool "btrfs-devel"
	help
	  Use the btrfs-devel tree.

config BOOTLINUX_TREE_MCGROF_NEXT
	bool "mcgrof-next"
	help
	  Use the mcgrof's linux-next tree.

endchoice

endif # BOOTLINUX_DEV
```

## kconfigs/workflows/bootlinux/Kconfig.mcgrof
```kconfig
if BOOTLINUX_TREE_MCGROF_NEXT

choice
	prompt "mcgrof-next branch to use"
	default BOOTLINUX_MCGROF_NEXT_LBS

config BOOTLINUX_MCGROF_NEXT_LBS
	bool "large-block-next"
	help
	  Use the latest stable LBS branch which enables all the bells and
	  whistles for all types of LBS devices.

config BOOTLINUX_MCGROF_NEXT_LBS_NOBDEV
	bool "large-block-nobdev"
	help
	  Use the latest minimal branch for LBS which let's you use LBS
	  devices with a sectorsize compatibility.

endchoice

endif # BOOTLINUX_TREE_MCGROF_NEXT
```

## kconfigs/workflows/bootlinux/Kconfig.stable
```kconfig
if BOOTLINUX_STABLE

choice
	prompt "Linux stable tree to use"
	default BOOTLINUX_TREE_STABLE

config BOOTLINUX_TREE_LINUS
	bool "linux"
	help
	  Use Linus Torvald's linux tree.

config BOOTLINUX_TREE_STABLE
	bool "linux-stable"
	help
	  Use the linux-stable tree.

endchoice

if BOOTLINUX_TREE_STABLE

choice
	prompt "Stable branch to use"
	default BOOTLINUX_STABLE_V60

config BOOTLINUX_STABLE_V419
	bool "linux-4.19.y"
	help
	  Automatically enable the latest supported linux-4.19.y kernel.

config BOOTLINUX_STABLE_V54
	bool "linux-5.4.y"
	help
	  Automatically enable the latest supported linux-5.4.y kernel.

config BOOTLINUX_STABLE_V510
	bool "linux-5.10.y"
	help
	  Automatically enable the latest supported linux-5.10.y kernel.

config BOOTLINUX_STABLE_V514
	bool "linux-5.14.y"
	help
	  Automatically enable the latest supported linux-5.14.y kernel.

config BOOTLINUX_STABLE_V517
	bool "linux-5.17.y"
	help
	  Automatically enable the latest supported linux-5.17.y kernel.

config BOOTLINUX_STABLE_V519
	bool "linux-5.19.y"
	help
	  Automatically enable the latest supported linux-5.19.y kernel.

config BOOTLINUX_STABLE_V60
	bool "linux-6.0.y"
	help
	  Automatically enable the latest supported linux-6.0.y kernel.

endchoice

endif # BOOTLINUX_TREE_STABLE

endif # BOOTLINUX_STABLE
```
