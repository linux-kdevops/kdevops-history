## vagrant/Kconfig
```kconfig
if VAGRANT
choice
	prompt "Vagrant virtualization technology to use"
	default VAGRANT_LIBVIRT_SELECT

config VAGRANT_LIBVIRT_SELECT
	bool "Libvirt"
	help
	  Select this option if you want to use KVM / libvirt for
	  local virtualization.

config VAGRANT_VIRTUALBOX
	bool "Virtualbox"
	select EXTRA_STORAGE_SUPPORTS_512
	select EXTRA_STORAGE_SUPPORTS_1K
	select EXTRA_STORAGE_SUPPORTS_2K
	select EXTRA_STORAGE_SUPPORTS_4K
	help
	  Select this option if you want to use VirtualBox for
	  local virtualization.

endchoice

if VAGRANT_VIRTUALBOX

choice
	prompt "VirtualBox storage pool path"
	default VIRTUALBOX_STORAGE_POOL_PATH_CUSTOM_MANUAL if !DISTRO_SUSE
	default VIRTUALBOX_STORAGE_POOL_PATH_CUSTOM_CWD if DISTRO_SUSE

config VIRTUALBOX_STORAGE_POOL_PATH_CUSTOM_CWD
	bool "Use the current vagrant working directory"
	help
	  Select this option if you want to use the vagrant directory inside
	  where you git cloned kdevops as the Vagrant storage pool path where
	  additional NVMe drives will be created. As it is today it
	  would seem only fedora restricts the $HOME to g-rwx o-rwx and so
	  by default this option won't work on Fedora by default. This used
	  to be the old default on kdevops but because of this it should not
	  be used by default. Distributions still relying on this should
	  verify they can change this default.

config VIRTUALBOX_STORAGE_POOL_PATH_CUSTOM_MANUAL
	bool "Custom manual path"
	help
	  Select this option if you want to manually specify where to use as
	  the directory where we'll have kdevops create additional NVMe drives
	  for VirtualBox to use. This is today's default given otherwise
	  we may have to muck with the $HOME directory permissions.

endchoice

config VIRTUALBOX_STORAGE_POOL_PATH_CUSTOM
	string "VirtualBox storage pool path"
	default $(shell, scripts/cwd-append.sh vagrant) if VIRTUALBOX_STORAGE_POOL_PATH_CUSTOM_CWD
	default "/opt/virtualbox/storage/" if VIRTUALBOX_STORAGE_POOL_PATH_CUSTOM_MANUAL
	help
	  The path to use for creating additional NVMe drives used by
	  VirtualBox. kdevops adds a postfix "kdevops" to this directory as it
	  wants to allow Vagrant full control over that directory. For instance
	  if this is /opt/virtualbox/storage/ kdevops will have VirtualBox
	  create the NVMe files under the directory
	  /opt/virtualbox/storage/kdevops/.vagrant/nvme_disks/guest-hostname/.

choice
	prompt "VirtualBox extra drive format"
	default VIRTUALBOX_EXTRA_DRIVE_VDI

config VIRTUALBOX_EXTRA_DRIVE_VDI
	bool "vdi"
	help
	  Select this option if you want to use the vdi format.

config VIRTUALBOX_EXTRA_DRIVE_VMDK
	bool "vmdk"
	help
	  Select this option if you want to use the vmdk format.

config VIRTUALBOX_EXTRA_DRIVE_VHD
	bool "vhd"
	help
	  Select this option if you want to use the vhd format.

endchoice

config VIRTUALBOX_EXTRA_DRIVE_FORMAT
	string
	default "vdi" if VIRTUALBOX_EXTRA_DRIVE_VDI
	default "vmdk" if VIRTUALBOX_EXTRA_DRIVE_VMDK
	default "vhd" if VIRTUALBOX_EXTRA_DRIVE_VHD

endif

config HAVE_SUSE_VAGRANT
	bool
	default $(shell, scripts/check_distro_kconfig.sh suse)

choice
	prompt "Vagrant guest Linux distribution to use"
	default VAGRANT_DEBIAN if !HAVE_SUSE_VAGRANT
	default VAGRANT_SUSE if HAVE_SUSE_VAGRANT

config VAGRANT_DEBIAN
	bool "Debian"
	select HAVE_CUSTOM_DISTRO_HOST_PREFIX
	select HAVE_DISTRO_XFS_PREFERS_MANUAL if FSTESTS_XFS
	select HAVE_DISTRO_BTRFS_PREFERS_MANUAL if FSTESTS_BTRFS
	select HAVE_DISTRO_EXT4_PREFERS_MANUAL if FSTESTS_EXT4
	select HAVE_DISTRO_PREFERS_CUSTOM_HOST_PREFIX
	select HAVE_DISTRO_PREFERS_FSTESTS_WATCHDOG if KDEVOPS_WORKFLOW_ENABLE_FSTESTS
	select HAVE_DISTRO_PREFERS_FSTESTS_WATCHDOG_KILL if KDEVOPS_WORKFLOW_ENABLE_FSTESTS
	help
	  This option will set the target guest to Debian.

config VAGRANT_OPENSUSE
	bool "OpenSUSE"
	select HAVE_CUSTOM_DISTRO_HOST_PREFIX
	select HAVE_DISTRO_XFS_PREFERS_MANUAL if FSTESTS_XFS
	select HAVE_DISTRO_BTRFS_PREFERS_MANUAL if FSTESTS_BTRFS
	select HAVE_DISTRO_EXT4_PREFERS_MANUAL if FSTESTS_EXT4
	select HAVE_DISTRO_BLKTESTS_PREFERS_MANUAL if KDEVOPS_WORKFLOW_ENABLE_BLKTESTS
	select HAVE_DISTRO_PREFERS_CUSTOM_HOST_PREFIX
	select HAVE_DISTRO_PREFERS_FSTESTS_WATCHDOG if KDEVOPS_WORKFLOW_ENABLE_FSTESTS
	select HAVE_DISTRO_PREFERS_FSTESTS_WATCHDOG_KILL if KDEVOPS_WORKFLOW_ENABLE_FSTESTS
	help
	  This option will set the target guest to OpenSUSE.

config VAGRANT_SUSE
	bool "SUSE"
	depends on HAVE_SUSE_VAGRANT
	select HAVE_KDEVOPS_CUSTOM_DEFAULTS
	select HAVE_CUSTOM_DISTRO_HOST_PREFIX
	select HAVE_DISTRO_PREFERS_CUSTOM_HOST_PREFIX
	select HAVE_DISTRO_XFS_PREFERS_MANUAL if FSTESTS_XFS
	select HAVE_DISTRO_BTRFS_PREFERS_MANUAL if FSTESTS_BTRFS
	select HAVE_DISTRO_BLKTESTS_PREFERS_MANUAL if KDEVOPS_WORKFLOW_ENABLE_BLKTESTS
	select HAVE_DISTRO_SUSE
	select HAVE_DISTRO_PREFERS_REGISTRATION
	select HAVE_DISTRO_REG_METHOD_TWOLINE
	select VAGRANT_INSTALL_PRIVATE_BOXES
	select HAVE_CUSTOM_KDEVOPS_GIT
	select HAVE_CUSTOM_KDEVOPS_GIT_DATA
	select HAVE_CUSTOM_KDEVOPS_DIR
	help
	  This option will set the target guest to SUSE. There is currently
	  no scriptable way to download Vagrant images, however the images
	  are available for download via:

	    https://suse.com/download

config VAGRANT_FEDORA
	bool "Fedora (or derived distro)"
	select HAVE_VAGRANT_BOX_VERSION
	select HAVE_DISTRO_XFS_PREFERS_MANUAL if FSTESTS_XFS
	select HAVE_DISTRO_BTRFS_PREFERS_MANUAL if FSTESTS_BTRFS
	select HAVE_DISTRO_EXT4_PREFERS_MANUAL if FSTESTS_EXT4
	select HAVE_DISTRO_PREFERS_FSTESTS_WATCHDOG if KDEVOPS_WORKFLOW_ENABLE_FSTESTS
	select HAVE_DISTRO_PREFERS_FSTESTS_WATCHDOG_KILL if KDEVOPS_WORKFLOW_ENABLE_FSTESTS
	help
	  This option will set the target guest to be a distro in the Fedora family.
	  For example, Fedora, CentOS Stream, RHEL, etc.

config VAGRANT_KDEVOPS
	bool "kdevops kernel builds"
	select HAVE_CUSTOM_DISTRO_HOST_PREFIX
	select HAVE_DISTRO_XFS_PREFERS_MANUAL if FSTESTS_XFS
	select HAVE_DISTRO_BTRFS_PREFERS_MANUAL if FSTESTS_BTRFS
	select HAVE_DISTRO_EXT4_PREFERS_MANUAL if FSTESTS_EXT4
	select HAVE_DISTRO_PREFERS_FSTESTS_WATCHDOG if KDEVOPS_WORKFLOW_ENABLE_FSTESTS
	select HAVE_DISTRO_PREFERS_FSTESTS_WATCHDOG_KILL if KDEVOPS_WORKFLOW_ENABLE_FSTESTS
	help
	  This option will let you select custom kernel builds by the
	  kdevops project. The distributions may vary and are are specified.
endchoice

config HAVE_VAGRANT_BOX_VERSION
	bool
	default n

source "vagrant/Kconfig.debian"
source "vagrant/Kconfig.opensuse"
source "vagrant/Kconfig.fedora"
source "vagrant/Kconfig.kdevops"

if HAVE_SUSE_VAGRANT
source "vagrant/Kconfig.suse"
endif # HAVE_SUSE_VAGRANT

config VAGRANT_BOX
	string
	default "debian/testing64" if VAGRANT_DEBIAN_TESTING64 || !VAGRANT
	default "debian/bullseye64" if VAGRANT_DEBIAN_BULLSEYE64
	default "debian/buster64" if VAGRANT_DEBIAN_BUSTER64
	default "opensuse/Tumbleweed.x86_64" if VAGRANT_OPENSUSE_X86_64_TW
	default VAGRANT_FEDORA_BOX_STRING if VAGRANT_FEDORA
	default "generic/rhel8" if VAGRANT_REDHAT_GENERIC_RHEL8_X86_64
	default "generic/rhel9" if VAGRANT_REDHAT_GENERIC_RHEL9_X86_64
	default "opensuse/Leap-15.3.x86_64" if VAGRANT_OPENSUSE_X86_64_LEAP_15_3
	default "opensuse/Leap-15.4.x86_64" if VAGRANT_OPENSUSE_X86_64_LEAP_15_4
	default "Leap-15.4.x86_64" if VAGRANT_OPENSUSE_X86_64_LEAP_15_4
	default "linux-kdevops/debian-next-20220629" if VAGRANT_KDEVOPS_DEBIAN_TESTING64_NEXT_20220629 || !VAGRANT
	default "linux-kdevops/debian-xfs-20230427" if VAGRANT_KDEVOPS_DEBIAN_TESTING64_XFS_20230427 || !VAGRANT
	default VAGRANT_SUSE_BOX if VAGRANT_SUSE
	help
	  The Vagrant box to use.

config VAGRANT_BOX_UPDATE_ON_BRINGUP
	bool "Run Vagrant box update prior to bringup"
	default y
	help
	  When you use Vagrant on a system the target box for the distribution
	  will first be downloaded on its first use. It will not be updated
	  until you manually run "vagrant box update" on the respective vagrant
	  directory. This can mean that if your system first used kdevops in
	  January 2022 and you are using Debian testing, the old version of
	  Debian testing as of January 2022 will be used if you try to
	  instantiate a guest in January 2023. This can means your userspace
	  may be too old to deal with some new kernel features. An example
	  is zstd module support for initframfs does not work well with old
	  userspace on Debian testing. The boot will fail when trying to
	  run "make linux" and it would not be clear why, the reason would be
	  a failed ext4 module could not be loaded, in fact no modules could
	  be loaded by the initramfs. To fix the user experience we ensure we
	  always run "vagrant box update" as the first step to "make bringup".

	  Folks testing stable kernels will use stable distributions, such as
	  Debian bullseye that don't move userspace as often but in fact welcome
	  their own stable updates to userspace, and this is why this is kept
	  as enabled by default.

	  You may want to disable this if you don't want to deal with these
	  updates on bringup, and you want to do the updates on your own.
	  Note that if you already ran bringup with an old box, you won't
	  reap benefits of the new one until you "make destroy" and then
	  "make bringup" again. If you are already on an old box and don't
	  want to destroy your current box image you can just upgrade userspace
	  manually by the typical distro means to update itself. For example
	  on Debian testing that's "apt-get update && apt-get dist-upgrade".

config VAGRANT_BOX_UPDATE_ON_BRINGUP
	bool "Validate Vagrantfile prior to bringup"
	default y
	help
	  Folks hacking on the Vagrantfile may want to ensure they validate
	  the Vagrantfile first. This will allow developers to identify issues
	  prior to running some real virtualization commands. Enable this by
	  default as validation is fast and safe.

config VAGRANT_PREFERRED_KERNEL_CI_SUBJECT_TOPIC
	string
	default VAGRANT_BOX if VAGRANT_DEBIAN_BUSTER64
	default VAGRANT_BOX if VAGRANT_DEBIAN_BULLSEYE64

config HAVE_VAGRANT_BOX_URL
	bool

if HAVE_VAGRANT_BOX_URL

config VAGRANT_BOX_URL
	string
	depends on HAVE_VAGRANT_BOX_URL
	default VAGRANT_SUSE_BOX_URL if HAVE_SUSE_VAGRANT
	default "https://download.opensuse.org/repositories/Virtualization:/Appliances:/Images:/openSUSE-Leap-15.4/images/boxes/Leap-15.4.x86_64.json" if VAGRANT_OPENSUSE_X86_64_LEAP_15_4

endif # HAVE_VAGRANT_BOX_URL

if HAVE_VAGRANT_BOX_VERSION

config VAGRANT_BOX_VERSION
	string
	default "1.0.20230425" if VAGRANT_OPENSUSE_X86_64_TW_1020230425
	default "1.0.20220528" if VAGRANT_OPENSUSE_X86_64_TW_1020220528
	default "1.0.20210915" if VAGRANT_OPENSUSE_X86_64_TW_1020210915
	default "1.0.20210203" if VAGRANT_OPENSUSE_X86_64_TW_1020210203
	default "1.0.20200714" if VAGRANT_OPENSUSE_X86_64_TW_1020200714
	default "1.0.20210203" if VAGRANT_OPENSUSE_X86_64_TW_1020210203
	default "0.1.0" if VAGRANT_KDEVOPS_DEBIAN_TESTING64_NEXT_20220629
	help
	  The Vagrant box version to use. This is set for you depending on the
	  image you select. You can manually override the version we have last
	  tested here.

endif # HAVE_VAGRANT_BOX_VERSION

if !HAVE_VAGRANT_BOX_VERSION

config VAGRANT_BOX_VERSION
	string
	default ""

endif # !HAVE_VAGRANT_BOX_VERSION
endif # VAGRANT
```

## vagrant/Kconfig.debian
```kconfig
# SPDX-License-Identifier: copyleft-next-0.3.1
if VAGRANT_DEBIAN

choice
	prompt "Debian release to use"
	default VAGRANT_DEBIAN_TESTING64

config VAGRANT_DEBIAN_BUSTER64
	bool "debian/buster64"
	select HAVE_DISTRO_XFS_SUPPORTS_CRC if FSTESTS_XFS
	select HAVE_DISTRO_XFS_SUPPORTS_EXTERNAL_LOG if FSTESTS_XFS
	select HAVE_DISTRO_XFS_SUPPORTS_REFLINKS if FSTESTS_XFS
	select HAVE_DISTRO_XFS_SUPPORTS_BIGBLOCKS if FSTESTS_XFS
	depends on TARGET_ARCH_X86_64
	help
	  This option will set the target guest to debian/buster64.

config VAGRANT_DEBIAN_BULLSEYE64
	bool "debian/bullseye64"
	select HAVE_DISTRO_XFS_SUPPORTS_CRC if FSTESTS_XFS
	select HAVE_DISTRO_XFS_SUPPORTS_EXTERNAL_LOG if FSTESTS_XFS
	select HAVE_DISTRO_XFS_SUPPORTS_REFLINKS if FSTESTS_XFS
	select HAVE_DISTRO_XFS_SUPPORTS_BIGBLOCKS if FSTESTS_XFS
	depends on TARGET_ARCH_X86_64
	help
	  This option will set the target guest to debian/bullseye64.

config VAGRANT_DEBIAN_TESTING64
	bool "debian/testing64"
	select HAVE_DISTRO_XFS_SUPPORTS_CRC if FSTESTS_XFS
	select HAVE_DISTRO_XFS_SUPPORTS_EXTERNAL_LOG if FSTESTS_XFS
	select HAVE_DISTRO_XFS_SUPPORTS_REFLINKS if FSTESTS_XFS
	select HAVE_DISTRO_XFS_SUPPORTS_BIGBLOCKS if FSTESTS_XFS
	depends on TARGET_ARCH_X86_64
	help
	  This option will set the target guest to debian/testing64.

endchoice

config VAGRANT_DEBIAN_BOX_SHORT
	string
	default "buster64" if VAGRANT_DEBIAN_BUSTER64
	default "bullseye64" if VAGRANT_DEBIAN_BULLSEYE64
	default "testing64" if VAGRANT_DEBIAN_TESTING64

endif # VAGRANT_DEBIAN
```

## vagrant/Kconfig.fedora
```kconfig
# SPDX-License-Identifier: copyleft-next-0.3.1
if VAGRANT_FEDORA

config VAGRANT_FEDORA_BOX_STRING
	string "Vagrant box string"
	default "fedora/38-cloud-base"
	help
	  This is the box string that vagrant should use. This is typically
	  something like fedora/??-cloud-base or generic/rhel?. We default
	  to the latest Fedora cloud-base release.

config VAGRANT_FEDORA_OLD_RELEASE
	bool "Is this an old release (pre-Fedora 32)?"
	default n
	help
	  XFS on older Fedora releases lacked support for certain
	  features. Enabling this will disable testing certain
	  configurations by default in the fstests workflow.

config RHEL_REGISTER
	bool "Register the guests with Red Hat?"
	default n
	help
	  Official RHEL installations require a subscription before you can download
	  packages from their core repos. Enable this if you're deploying an official
	  RHEL cloud image (e.g. generic/rhel9).

config RHEL_ORG_ID
	string "Red Hat Organization Identifier"
	depends on RHEL_REGISTER
	default ""
	help
	  Enter the Red Hat Organizational ID for your subscription here.

config RHEL_ACTIVATION_KEY
	string "Red Hat Activation Key"
	depends on RHEL_REGISTER
	default ""
	help
	  Enter the Activation Key to use when registering systems.

config VAGRANT_FEDORA_NEW_RELEASE
	bool
	default y
	depends on !VAGRANT_FEDORA_OLD_RELEASE
	select HAVE_DISTRO_XFS_SUPPORTS_CRC if FSTESTS_XFS
	select HAVE_DISTRO_XFS_SUPPORTS_EXTERNAL_LOG if FSTESTS_XFS
	select HAVE_DISTRO_XFS_SUPPORTS_REFLINKS if FSTESTS_XFS
	select HAVE_DISTRO_XFS_SUPPORTS_BIGBLOCKS if FSTESTS_XFS

endif # VAGRANT_FEDORA
```

## vagrant/Kconfig.kdevops
```kconfig
# SPDX-License-Identifier: copyleft-next-0.3.1
if VAGRANT_KDEVOPS

choice
	prompt "Kdevops release to use"
	default VAGRANT_KDEVOPS_DEBIAN_TESTING64_XFS_20230427

config VAGRANT_KDEVOPS_DEBIAN_TESTING64_XFS_20230427
	bool "linux-kdevops/debian-xfs-20230427"
	select HAVE_VAGRANT_BOX_VERSION
	select HAVE_DISTRO_XFS_SUPPORTS_CRC if FSTESTS_XFS
	select HAVE_DISTRO_XFS_SUPPORTS_EXTERNAL_LOG if FSTESTS_XFS
	select HAVE_DISTRO_XFS_SUPPORTS_REFLINKS if FSTESTS_XFS
	select HAVE_DISTRO_XFS_SUPPORTS_BIGBLOCKS if FSTESTS_XFS
	select HAVE_SUPPORTS_PURE_IOMAP
	depends on TARGET_ARCH_X86_64
	help
	  This option will set the target guest to
	  linux-kdevops/debian-xfs-20230423 which is based on
	  debian-testing and only uses XFS for the root fs.

config VAGRANT_KDEVOPS_DEBIAN_TESTING64_NEXT_20220629
	bool "linux-kdevops/debian-next-20220629"
	select HAVE_VAGRANT_BOX_VERSION
	select HAVE_DISTRO_XFS_SUPPORTS_CRC if FSTESTS_XFS
	select HAVE_DISTRO_XFS_SUPPORTS_EXTERNAL_LOG if FSTESTS_XFS
	select HAVE_DISTRO_XFS_SUPPORTS_REFLINKS if FSTESTS_XFS
	select HAVE_DISTRO_XFS_SUPPORTS_BIGBLOCKS if FSTESTS_XFS
	depends on TARGET_ARCH_X86_64
	help
	  This option will set the target guest to
	  linux-kdevops/debian-next-20220629 which is based on
	  debian-testing. It just has linux-next next-20220629.

endchoice

config VAGRANT_DEBIAN_BOX_SHORT
	string
	default "debian-next-20220629" if VAGRANT_KDEVOPS_DEBIAN_TESTING64_NEXT_20220629
	default "debian-xfs-20230427" if VAGRANT_KDEVOPS_DEBIAN_TESTING64_XFS_20230427

endif # VAGRANT_KDEVOPS
```
