## kconfigs/workflows/fstests/Kconfig
```kconfig
if KDEVOPS_WORKFLOW_FSTESTS

choice
	prompt "Target filesystem to test"
	default FSTESTS_XFS

config FSTESTS_XFS
	bool "xfs"
	help
	  This will target testing the xfs filesystem.

config FSTESTS_BTRFS
	bool "brfs"
	help
	  This will target testing the btrfs filesystem.

endchoice

config FSTESTS_FSTYP
	string "The filesystem to test with fstests"
	default "xfs" if FSTESTS_XFS
	default "btrfs" if FSTESTS_BTRFS
	help
	  The filesystem to test. This will be automatically set depending on
	  the above choice, you however can override this manually.

if FSTESTS_XFS

config FSTESTS_XFS_MANUAL_COVERAGE
	bool "Enable manual coverage selection"
	default n
	help
	  By default we aim to spawn enough hosts to cover testing the full
	  range of supported features upstream on the Linux kernel for xfs,
	  and for you to also be able to do development on each section
	  concurrently. This consists of a total of 16 hosts created, disabling
	  this option reduces let's you manually select only the sections you
	  want to test. This is useful if for example you have reduces system
	  resources or your target kernel does not enable certain features
	  which you don't care to test for.

	  Since fstests tests are not parallized and cannot easily be parallized
	  and since there are many different ways in which you can create an
	  xfs filesystem we have devised a strategy to split up tests by the
	  type of xfs configuration used when you created the filesystem. The
	  fstests suite allows you to specify different configurations using
	  "sections" on an fstests configuration file. We create then one host
	  per target section on x86_64.

	  Today this consists of 8 different sections. Each section uses
	  different mkfs.xfs commands which enable different features. By
	  default we also rely on two spawned hosts per tested section, one
	  used to establish a baseline and another for development purposes.
	  Since a total of 8 xfs sections are currently tested with kdevops
	  this means by default 16 hosts will be spawned to test xfs.

	  You can enable this to allow you to override the spawned hosts, to
	  reduce the number of sections tested and spanwed hosts.

config FSTESTS_XFS_BASELINE_AND_DEV
	bool "Enable both a baseline and development system per target test"
	default y
	help
	  By default a host is created for each target fstests for both to
	  track a baseline and to do development. That is, two hosts are created
	  per target test. If you are constrained with system resources disable
	  this option and only one system will be created for you for each
	  target test, and you can use that for both basline tracking and
	  development. This just means you have reboot to a different kernel
	  if you want to switch between a baseline and a development kernel
	  to test. If enabled, the host baseline will be created as well as
	  the development host, the development hostname is the same as the
	  baseline host but with an added "-dev" postfix.

if FSTESTS_XFS_MANUAL_COVERAGE

config FSTESTS_XFS_SECTION_CRC
	bool "Enable testing section: xfs"
	default y
	help
	  This will create a host to test the baseline of fstests using the
	  following configuration:

	      [xfs]
	      MKFS_OPTIONS='-f -m crc=1,reflink=0,rmapbt=0, -i sparse=0'
	      FSTYP=xfs

config FSTESTS_XFS_SECTION_NOCRC
	bool "Enable testing section: xfs_nocrc"
	default y
	help
	  This will create a host to test the baseline of fstests using the
	  following configuration without CRC enabled. This is useful to test
	  older kernels which lacked CRC support.

	      [xfs_nocrc]
	      MKFS_OPTIONS='-f -m crc=0,reflink=0,rmapbt=0, -i sparse=0,'
	      FSTYP=xfs
	      [xfs]

config FSTESTS_XFS_SECTION_NOCRC_512
	bool "Enable testing section: xfs_nocrc_512"
	default y
	help
	  This will create a host to test the baseline of fstests using the
	  following configuration without CRC enabled using 512 byte block size.
	  This is useful to test older kernels which lacked CRC support.

	      [xfs_nocrc_512]
	      MKFS_OPTIONS='-f -m crc=0,reflink=0,rmapbt=0, -i sparse=0, -b size=512,'
	      FSTYP=xfs

config FSTESTS_XFS_SECTION_REFLINK
	bool "Enable testing section: xfs_reflink"
	default y
	help
	  This will create a host to test the baseline of fstests using the
	  following configuration which enables reflinks.

	      [xfs_reflink]
	      MKFS_OPTIONS='-f -m reflink=1,rmapbt=1, -i sparse=1,'
	      FSTYP=xfs

config FSTESTS_XFS_SECTION_REFLINK_1024
	bool "Enable testing section: xfs_reflink_1024"
	default y
	help
	  This will create a host to test the baseline of fstests using the
	  following configuration which enables reflink using 1024 byte
	  block size.

	      [xfs_reflink]
	      MKFS_OPTIONS='-f -m reflink=1,rmapbt=1, -i sparse=1,'
	      FSTYP=xfs

config FSTESTS_XFS_SECTION_EXTERNAL_LOGS
	bool "Enable testing sections which use an external log device"
	default y
	help
	  Enabling this option allows you to test xfs configuration which
	  require the use of an external log device.

if FSTESTS_XFS_SECTION_EXTERNAL_LOGS

config FSTESTS_XFS_SECTION_LOGDEV
	bool "Enable testing section: xfs_logdev"
	default y
	help
	  This will create a host to test the baseline of fstests using the
	  following configuration which enables the usage of writing metadata
	  to an external log device.

	      [xfs_logdev]
	      MKFS_OPTIONS="-f -m crc=1,reflink=0,rmapbt=0, -i sparse=0 -lsize=1g"
	      SCRATCH_LOGDEV=/dev/some-device
	      USE_EXTERNAL=yes
	      FSTYP=xfs

config FSTESTS_XFS_SECTION_RTDEV
	bool "Enable testing section: xfs_realtimedev"
	default y
	help
	  This will create a host to test the baseline of fstests using the
	  following configuration which enables the usage of real time device:

	      [xfs_realtimedev]
	      MKFS_OPTIONS="-f -lsize=1g"
	      SCRATCH_LOGDEV=@FSTESTSSCRATCHLOGDEV@
	      SCRATCH_RTDEV=@FSTESTSSCRATCHRTDEV@
	      USE_EXTERNAL=yes
	      FSTYP=xfs

endif # FSTESTS_XFS_SECTION_EXTERNAL_LOGS

endif # FSTESTS_XFS_MANUAL_COVERAGE

endif # FSTESTS_XFS

config FSTESTS_GIT
	string "The fstests git tree to clone"
	default "https://git.kernel.org/pub/scm/fs/xfs/xfstests-dev.git"
	help
	  The fstests git tree to clone.

config FSTESTS_DATA
	string "Where to clone the fstests git tree to"
	default "{{data_path}}/xfstests"
	help
	  This is the target location of where to clone the above git tree.
	  Note that {{data_path}} corresponds to the location set by the
	  configuration option CONFIG_WORKFLOW_DATA_PATH.

config FSTESTS_DATA_TARGET
	string "The target fstests install directory"
	default "/var/lib/xfstests"
	help
	  The directory where fstests will be installed.

choice
	prompt "Strategy for device pool"
	default FSTESTS_TESTDEV_SPARSEFILE_GENERATION

config FSTESTS_TESTDEV_SPARSEFILE_GENERATION
	bool "Create sparse files for test devices"
	help
	  When testing a filesystem with fstests you must provide the
	  test devices to be used to test. By selecting this option
	  sparse files will be created for you on a target path, and
	  loopback devices will be set up for you so you can use these
	  loopback devices to test the filesystem.

	  This is useful if you don't really want to test creating a filesystem
	  against real block devices or are constrained / limited by the amount
	  of block devices you have. By using sparse files you are also
	  reducing the amount of hard drive space you actually need to only the
	  amount of actual space used by all the tests. This varies by the
	  filesystem you are testing.

	  We'll create 15 sparse files for you, and so you can run tests which
	  require up to 15 block devices. The TEST_DEV is set to /dev/loop16.
	  If a LOGWRITES_DEV is used this /dev/loop15 is used.
	  If a SCRATCH_RTDEV is used this /dev/loop14 is used.

	  The SCRATCH_DEV_POOL is set to these devices:

	   /dev/loop5   /dev/loop6   /dev/loop6   /dev/loop7
	   /dev/loop8   /dev/loop9   /dev/loop10  /dev/loop11

	  With this strategy these loopback devices currently remain unused:

	   /dev/loop12
	   /dev/loop13

endchoice

if FSTESTS_TESTDEV_SPARSEFILE_GENERATION

config FSTESTS_SPARSE_DEV
	string "Device to use to create a filesystem on for sparse files"
	default "/dev/nvme1n1" if VAGRANT
	default "/dev/nvme2n1" if TERRAFORM_AWS_INSTANCE_M5AD_4XLARGE
	default "/dev/nvme1n1" if TERRAFORM_GCE
	default "/dev/sde" if TERRAFORM_AZURE
	help
	  The device to use to create a filesystem on where we will place
	  sparse files.

choice
	prompt "Filesystem to use where sparse files will live"
	default FSTESTS_SPARSE_XFS

config FSTESTS_SPARSE_XFS
	bool "xfs"
	help
	  This will target testing the xfs filesystem.

config FSTESTS_SPARSE_BTRFS
	bool "brfs"
	help
	  This will target testing the btrfs filesystem.

config FSTESTS_SPARSE_EXT4
	bool "ext4"
	help
	  This will target testing the ext4 filesystem.

endchoice

config FSTESTS_SPARSE_FSTYPE
	string "Filesystem to use to create where the sparse files will live"
	default "xfs" if FSTESTS_SPARSE_XFS
	default "btrfs" if FSTESTS_SPARSE_BTRFS
	default "ext4" if FSTESTS_SPARSE_EXT4
	help
	  The filesystem to use where we will place the generated sparse files.
	  This is not the filesystem we will test, this is just where the sparse
	  files used will live.

config FSTESTS_SPARSE_LABEL
	string "Filesystem label to use for the filesystem where sparsefiles live"
	default "sparsefiles"
	help
	  The filesystem label to create and later use to mount the partition on
	  the /etc/fstab file to which represents where sparsefiles live.

config FSTESTS_SPARSE_FILE_PATH
	string "Path to directory where to generate sparse files"
	default "/media/sparsefiles"
	help
	  The directory where to create sparse files to be used to represent
	  actual devices used.

config FSTESTS_SPARSE_FILE_SIZE
	string "Size of the sparse files to use per target device"
	default "20G"
	help
	  The size of the sparse files to create, this is the -s argument passed
	  to the command truncate.

config FSTESTS_SPARSE_FILENAME_PREFIX
	string "The sparse file name prefix to use"
	default "sparse-disk"
	help
	  This is the prefix for the name of the sparse file to create.
	  For instance if FSTESTS_SPARSE_FILE_PATH is set to /media/truncated
	  and you set this prefix to sparse-disk, the first sparse file to create
	  will be named /media/truncated/sparse-disk5. The name used is simply for
	  pure convenience to the developer and to make it clear what type of
	  file backing is provided for the loopback device.

endif # FSTESTS_TESTDEV_SPARSEFILE_GENERATION

config FSTESTS_TEST_DEV
	string "The device to use TEST_DEV on fstests"
	default "/dev/loop16" if FSTESTS_TESTDEV_SPARSEFILE_GENERATION
	help
	  To test with fstests one must set the TEST_DEV variable, this sets
	  the TEST_DEV to use.

config FSTESTS_TEST_DIR
	string "The path to use for the fstests TEST_DIR variable"
	default "/media/test"
	help
	  To test with fstests one must set the TEST_DEV variable, this sets
	  the TEST_DEV to use.

	# default $(shell, for i in $(seq 5 11) echo /dev/loop$i) if FSTESTS_TESTDEV_SPARSEFILE_GENERATION
config FSTESTS_SCRATCH_DEV_POOL
	string "The list of devices to set in SCRATCH_DEV_POOL"
	default "/dev/loop5 /dev/loop6 /dev/loop6 /dev/loop7 /dev/loop8 /dev/loop9 /dev/loop10 /dev/loop11" if FSTESTS_TESTDEV_SPARSEFILE_GENERATION
	help
	  To set of spare devices to use for the FSTESTS SCRATCH_DEV_POOL.

config FSTESTS_SCRATCH_MNT
	string "The path to use for the fstests SCRATCH_MNT variable"
	default "/media/scratch"
	help
	  This sets the SCRATCH_MNT variable.

config FSTESTS_LOGWRITES_DEV
	string "The fstests LOGWRITES_DEV to use"
	default "/dev/loop15" if FSTESTS_TESTDEV_SPARSEFILE_GENERATION
	help
	  To set of spare devices to use for the fstests SCRATCH_DEV_POOL.

config FSTESTS_SCRATCH_LOGDEV
	string "The fstests SCRATCH_LOGDEV to use"
	default "/dev/loop15" if FSTESTS_TESTDEV_SPARSEFILE_GENERATION
	help
	  To set devices to use for the SCRATCH_LOGDEV.

config FSTESTS_LOGWRITES_DEV
	string "The fstests LOGWRITES_DEV to use"
	default "/dev/loop15" if FSTESTS_TESTDEV_SPARSEFILE_GENERATION
	help
	  To set devices to use for the LOGWRITES_DEV.

if FSTESTS_XFS

config FSTESTS_SCRATCH_RTDEV
	string "The fstests SCRATCH_RTDEV to use"
	default "/dev/loop14" if FSTESTS_TESTDEV_SPARSEFILE_GENERATION
	help
	  To set devices to use for the SCRATCH_RTDEV.

endif # FSTESTS_XFS

config FSTESTS_SETUP_SYSTEM
	bool "Help setup system if something is found missing or broken"
	default y
	help
	  This adds adds users / groups if missing. Additionally if
	  a service is not avaiable it ensures to start it. These quirks should
	  all be moved as part of the ansible role for fstests eventually.

config FSTESTS_RUN_TESTS
	bool "Run fstests"
	default y
	help
	  Disable this to only install dependencies for fstests, and so the
	  full set of fstests won't be run.

endif # KDEVOPS_WORKFLOW_FSTESTS
```

## terraform/Kconfig
```kconfig
if TERRAFORM

menu "Terraform cloud provider configuration"
source "terraform/Kconfig.providers"
endmenu

menu "Terraform ssh configuration"
source "terraform/Kconfig.ssh"
endmenu

config TERRAFORM_PRIVATE_NET
	bool "Add a private network for the guests"
	depends on TERRAFORM_OPENSTACK || TERRAFORM_AZURE
	default y
	help
	  This option adds a private network between the various guests
	  on a separate interface from the public network. This is useful
	  if you want to run a workflow that involves communications
	  between the guests. The guests will determine their IPv4 address
	  via DHCP.

config TERRAFORM_PRIVATE_NET_PREFIX
	string "Network prefix for private network"
	default "10.0.3.0"
	depends on TERRAFORM_PRIVATE_NET
	help
	  Network prefix of the private network. It's recommended to use
	  RFC1918 addresses or something that won't conflict with
	  globally-routable addresses.

config TERRAFORM_PRIVATE_NET_MASK
	int "Network mask for private network"
	default 24
	depends on TERRAFORM_PRIVATE_NET
	help
	  Length of the network mask to use for the private network.
endif # TERRAFORM
```

## terraform/Kconfig.limits
```kconfig
config TERRAFORM_LIMIT_BOXES
	bool "Limit the number of boxes creaed beyond what the project defines"
	default y
	help
	  If enabled we and you are running 'make menuconfig' as user sonia,
	  then we'd infer this and peg sonia as the default user name for you.
	  We'll simply run $(shell echo $USER).

if TERRAFORM_LIMIT_BOXES

config TERRAFORM_LIMIT_NUM_BOXES
	int "Limit the number of boxes to this number"
	default 1
	help
	  If enabled and say you have 2 hosts enabled we'll only create 1.
	  You can use this if you are afraid of getting chaged on your cloud
	  provider while taking kdevops out for a spin on your cloud provider.

endif # TERRAFORM_LIMIT_BOXES
```

## terraform/Kconfig.providers
```kconfig
choice
	prompt "Choose your cloud provider"
	default TERRAFORM_AWS

config TERRAFORM_GCE
	bool "GCE - Google Cloud Engine"
	depends on TARGET_ARCH_X86_64
	help
	  Enabling this means you are going to use GCE for your cloud solution.

config TERRAFORM_AWS
	bool "AWS - Amazon Web Services"
	depends on TARGET_ARCH_X86_64 || TARGET_ARCH_ARM64
	help
	  Enabling this means you are going to use AWS for your cloud solution.

config TERRAFORM_AZURE
	bool "Azure"
	depends on TARGET_ARCH_X86_64
	select TERRAFORM_PRIVATE_NET
	help
	  Enabling this means you are going to use Azure for your cloud
	  solution. Note that Azure requires a private network for the
	  guests.

config TERRAFORM_OCI
	bool "OCI - Oracle Cloud Infrastructure"
	depends on TARGET_ARCH_X86_64
	help
	  Enabling this means you are going to use OCI for your cloud
	  solution.

config TERRAFORM_OPENSTACK
	bool "OpenStack"
	help
	  Enabling this means you are going to use OpenStack for your cloud
	  solution.

endchoice

source "terraform/gce/Kconfig"
source "terraform/aws/Kconfig"
source "terraform/azure/Kconfig"
source "terraform/oci/Kconfig"
source "terraform/openstack/Kconfig"
```
