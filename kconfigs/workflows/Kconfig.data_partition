## vagrant/Kconfig.opensuse
```kconfig
# SPDX-License-Identifier: copyleft-next-0.3.1
if VAGRANT_OPENSUSE

choice
	prompt "OpenSUSE release to use"
	default VAGRANT_OPENSUSE_X86_64_LEAP_15_3

config VAGRANT_OPENSUSE_X86_64_TW
	bool "opensuse/Tumbleweed.x86_64"
	depends on TARGET_ARCH_X86_64
	help
	  Enable this to be able to select between the supported OpenSUSE
	  Tumbleweed releases.

config VAGRANT_OPENSUSE_X86_64_LEAP_15_3
	bool "opensuse/Leap-15.3.x86_64"
	depends on TARGET_ARCH_X86_64
	select HAVE_DISTRO_BTRFS_DISABLES_RAID56  if FSTESTS_BTRFS
	select HAVE_DISTRO_XFS_SUPPORTS_CRC if FSTESTS_XFS
	select HAVE_DISTRO_XFS_SUPPORTS_EXTERNAL_LOG if FSTESTS_XFS
	select HAVE_DISTRO_XFS_SUPPORTS_REFLINKS if FSTESTS_XFS
	select HAVE_DISTRO_XFS_SUPPORTS_BIGBLOCKS if FSTESTS_XFS
	select HAVE_DISTRO_PREFERS_FSTESTS_WATCHDOG if FSTESTS_XFS
	select HAVE_DISTRO_PREFERS_FSTESTS_WATCHDOG_KILL if FSTESTS_XFS
	select HAVE_DISTRO_BLKTESTS_TEST_BLOCK if KDEVOPS_WORKFLOW_ENABLE_BLKTESTS
	select HAVE_DISTRO_BLKTESTS_TEST_LOOP if KDEVOPS_WORKFLOW_ENABLE_BLKTESTS
	select HAVE_DISTRO_BLKTESTS_TEST_NBD if KDEVOPS_WORKFLOW_ENABLE_BLKTESTS
	select HAVE_DISTRO_PREFERS_BLKTESTS_WATCHDOG if KDEVOPS_WORKFLOW_ENABLE_BLKTESTS
	select HAVE_DISTRO_PREFERS_BLKTESTS_WATCHDOG_KILL if KDEVOPS_WORKFLOW_ENABLE_BLKTESTS
	select HAVE_DISTRO_PREFERS_REFRESH
	select HAVE_DISTRO_PREFERS_UPDATE
	select HAVE_DISTRO_PREFERS_INSTALL_KDEVTOOLS
	help
	  This enables the OpenSUSE Leap 15.3 release.

config VAGRANT_OPENSUSE_X86_64_LEAP_15_4
	bool "Leap-15.4.x86_64"
	depends on TARGET_ARCH_X86_64
	select HAVE_VAGRANT_BOX_URL
	select HAVE_DISTRO_BTRFS_DISABLES_RAID56  if FSTESTS_BTRFS
	select HAVE_DISTRO_XFS_SUPPORTS_CRC if FSTESTS_XFS
	select HAVE_DISTRO_XFS_SUPPORTS_EXTERNAL_LOG if FSTESTS_XFS
	select HAVE_DISTRO_XFS_SUPPORTS_REFLINKS if FSTESTS_XFS
	select HAVE_DISTRO_XFS_SUPPORTS_BIGBLOCKS if FSTESTS_XFS
	select HAVE_DISTRO_PREFERS_FSTESTS_WATCHDOG if FSTESTS_XFS
	select HAVE_DISTRO_PREFERS_FSTESTS_WATCHDOG_KILL if FSTESTS_XFS
	select HAVE_DISTRO_BLKTESTS_TEST_BLOCK if KDEVOPS_WORKFLOW_ENABLE_BLKTESTS
	select HAVE_DISTRO_BLKTESTS_TEST_LOOP if KDEVOPS_WORKFLOW_ENABLE_BLKTESTS
	select HAVE_DISTRO_BLKTESTS_TEST_NBD if KDEVOPS_WORKFLOW_ENABLE_BLKTESTS
	select HAVE_DISTRO_PREFERS_BLKTESTS_WATCHDOG if KDEVOPS_WORKFLOW_ENABLE_BLKTESTS
	select HAVE_DISTRO_PREFERS_BLKTESTS_WATCHDOG_KILL if KDEVOPS_WORKFLOW_ENABLE_BLKTESTS
	select HAVE_DISTRO_PREFERS_REFRESH
	select HAVE_DISTRO_PREFERS_UPDATE
	select HAVE_DISTRO_PREFERS_INSTALL_KDEVTOOLS
	help
	  This enables the OpenSUSE Leap 15.4 release.

endchoice

if VAGRANT_OPENSUSE_X86_64_TW

choice
	prompt "opensuse/Tumbleweed.x86_64 version to use"
	default VAGRANT_OPENSUSE_X86_64_TW_1020210915

config VAGRANT_OPENSUSE_X86_64_TW_1020210915
	bool "opensuse/Tumbleweed.x86_64 1.0.20210915 "
	select HAVE_VAGRANT_BOX_VERSION
	select HAVE_DISTRO_XFS_SUPPORTS_CRC if FSTESTS_XFS
	select HAVE_DISTRO_XFS_SUPPORTS_EXTERNAL_LOG if FSTESTS_XFS
	select HAVE_DISTRO_XFS_SUPPORTS_REFLINKS if FSTESTS_XFS
	select HAVE_DISTRO_XFS_SUPPORTS_BIGBLOCKS if FSTESTS_XFS
	help
	  This option will set the target guest to opensuse/Tumbleweed.x86_64
	  release 1.0.20210915.

config VAGRANT_OPENSUSE_X86_64_TW_1020210203
	bool "opensuse/Tumbleweed.x86_64 1.0.20210203 "
	select HAVE_VAGRANT_BOX_VERSION
	select HAVE_DISTRO_XFS_SUPPORTS_CRC if FSTESTS_XFS
	select HAVE_DISTRO_XFS_SUPPORTS_EXTERNAL_LOG if FSTESTS_XFS
	select HAVE_DISTRO_XFS_SUPPORTS_REFLINKS if FSTESTS_XFS
	select HAVE_DISTRO_XFS_SUPPORTS_BIGBLOCKS if FSTESTS_XFS
	help
	  This option will set the target guest to opensuse/Tumbleweed.x86_64
	  release 1.0.20210203.

config VAGRANT_OPENSUSE_X86_64_TW_1020200714
	bool "opensuse/Tumbleweed.x86_64 1.0.20200714"
	select HAVE_VAGRANT_BOX_VERSION
	select HAVE_DISTRO_XFS_SUPPORTS_CRC if FSTESTS_XFS
	select HAVE_DISTRO_XFS_SUPPORTS_EXTERNAL_LOG if FSTESTS_XFS
	select HAVE_DISTRO_XFS_SUPPORTS_REFLINKS if FSTESTS_XFS
	select HAVE_DISTRO_XFS_SUPPORTS_BIGBLOCKS if FSTESTS_XFS
	help
	  This option will set the target guest to opensuse/Tumbleweed.x86_64
	  release 1.0.20200714.

endchoice

endif # VAGRANT_OPENSUSE_X86_64_TW

config VAGRANT_OPENSUSE_BOX_SHORT
	string
	default "tw" if VAGRANT_OPENSUSE_X86_64_TW
	default "leap15sp3" if VAGRANT_OPENSUSE_X86_64_LEAP_15_3
	default "leap15sp4" if VAGRANT_OPENSUSE_X86_64_LEAP_15_4

endif # VAGRANT_OPENSUSE
```

## vagrant/Kconfig.pcie_passthrough_libvirt
```kconfig
# SPDX-License-Identifier: copyleft-next-0.3.1

config KDEVOPS_LIBVIRT_PCIE_PASSTHROUGH
	bool "Enable libvirt PCIE passthrough support"
	default n
	help
	  Enable this if you want to enable PCI-E passthrough onto target
	  guests.

if KDEVOPS_LIBVIRT_PCIE_PASSTHROUGH

choice
	prompt "What guest target type to passthrough to"
	default KDEVOPS_LIBVIRT_PCIE_PASSTHROUGH_TYPE_FIRST

config KDEVOPS_LIBVIRT_PCIE_PASSTHROUGH_TYPE_FIRST
	bool "Onto the first guest"
	help
	  Select this option if you want to passthrough PCI-E devices selected
	  onto the first guest that kdevops generates on the nodes list.

config KDEVOPS_LIBVIRT_PCIE_PASSTHROUGH_TYPE_SPECIFIC
	bool "Onto a specific host name you'll specify"
	help
	  Select this option if you want to passthrough PCI-E devices onto
	  a guest hostname. This means you have foresight into the future
	  generated kdevops nodes that will be available and you will manually
	  specify a target hostname you want to use to pass on the selected
	  PCI-E devices to.

endchoice

config KDEVOPS_LIBVIRT_PCIE_PASSTHROUGH_TARGET_HOSTNAME
	string "Guest target hostname to passthrough PCI-E devices to"
	default "enter-valid-hostname"
	depends on KDEVOPS_LIBVIRT_PCIE_PASSTHROUGH_TYPE_SPECIFIC
	help
	  Set this to the hostname of the target guest you want to passthrough
	  the enabled PCI-E devices to.

menu "Select which PCI-E devices to passthrough"
source "vagrant/Kconfig.passthrough_libvirt.generated"
endmenu

endif # KDEVOPS_LIBVIRT_PCIE_PASSTHROUGH
```

## vagrant/Kconfig.redhat.generic
```kconfig
# SPDX-License-Identifier: copyleft-next-0.3.1
if VAGRANT_REDHAT_GENERIC

choice
	prompt "Redhat release to use"
	default VAGRANT_REDHAT_GENERIC_RHEL8_X86_64

config VAGRANT_REDHAT_GENERIC_RHEL8_X86_64
	bool "generic/rhel8"
	depends on TARGET_ARCH_X86_64
	help
	  This option will set the target guest to generic/rhel8.
	  Note, that there is nothing one can do with this release other than
	  get the base release. Registration still needs to be worked on.

config VAGRANT_REDHAT_GENERIC_RHEL9_X86_64
	bool "generic/rhel9"
	depends on TARGET_ARCH_X86_64
	help
	  This option will set the target guest to generic/rhel9.
	  Note, that there is nothing one can do with this release other than
	  get the base release. Registration still needs to be worked on.

endchoice

config VAGRANT_REDHAT_GENERIC_BOX_SHORT
	string
	default "rhel8" if VAGRANT_REDHAT_GENERIC_RHEL8_X86_64
	default "rhel9" if VAGRANT_REDHAT_GENERIC_RHEL9_X86_64


endif # VAGRANT_REDHAT_GENERIC
```
