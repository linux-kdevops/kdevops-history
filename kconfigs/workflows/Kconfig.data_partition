## terraform/Kconfig.ssh
```kconfig
config TERRAFORM_SSH_USER_INFER
	bool "Selecting this will infer your username from you local system"
	default y
	help
	  If enabled we and you are running 'make menuconfig' as user sonia,
	  then we'd infer this and peg sonia as the default user name for you.
	  We'll simply run $(shell echo $USER).

config TERRAFORM_SSH_CONFIG_USER
	string "The username to create on the target systems"
	default $(shell, echo $USER) if TERRAFORM_SSH_USER_INFER
	default "admin" if !TERRAFORM_SSH_USER_INFER
	help
	  The ssh public key which will be pegged onto the systems's
	  ~/.ssh/authorized_keys file so you can log in.

config TERRAFORM_SSH_CONFIG_PUBKEY_FILE
	string "The ssh public key to use to log in"
	default "~/.ssh/kdevops_terraform.pub"
	help
	  The ssh public key which will be pegged onto the systems's
	  ~/.ssh/authorized_keys file so you can log in.

config TERRAFORM_SSH_CONFIG_GENKEY
	bool "Should we create a new random key for you?"
	default y
	help
	  If enabled we will create a new ssh key for you, to be used to log in
	  to the systems created by terraform. If the file already exists we
	  won't overwrite to it, uness you enable the next option.

	  Enabling this is highly encouraged, given the security concerns of
	  old development keys lingering around for too long. Development
	  systems aren't always on the most trusted systems, and since the
	  target systems are ephemeral, if you use a key you typically use
	  to log in to more important systems you are putting that key at
	  risk. By encouraging the ssh keys to be just as ephemeral as the
	  development systems created, we we ensuring there is no leakage of
	  valuable ssh keys.

	  You are encouraged to be running haveged on your local system.

if TERRAFORM_SSH_CONFIG_GENKEY

config TERRAFORM_SSH_CONFIG_GENKEY_OVERWRITE
	bool "Should we destroy any existing key if the file already exists?"
	default y
	help
	  If enabled we will destroy your old key if it existed. This is
	  highly encouraged. You don't want to keep old keys around forever
	  for all your development ephemeral systems.

config TERRAFORM_SSH_CONFIG_GENKEY_EMPTY_PASSPHRASE
	bool "Should we create the key with an empty passphrase?"
	default y
	help
	  If enabled your ssh key will not have an associated passphrase with
	  it. This is fine if you are just using ephemeral development systems.

endif # TERRAFORM_SSH_CONFIG_GENKEY
```
