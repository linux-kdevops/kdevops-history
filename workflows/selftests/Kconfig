## workflows/selftests/Kconfig
```kconfig
if KDEVOPS_WORKFLOW_ENABLE_SELFTESTS

menu "Configure what to test in selftests"

config SELFTESTS_MANUAL_COVERAGE
	bool "Enable manual coverage selection"
	default y
	help
	  By default we aim to spawn enough hosts to cover testing the full
	  set of supported tests. If you are sure you don't need to test
	  certain things, enabling this option lets you disable them here.

	  We only enable selftests for a subsystem by default after vetting by
	  respective subsystem maintainers.

if SELFTESTS_MANUAL_COVERAGE

config SELFTESTS_SECTION_FIRMWARE
	bool "Firmware loader"
	default y
	help
	  This will create a host to test the firmware loader.

config SELFTESTS_SECTION_KMOD
	bool "kmod - Kernel module loader usermode helper"
	default y
	help
	  This will create a host to test the kmod selftest.

config SELFTESTS_SECTION_SYSCTL
	bool "sysctls"
	default y
	help
	  This will create a host to test proc sysctls.

endif # SELFTESTS_MANUAL_COVERAGE

if !SELFTESTS_MANUAL_COVERAGE

config SELFTESTS_SECTION_FIRMWARE
	bool
	default y

config SELFTESTS_SECTION_KMOD
	bool
	default y

config SELFTESTS_SECTION_SYSCTL
	bool
	default y

endif # !SELFTESTS_MANUAL_COVERAGE

endmenu

endif # KDEVOPS_WORKFLOW_ENABLE_SELFTESTS
```
