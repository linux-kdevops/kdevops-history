## workflows/linux/Kconfig.dev
```kconfig
if BOOTLINUX_DEV

choice
	prompt "Linux development tree to use"
	default BOOTLINUX_TREE_NEXT if !QEMU_ENABLE_EXTRA_DRIVE_LARGEIO
	default BOOTLINUX_TREE_MCGROF_NEXT if QEMU_ENABLE_EXTRA_DRIVE_LARGEIO

config BOOTLINUX_TREE_NEXT
	bool "linux-next"
	help
	  Use the linux-next tree.

config BOOTLINUX_TREE_BTRFS_DEVEL
	bool "btrfs-devel"
	help
	  Use the btrfs-devel tree.

config BOOTLINUX_TREE_JLAYTON_LINUX
	bool "jlayton-linux"
	help
	  Use Jeff Layton's linux tree.

config BOOTLINUX_TREE_MCGROF_NEXT
	bool "mcgrof-next"
	select BOOTLINUX_HAS_PURE_IOMAP_CONFIG
	help
	  Use mcgrof's linux-next tree.

endchoice

endif # BOOTLINUX_DEV
```

## workflows/linux/Kconfig.jlayton
```kconfig
if BOOTLINUX_TREE_JLAYTON_LINUX

choice
	prompt "jlayton-linux branch to use"
	default BOOTLINUX_JLAYTON_LINUX_KDEVOPS

config BOOTLINUX_JLAYTON_LINUX_KDEVOPS
	bool "kdevops"
	help
	  Use the kdevops branch.

config BOOTLINUX_JLAYTON_LINUX_IVERSION
	bool "iversion-next"
	help
	  Use the iversion-next branch.

config BOOTLINUX_JLAYTON_LINUX_CUSTOM
	bool "Custom branch name"
	help
	  Use a custom branch name.

endchoice

config BOOTLINUX_JLAYTON_LINUX_CUSTOM_NAME
	string "Custom branch name"
	default "kdevops"
	depends on BOOTLINUX_JLAYTON_LINUX_CUSTOM
	help
	  Custom branch name to use for Jeff Layton's linux tree.

config BOOTLINUX_JLAYTON_LINUX_TAG
	string
	default BOOTLINUX_JLAYTON_LINUX_CUSTOM_NAME if BOOTLINUX_JLAYTON_LINUX_CUSTOM
	default "kdevops" if BOOTLINUX_JLAYTON_LINUX_KDEVOPS
	default "iversion-next" if BOOTLINUX_JLAYTON_LINUX_IVERSION

config BOOTLINUX_JLAYTON_TREE_NAME
	string
	default "jlayton-linux"

config BOOTLINUX_JLAYTON_TREE_URL
	string
	default "git://git.kernel.org/pub/scm/linux/kernel/git/jlayton/linux.git" if BOOTLINUX_TREE_JLAYTON_LINUX

endif # BOOTLINUX_TREE_JLAYTON_LINUX
```

## workflows/linux/Kconfig.kdevops
```kconfig
if BOOTLINUX_TREE_KDEVOPS_LINUS

choice
	prompt "kdevops-linus branch to use"
	default BOOTLINUX_KDEVOPS_LINUS_LBS_MINORDER

config BOOTLINUX_KDEVOPS_LINUS_LBS_MINORDER
	bool "large-block-minorder"
	help
	  Use the latest LBS branch based on Linus' tree.

endchoice

config BOOTLINUX_TREE_KDEVOPS_URL
	string
	default "https://github.com/linux-kdevops/linux.git" if !USE_LOCAL_LINUX_MIRROR
	default "/mirror/kdevops-linus.git" if USE_LIBVIRT_MIRROR && BOOTLINUX_9P

config BOOTLINUX_KDEVOPS_TREE_TAG
	string
	default "large-block-minorder"

config BOOTLINUX_KDEVOPS_TREE_NAME
	string
	default "kdevops-linus"

endif # BOOTLINUX_TREE_KDEVOPS_LINUS
```

## workflows/linux/Kconfig.linus
```kconfig
if BOOTLINUX_LINUS

choice
	prompt "Linux tree based on Linus' tree to use"
	default BOOTLINUX_TREE_LINUS

config BOOTLINUX_TREE_LINUS
	bool "linux"
	help
	  Use Linus Torvald's linux tree.

config BOOTLINUX_TREE_KDEVOPS_LINUS
	bool "kdevops-linus"
	help
	  Branches in kdevops' tree based on Linus' tree.

config BOOTLINUX_TREE_MCGROF_LINUS
	bool "mcgrof-linus"
	help
	  Branches in mcgrof's tree based on Linus' tree.

endchoice

if BOOTLINUX_TREE_LINUS

choice
	prompt "Linus' tag or branch to use"
	default BOOTLINUX_LINUS_66_RC5

config BOOTLINUX_LINUS_MASTER
	bool "master"
	help
	  Use the master branch, the top of Linus' tree.

config BOOTLINUX_LINUS_66_RC4
	bool "v6.6-rc4"
	help
	  Use the v6.6-rc4 tag.

config BOOTLINUX_LINUS_66_RC5
	bool "v6.6-rc5"
	help
	  Use the v6.6-rc5 tag.

config BOOTLINUX_LINUS_66_RC2
	bool "v6.6-rc2"
	help
	  Use the v6.6-rc2 tag.

endchoice

config BOOTLINUX_TREE_LINUS_TAG
	string
	default "master" if BOOTLINUX_LINUS_MASTER
	default "v6.6-rc2" if BOOTLINUX_LINUS_66_RC2
	default "v6.6-rc4" if BOOTLINUX_LINUS_66_RC2
	default "v6.6-rc5" if BOOTLINUX_LINUS_66_RC5

config BOOTLINUX_TREE_LINUS_NAME
	string
	default "linux"

config BOOTLINUX_TREE_LINUS_URL
	string
	default "https://git.kernel.org/pub/scm/linux/kernel/git/torvalds/linux.git" if !USE_LOCAL_LINUX_MIRROR
	default "git://192.168.124.1/mirror/linux.git" if USE_LIBVIRT_MIRROR && !BOOTLINUX_9P
	default "/mirror/linux.git" if USE_LIBVIRT_MIRROR && BOOTLINUX_9P

endif # BOOTLINUX_TREE_LINUS

endif # BOOTLINUX_LINUS
```

## workflows/linux/Kconfig.mcgrof
```kconfig
if BOOTLINUX_TREE_MCGROF_LINUS

choice
	prompt "mcgrof-linus branch to use"
	default BOOTLINUX_MCGROF_LINUS_LBS

config BOOTLINUX_MCGROF_LINUS_LBS
	bool "large-block-linus"
	help
	  Use the latest LBS branch based on Linus' tree.

config BOOTLINUX_MCGROF_LINUS_LBS_NOBDEV
	bool "large-block-linus-nobdev"
	help
	  Use the latest minimal branch for LBS which let's you use LBS
	  devices with a sectorsize compatibility based on Linus' tree.

endchoice

endif # BOOTLINUX_TREE_MCGROF_LINUS

if BOOTLINUX_TREE_MCGROF_NEXT

choice
	prompt "mcgrof-next branch to use"
	default BOOTLINUX_MCGROF_NEXT_LBS

config BOOTLINUX_MCGROF_NEXT_LBS
	bool "large-block-next"
	help
	  Use the latest stable LBS branch which enables all the bells and
	  whistles for all types of LBS devices.

config BOOTLINUX_MCGROF_NEXT_LBS_NOBDEV
	bool "large-block-nobdev"
	help
	  Use the latest minimal branch for LBS which let's you use LBS
	  devices with a sectorsize compatibility.

endchoice

endif # BOOTLINUX_TREE_MCGROF_NEXT

if BOOTLINUX_TREE_MCGROF_LINUS || BOOTLINUX_TREE_MCGROF_NEXT

config BOOTLINUX_MCGROF_TREE
	bool
	default y

config BOOTLINUX_MCGROF_TREE_TAG
	string
	default "large-block-linus" if BOOTLINUX_MCGROF_LINUS_LBS
	default "large-block-linus-nobdev" if BOOTLINUX_MCGROF_LINUS_LBS_NOBDEV
	default "large-block-20230915" if BOOTLINUX_MCGROF_NEXT_LBS
	default "large-block-nobdev-20230915" if BOOTLINUX_MCGROF_NEXT_LBS_NOBDEV

config BOOTLINUX_MCGROF_TREE_NAME
	string
	default "mcgrof-linus" if BOOTLINUX_TREE_MCGROF_LINUS
	default "mcgrof-next" if BOOTLINUX_TREE_MCGROF_NEXT

config BOOTLINUX_MCGROF_TREE_URL
	string
	default "https://git.kernel.org/pub/scm/linux/kernel/git/mcgrof/linux-next.git" if BOOTLINUX_TREE_MCGROF_NEXT && !USE_LOCAL_LINUX_MIRROR
	default "/mirror/mcgrof-next.git" if BOOTLINUX_TREE_MCGROF_NEXT && USE_LIBVIRT_MIRROR && BOOTLINUX_9P
	default "https://git.kernel.org/pub/scm/linux/kernel/git/mcgrof/linux.git" if BOOTLINUX_TREE_MCGROF_LINUS && !USE_LOCAL_LINUX_MIRROR
	default "/mirror/mcgrof-linus.git" if BOOTLINUX_TREE_MCGROF_LINUS && USE_LIBVIRT_MIRROR && BOOTLINUX_9P

endif # BOOTLINUX_TREE_MCGROF_LINUS || BOOTLINUX_TREE_MCGROF_NEXT
```

## workflows/linux/Kconfig.next
```kconfig
if BOOTLINUX_TREE_NEXT

config BOOTLINUX_TREE_NEXT_TAG
	string "linux-next tag to pull"
	default "next-20240108"

config BOOTLINUX_TREE_NEXT_NAME
	string
	default "linux-next"

config BOOTLINUX_TREE_NEXT_URL
	string
	default "https://git.kernel.org/pub/scm/linux/kernel/git/next/linux-next.git" if !USE_LOCAL_LINUX_MIRROR
	default $(shell, scripts/append-makefile-vars.sh git:// $(KDEVOPS_DEFAULT_BRIDGE_IP_VAGRANT) /mirror/linux-next.git) if USE_LIBVIRT_MIRROR && !BOOTLINUX_9P && VAGRANT
	default $(shell, scripts/append-makefile-vars.sh git:// $(KDEVOPS_DEFAULT_BRIDGE_IP_GUESTFS) /mirror/linux-next.git) if USE_LIBVIRT_MIRROR && !BOOTLINUX_9P && GUESTFS
	default "/mirror/linux-next.git" if USE_LIBVIRT_MIRROR && BOOTLINUX_9P

endif # BOOTLINUX_TREE_NEXT
```

## workflows/linux/Kconfig.stable
```kconfig
if BOOTLINUX_STABLE

choice
	prompt "Linux stable tree to use"
	default BOOTLINUX_TREE_STABLE

config BOOTLINUX_TREE_STABLE
	bool "linux-stable"
	help
	  Use the linux-stable tree.

endchoice

if BOOTLINUX_TREE_STABLE

choice
	prompt "Stable branch to use"
	default BOOTLINUX_STABLE_V60

config BOOTLINUX_STABLE_V419
	bool "linux-4.19.y"
	help
	  Automatically enable the latest supported linux-4.19.y kernel.

config BOOTLINUX_STABLE_V54
	bool "linux-5.4.y"
	help
	  Automatically enable the latest supported linux-5.4.y kernel.

config BOOTLINUX_STABLE_V510
	bool "linux-5.10.y"
	help
	  Automatically enable the latest supported linux-5.10.y kernel.

config BOOTLINUX_STABLE_V514
	bool "linux-5.14.y"
	help
	  Automatically enable the latest supported linux-5.14.y kernel.

config BOOTLINUX_STABLE_V517
	bool "linux-5.17.y"
	help
	  Automatically enable the latest supported linux-5.17.y kernel.

config BOOTLINUX_STABLE_V519
	bool "linux-5.19.y"
	help
	  Automatically enable the latest supported linux-5.19.y kernel.

config BOOTLINUX_STABLE_V60
	bool "linux-6.0.y"
	help
	  Automatically enable the latest supported linux-6.0.y kernel.

config BOOTLINUX_STABLE_V61
	bool "linux-6.1.y"
	help
	  Automatically enable the latest supported linux-6.1.y kernel.

endchoice

endif # BOOTLINUX_TREE_STABLE

config BOOTLINUX_TREE_STABLE_TAG
	string
	default "v4.19.133" if BOOTLINUX_STABLE_V419
	default "v5.4.210" if BOOTLINUX_STABLE_V54
	default "v5.10.105" if BOOTLINUX_STABLE_V510
	default "v5.14.4" if BOOTLINUX_STABLE_V514
	default "v5.17-rc7" if BOOTLINUX_STABLE_V517
	default "v5.19-rc4" if BOOTLINUX_STABLE_V519
	default "v6.0.9" if BOOTLINUX_STABLE_V60
	default "linux-6.1.y" if BOOTLINUX_STABLE_V61

config BOOTLINUX_TREE_STABLE_NAME
	string
	default "linux-stable" if BOOTLINUX_TREE_STABLE

config BOOTLINUX_TREE_STABLE_URL
	string
	default "https://git.kernel.org/pub/scm/linux/kernel/git/stable/linux.git" if !USE_LOCAL_LINUX_MIRROR
	default "git://192.168.124.1/mirror/linux-stable.git" if USE_LIBVIRT_MIRROR && !BOOTLINUX_9P
	default "/mirror/linux-stable.git" if USE_LIBVIRT_MIRROR && BOOTLINUX_9P

endif # BOOTLINUX_STABLE
```

## workflows/ltp/Kconfig
```kconfig
if KDEVOPS_WORKFLOW_ENABLE_LTP

if WORKFLOWS_DEDICATED_WORKFLOW

menu "Test groups to enable"

config LTP_TESTS_CVE
	bool "CVE group"
	help
	  Run the CVE regression tests.

config LTP_TESTS_FS
	bool "FS group"
	help
	  Run the file system-related unit tests.

config LTP_TESTS_FS_BIND
	bool "Bind mount group"
	help
	  Run the file system bind mount unit tests.

config LTP_TESTS_FS_PERMS_SIMPLE
	bool "FS simple permission group"
	help
	  Run the file system permission unit tests.

config LTP_TESTS_FS_READONLY
	bool "FS read-only group"
	help
	  Run the file system read-only unit tests.

config LTP_TESTS_NFS
	bool "NFS group"
	help
	  Run the NFS, NFS locking, and RPC unit tests.

config LTP_TESTS_NOTIFY
	bool "inotify and fanotify group"
	help
	  Run the inotify and fanotify unit tests.

config LTP_TESTS_RPC
	bool "Traditional SunRPC group"
	help
	  Run SunRPC library unit tests.

config LTP_TESTS_SMACK
	bool "SMACK tests"
	help
	  Run the SMACK unit group.

config LTP_TESTS_TIRPC
	bool "Transport-Independent SunRPC group"
	help
	  Run the TI-RPC library unit tests.

endmenu

endif # WORKFLOWS_DEDICATED_WORKFLOW

config LTP_REPO
	string "The ltp repository to clone"
	default "https://github.com/linux-test-project/ltp.git"
	help
	  The ltp repository to clone.

config LTP_REPO_COMMIT
	string "The version of ltp to check out"
	default "20240129"
	help
	  The reference (tag, commit hash, or branch) to be checked out
	  and used for the test.

endif # KDEVOPS_WORKFLOW_ENABLE_LTP
```

## workflows/pynfs/Kconfig
```kconfig
if KDEVOPS_WORKFLOW_ENABLE_PYNFS

config PYNFS_GIT
	string "pynfs git tree to clone"
	default "git://git.linux-nfs.org/projects/cdmackay/pynfs.git"
	help
	  The pynfs git tree to clone.

config PYNFS_GIT_TAG
	string "tag, branch or sha1sum"
	default "master"
	help
	  The tag, branch or sha1sum to check out.

endif # KDEVOPS_WORKFLOW_ENABLE_PYNFS
```
