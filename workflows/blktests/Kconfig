## workflows/gitr/Kconfig
```kconfig
if KDEVOPS_WORKFLOW_ENABLE_GITR

choice
	prompt "The target file system type to be tested"
	default GITR_BTRFS

config GITR_XFS
	bool "xfs"
	help
	  Run the git regression suite on an xfs file system.

config GITR_BTRFS
	bool "btrfs"
	help
	  Run the git regression suite on a btrfs file system.

config GITR_EXT4
	bool "ext4"
	help
	  Run the git regression suite on an ext4 file system.

config GITR_NFS
	bool "nfs"
	help
	  Run the git regression suite on an NFS mount.

config GITR_TMPFS
	bool "tmpfs"
	help
	  Run the git regression suite on a tmpfs file system.

endchoice

if GITR_XFS
menu "Configure how to test XFS"
source "workflows/gitr/xfs/Kconfig"
endmenu
endif # GITR_XFS

if GITR_BTRFS
menu "Configure how to test btrfs"
source "workflows/gitr/btrfs/Kconfig"
endmenu
endif # GITR_BTRFS

if GITR_EXT4
menu "Configure how to test ext4"
source "workflows/gitr/ext4/Kconfig"
endmenu
endif # GITR_EXT4

if GITR_NFS
menu "Configure how nfs should be tested"
source "workflows/gitr/nfs/Kconfig"
endmenu
endif # GITR_NFS

if GITR_TMPFS
menu "Configure how tmpfs should be tested"
source "workflows/gitr/tmpfs/Kconfig"
endmenu
endif # GITR_TMPFS

config GITR_MNT
	string "Where to mount the file system under test"
	default "/gitr"
	help
	  The directory over which to mount the file system under test.

config GITR_REPO
	string "The git tool repository to clone"
	default "https://git.kernel.org/pub/scm/git/git.git"
	help
	  The git tool repository to clone.

config GITR_REPO_COMMIT
	string "The version of git to check out"
	default "v2.43.0"
	help
	  The commit to be used for the test.

if KDEVOPS_WORKFLOW_DEDICATE_GITR

config GITR_ALL_TESTS
	bool "Run all available git regression tests"
	default y
	help
	  Say Y here if you simply want to run the full git
	  regression suite. This is the default.

	  If you would like to run only specific individual tests,
	  say N here, and fill in the GITR_TEST_LIST option below.

config GITR_TEST_LIST
	string "List of regression tests to run"
	default ""
	depends on !GITR_ALL_TESTS
	help
	  This option specifies a blank-separated list of specific
	  individual regression tests that can be run with "make
	  gitr-baseline" and its brethren targets.

	  You can find a list of scripts that can be run in the t/
	  directory of the git repo.

endif # KDEVOPS_WORKFLOW_DEDICATE_GITR

endif # KDEVOPS_WORKFLOW_ENABLE_GITR
```

## workflows/gitr/btrfs/Kconfig
```kconfig
config GITR_BTRFS_DEVICE
	string
	default "/dev/disk/by-id/nvme-QEMU_NVMe_Ctrl_kdevops1" if LIBVIRT && LIBVIRT_EXTRA_STORAGE_DRIVE_NVME
	default "/dev/disk/by-id/virtio-kdevops1" if LIBVIRT && LIBVIRT_EXTRA_STORAGE_DRIVE_VIRTIO
	default "/dev/disk/by-id/ide-kdevops1" if LIBVIRT && LIBVIRT_EXTRA_STORAGE_DRIVE_IDE
	default "/dev/nvme2n1" if TERRAFORM_AWS_INSTANCE_M5AD_4XLARGE
	default "/dev/nvme1n1" if TERRAFORM_GCE
	default "/dev/sdd" if TERRAFORM_AZURE

config GITR_BTRFS_LABEL
	string "The file system label to use"
	default "gitr"
	help
	  The file system label that marks the file system under test.

config GITR_BTRFS_MOUNT_OPTS
	string "The file system mount options to use"
	default "defaults"
	help
	  The mount options to use when mounting the file system under test.
```

## workflows/gitr/nfs/Kconfig
```kconfig
config GITR_USE_KDEVOPS_NFSD
	bool "Test against the kdevops NFS server"
	select KDEVOPS_SETUP_NFSD
	default y
	help
	  Select this option if you want to test against an NFS
	  server deployed by kdevops. If you want to test against
	  another already-deployed and reachable NFS server, disable
	  this option and specify the server hostname below.

config GITR_NFS_SERVER_HOSTNAME
	string "Test Server hostname"
	default ""
	depends on !GITR_USE_KDEVOPS_NFSD
	help
	  The NFS server hostname or address that test clients are to
	  mount.

config GITR_NFS_SERVER_EXPORT
	string "Test Server export path"
	default "gitr"
	depends on !GITR_USE_KDEVOPS_NFSD
	help
	  The NFS server export path that test clients are to mount.

config GITR_NFS_MOUNT_OPTS
	string "The NFS client mount options to use"
	default "sec=sys,proto=tcp"
	help
	  The mount options to use when mounting the file system
	  under test.

if KDEVOPS_WORKFLOW_DEDICATE_GITR

config GITR_NFS_SECTION_V42
	bool "Enable testing section: nfs_v42"
	default n
	help
	  Create a target host to run the gitr workflow on an
	  NFSv4.2 mount.

config GITR_NFS_SECTION_V41
	bool "Enable testing section: nfs_v41"
	default n
	help
	  Create a target host to run the gitr workflow on an
	  NFSv4.1 mount.

config GITR_NFS_SECTION_V40
	bool "Enable testing section: nfs_v40"
	default n
	help
	  Create a target host to run the gitr workflow on an
	  NFSv4.0 mount.

config GITR_NFS_SECTION_V3
	bool "Enable testing section: nfs_v3"
	default n
	help
	  Create a target host to run the gitr workflow on an
	  NFSv3 mount.

endif # KDEVOPS_WORKFLOW_DEDICATE_GITR
```

## workflows/gitr/tmpfs/Kconfig
```kconfig
config GITR_TMPFS_MOUNT_OPTS
	string "The file system mount options to use"
	default "size=75%"
	help
	  The mount options to use when mounting the file system under test.
```

## workflows/linux/Kconfig
```kconfig
if BOOTLINUX

config BOOTLINUX_HAS_PURE_IOMAP_CONFIG
	bool

# For images / distros that do not require CONFIG_BUFFER_HEAD To support this
# you should have an image / instance which does not require BLK_DEV_MD (RAID
# support), ext4, vfat, or other older filesystems which require struct buffer
# head usage.
#
# CONFIG_BUFFER_HEAD is only available currently on development branches, not
# even yet part of linux-next. The branches that have support for this must
# select BOOTLINUX_HAS_PURE_IOMAP_CONFIG.
#
# Instances / images which can boot into a kernel without buffer heads then
# must also select HAVE_SUPPORTS_PURE_IOMAP

if HAVE_SUPPORTS_PURE_IOMAP

config BOOTLINUX_PURE_IOMAP
	bool "Use a kernel configuration which disables buffer heads"
	default HAVE_SUPPORTS_PURE_IOMAP
	depends on BOOTLINUX_HAS_PURE_IOMAP_CONFIG
	help
	  This will let you choose use 9p to build Linux. What this does is

endif # HAVE_SUPPORTS_PURE_IOMAP

config BOOTLINUX_9P
	bool "Use 9p to build Linux"
	depends on LIBVIRT
	depends on LIBVIRT_MACHINE_TYPE_Q35
	default LIBVIRT_MACHINE_TYPE_Q35
	help
	  This will let you choose use 9p to build Linux. What this does is
	  use your localhost to git clone Linux under the assumption your
	  host is more powerful than the guests you are going to instantiate.
	  The localhost then will be used to build Linux using all threads
	  possible. The installation of Linux on the guest is done only with
	  the install target, the guest gets read-only access to the host's
	  path where Linux is closed using 9p.

	  You should not have to modify any default 9p settings except maybe
	  where your localhost path for your git tree is. You should keep
	  the other settings as-is unless you know what you are doing.

if BOOTLINUX_9P

menu "Modify default 9p configuration"
config BOOTLINUX_9P_HOST_PATH
	string "9p host path"
	default $(shell, echo $PWD/linux)
	help
	  This sets the 9p host path that will be used. This is the path
	  that has your or we'll clone the respective linux git tree.
	  If you have no git tree present there we'll git clone Linux there
	  for you. Otherwise we'll just reset the tree for you and build Linux
	  there for you. We build Linux only once.

config BOOTLINUX_9P_MSIZE
	int "9p msize"
	default 131072
	help
	  This sets the msize value. Prior to v5.15 this was set to 8 KiB as
	  default, however this is reported to have produced pretty terrible
	  performance, and so this was bumped 128 KiB as default after v5.15.
	  The qemu wiki [0] seems to suggest to use a range between 10-100 MiB
	  for SATA and however that is a lie as 500 KiB (512000) is the maximum
	  value possible. Also, using the max value possible I get a different
	  value for sha1sum on files! So let's just stick to the default
	  of 128 KiB (131072). If you are going to update the default value
	  for msize on kdevops please make sure you test this and it works.

	  [0] https://wiki.qemu.org/Documentation/9psetup

config BOOTLINUX_9P_FSDEV
	string "9p fsdev"
	default "kdevops_9p_fsdev"
	help
	  This sets the 9p fsdev ID. This is used by libvirt if that is enabled,
	  and then by the respective mount command.

config BOOTLINUX_9P_SECURITY_MODEL
	string "9p security model"
	default "none"
	help
	  The security model to use.

config BOOTLINUX_9P_DRIVER
	string "9p driver to use"
	default "virtio-9p-pci"
	help
	  The security model to use.

config BOOTLINUX_9P_MOUNT_TAG
	string "9p mount tag"
	default "kdevops_9p_bootlinux"
	help
	  This sets the 9p mount tag to use.

endmenu

endif # BOOTLINUX_9P

choice
	prompt "Type of development version of Linux to use"
	default BOOTLINUX_DEV

config BOOTLINUX_LINUS
	bool "Linux releases based on Linus' tree"
	help
	  This will let you choose Linux trees based on Linus' tree.

config BOOTLINUX_STABLE
	bool "Stable Linux releases"
	help
	  This will let you choose from stable Linux trees only.

config BOOTLINUX_DEV
	bool "Development Linux releases"
	help
	  This will let you choose from development Linux trees only. Mostly
	  linux-next based trees.

config BOOTLINUX_CUSTOM
	bool "Custom Linux releases"
	help
	  This will let you enter in your own git tree URL / branch / ID.

endchoice

source "workflows/linux/Kconfig.linus"
source "workflows/linux/Kconfig.stable"
source "workflows/linux/Kconfig.dev"

# Later on we could automate this with 'make dynconfig' and reading
# dynamically kernel.org's sources / branches.
source "workflows/linux/Kconfig.kdevops"
source "workflows/linux/Kconfig.mcgrof"
source "workflows/linux/Kconfig.jlayton"

source "workflows/linux/Kconfig.btrfs"

if BOOTLINUX_CUSTOM

config BOOTLINUX_CUSTOM_NAME
	string "Custom Linux kernel tree name"
	default "torvalds-linux"
	help
	  Short name to describe your custom tree. This will be used for the
	  the path used to place linux on the nodes on /data/$BOOTLINUX_TREE_NAME.

config BOOTLINUX_CUSTOM_URL
	string "Custom git tree URL"
	default "git://git.kernel.org/pub/scm/linux/kernel/git/torvalds/linux.git"

config BOOTLINUX_CUSTOM_TAG
	string "Custom Linux kernel tag or branch to use"
	default "master"
	help
	  The git ID or branch name to check out to compile linux.

endif # BOOTLINUX_CUSTOM

# This ends up being the directory name used for the /data/ partition
# where linux is deployed on the nodes.
config BOOTLINUX_TREE_NAME
	string
	default BOOTLINUX_TREE_LINUS_NAME if BOOTLINUX_TREE_LINUS
	default BOOTLINUX_TREE_STABLE_NAME if BOOTLINUX_TREE_STABLE
	default BOOTLINUX_TREE_NEXT_NAME if BOOTLINUX_TREE_NEXT
	default BOOTLINUX_TREE_BTRFS_DEVEL_NAME if BOOTLINUX_TREE_BTRFS_DEVEL
	default BOOTLINUX_KDEVOPS_TREE_NAME if BOOTLINUX_TREE_KDEVOPS_LINUS
	default BOOTLINUX_MCGROF_TREE_NAME if BOOTLINUX_MCGROF_TREE
	default BOOTLINUX_JLAYTON_TREE_NAME if BOOTLINUX_TREE_JLAYTON_LINUX
	default BOOTLINUX_CUSTOM_NAME if BOOTLINUX_CUSTOM

config BOOTLINUX_TREE
	string
	default BOOTLINUX_TREE_LINUS_URL if BOOTLINUX_TREE_LINUS
	default BOOTLINUX_TREE_STABLE_URL if BOOTLINUX_TREE_STABLE
	default BOOTLINUX_TREE_NEXT_URL if BOOTLINUX_TREE_NEXT
	default BOOTLINUX_MCGROF_TREE_URL if BOOTLINUX_MCGROF_TREE
	default BOOTLINUX_TREE_KDEVOPS_URL if BOOTLINUX_TREE_KDEVOPS_LINUS
	default BOOTLINUX_TREE_BTRFS_TREE_URL if BOOTLINUX_TREE_BTRFS_DEVEL
	default BOOTLINUX_JLAYTON_TREE_URL if BOOTLINUX_TREE_JLAYTON_LINUX
	default BOOTLINUX_CUSTOM_URL if BOOTLINUX_CUSTOM

config BOOTLINUX_TEST_MESSAGE_ID
	bool "Test mailing list message ID"
	default n
	select BOOTLINUX_TEST_MESSAGE_ID_INSTALL_B4 if BOOTLINUX_TEST_MESSAGE_ID
	help
	  When enabled, the b4 command from public-inbox will rebase the patches
	  contained in the message-id on top of a baseline kernel and install it
	  in the development box. A baseline kernel without the patches will be
	  installed in the baseline box. The effects of the patch on the tests
	  can then be seen as the difference between the baseline and development
	  test runs.

config BOOTLINUX_TEST_MESSAGE_ID_THREAD_ID
	string "The message ID"
	default ""
	depends on BOOTLINUX_TEST_MESSAGE_ID
	help
	  The message id that will be rebased on top of the baseline kernel in
	  the development box.

config BOOTLINUX_TEST_MESSAGE_ID_INSTALL_B4
	bool
	default n
	depends on BOOTLINUX_TEST_MESSAGE_ID
	prompt "Install b4 on development system" if BOOTLINUX_TEST_MESSAGE_ID
	help
	  When enabled, b4 will be installed using pip

config BOOTLINUX_TREE_TAG
	string
	default BOOTLINUX_TREE_LINUS_TAG if BOOTLINUX_TREE_LINUS
	default BOOTLINUX_TREE_STABLE_TAG if BOOTLINUX_STABLE
	default BOOTLINUX_TREE_NEXT_TAG if BOOTLINUX_TREE_NEXT
	default BOOTLINUX_TREE_BTRFS_DEVEL_TAG if BOOTLINUX_TREE_BTRFS_DEVEL
	default BOOTLINUX_KDEVOPS_TREE_TAG if BOOTLINUX_TREE_KDEVOPS_LINUS
	default BOOTLINUX_MCGROF_TREE_TAG if BOOTLINUX_MCGROF_TREE
	default BOOTLINUX_TREE_JLAYTON_LINUX_TAG if BOOTLINUX_TREE_JLAYTON_LINUX
	default BOOTLINUX_CUSTOM_TAG if BOOTLINUX_CUSTOM

config BOOTLINUX_TREE_LOCALVERSION
	string "Linux local version to use"
	help
	  The Linux local version to use (for uname).

config BOOTLINUX_SHALLOW_CLONE
	bool "Shallow git clone"
	default n
	help
	  If enabled the git tree cloned with be cloned using a shallow tree
	  with history truncated. You want to enable this if you really don't
	  care about the git history on the targets which will clone Linux.
	  Using a full shallow tree will save you about 5 minutes in time.
	  You want to say no here (the default) if you are using the targets
	  for actual kernel development. You want to enable this if you are
	  just using the targets as dummy target runners and don't expect to
	  be using 'git log' on the target guests.

config BOOTLINUX_SHALLOW_CLONE_DEPTH
	int "Shallow git clone depth"
	default 1
	depends on BOOTLINUX_SHALLOW_CLONE
	help
	  Create a shallow clone with a history truncated to the specified
	  number or revisions. The minimum possible value is 1, otherwise
	  ignored. Needs git>=1.9.1 to work correctly.

endif # BOOTLINUX
```

## workflows/linux/Kconfig.btrfs
```kconfig
if BOOTLINUX_TREE_BTRFS_DEVEL

config BOOTLINUX_TREE_BTRFS_DEVEL_TAG
	string
	default "btrfs-devel"

config BOOTLINUX_TREE_BTRFS_DEVEL_NAME
	string
	default "btrfs-devel"

config BOOTLINUX_TREE_BTRFS_TREE_URL
	string
	default "https://github.com/kdave/btrfs-devel.git" if BOOTLINUX_TREE_BTRFS_DEVEL

endif # BOOTLINUX_TREE_BTRFS_DEVEL
```

## workflows/linux/Kconfig.cel
```kconfig
if BOOTLINUX_TREE_CEL_LINUX

choice
	prompt "cel-linux branch to use"
	default BOOTLINUX_CEL_LINUX_NEXT

config BOOTLINUX_CEL_LINUX_NEXT
	bool "nfsd-next"
	help
	  Pull the nfsd-next branch.

config BOOTLINUX_CEL_LINUX_FIXES
	bool "nfsd-fixes"
	help
	  Pull the nfsd-fixes branch.

config BOOTLINUX_CEL_LINUX_CUSTOM
	bool "Custom branch name"
	help
	  Pull a custom branch name.

endchoice

config BOOTLINUX_CEL_LINUX_CUSTOM_NAME
	string "Custom branch name"
	default "custom"
	depends on BOOTLINUX_CEL_LINUX_CUSTOM
	help
	  Custom branch name to use for Chuck Lever's linux tree.

config BOOTLINUX_CEL_TREE_TAG
	string
	default "nfsd-next" if BOOTLINUX_CEL_LINUX_NEXT
	default "nfsd-fixes" if BOOTLINUX_CEL_LINUX_FIXES
	default BOOTLINUX_CEL_LINUX_CUSTOM_NAME if BOOTLINUX_CEL_LINUX_CUSTOM

config BOOTLINUX_CEL_TREE_NAME
	string
	default "cel-linux"

config BOOTLINUX_CEL_TREE_URL
	string
	default "https://git.kernel.org/pub/scm/linux/kernel/git/cel/linux.git" if BOOTLINUX_TREE_CEL_LINUX

endif # BOOTLINUX_TREE_CEL_LINUX
```
