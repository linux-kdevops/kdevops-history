## workflows/fstests/xfs/Kconfig
```kconfig
# Distributions actively maintaining XFS support should select this and then
# any be careful to select any of the other HAVE_DISTRO_XFS_* below so that
# testers can know what to test for.
config HAVE_DISTRO_XFS_PREFERS_MANUAL
	bool
	default n

config HAVE_DISTRO_XFS_SUPPORTS_CRC
	bool
	default n

config HAVE_DISTRO_XFS_IGNORES_NOCRC
	bool
	default n

config HAVE_DISTRO_XFS_SUPPORTS_REFLINKS
	bool
	default n

config HAVE_DISTRO_XFS_SUPPORTS_BIGBLOCKS
	bool
	default n

config HAVE_DISTRO_XFS_SUPPORTS_EXTERNAL_LOG
	bool
	default n

config HAVE_DISTRO_XFS_SUPPORTS_RT
	bool
	default n

config FSTESTS_XFS_QUOTA_ENABLED
	bool "Enable XFS quota"
	default n
	help
	  Pass '-o usrquota,grpquota,prjquota' when mounting an fs.

config FSTESTS_XFS_SECTION_LOGDEV_ENABLED
	bool "Enable testing sections which use an external log device"
	default y if HAVE_DISTRO_XFS_SUPPORTS_EXTERNAL_LOG
	default n if !HAVE_DISTRO_XFS_SUPPORTS_EXTERNAL_LOG
	help
	  Enabling this option allows you to test xfs configurations
	  which use an external log device.

config FSTESTS_XFS_SECTION_RTDEV_ENABLED
	bool "Enable testing sections which use a realtime device"
	default y if HAVE_DISTRO_XFS_SUPPORTS_RT
	default n if !HAVE_DISTRO_XFS_SUPPORTS_RT
	help
	  Enabling this option allows you to test xfs configurations
	  which use a realtime device.

if FSTESTS_XFS_QUOTA_ENABLED
config FSTESTS_XFS_MOUNT_QUOTA_OPTS
	string "Quota options to be passed during mount"
	default ""
	help
	  The quota options to be passed when mounting a filesystem.
endif # FSTESTS_XFS_QUOTA_ENABLED

config FSTESTS_XFS_MANUAL_COVERAGE
	bool "Enable manual coverage selection"
	default y if HAVE_DISTRO_XFS_PREFERS_MANUAL
	default n if !HAVE_DISTRO_XFS_PREFERS_MANUAL
	help
	  By default we aim to spawn enough hosts to cover testing the full
	  range of supported features upstream on the Linux kernel for xfs,
	  and for you to also be able to do development on each section
	  concurrently. This consists of a total of 16 hosts created, disabling
	  this option let's you manually select only the sections you
	  want to test. This is useful if for example you have reduced system
	  resources or your target kernel does not enable certain features
	  which you don't care to test for.

	  Since fstests tests are not parallelized and cannot easily be
          parallelized and since there are many different ways in which you can
          create an xfs filesystem we have devised a strategy to split up tests
          by the type of xfs configuration used when you created the
          filesystem. The fstests suite allows you to specify different
          configurations using "sections" on an fstests configuration file. We
          create then one host per supported target section for each respective
          architecture.

	  Today this consists of 8 different sections for x86_64, and 9 for
	  ppc64le and aarc64.

	  Each section uses different mkfs.xfs commands which enable different
	  features. By default we also rely on two spawned hosts per tested
	  section, one used to establish a baseline and another for
	  development purposes, if KDEVOPS_BASELINE_AND_DEV is enabled.
	  Since a total of 8 xfs sections are currently supported on x86_64,
	  this means by default 16 hosts will be spawned to test xfs with
	  x86_64 unless KDEVOPS_BASELINE_AND_DEV is used. Likewise for
	  ppc64le and aarch64 this consists of 9 target xfs sections for
	  a total of 18 hosts spawned if KDEVOPS_BASELINE_AND_DEV is
	  enabled.

	  You can enable this to allow you to override the spawned hosts, to
	  reduce the number of sections tested and spawned hosts.

if FSTESTS_XFS_MANUAL_COVERAGE

config FSTESTS_XFS_SECTION_CRC
	bool "Enable testing section: xfs_crc"
	default y if HAVE_DISTRO_XFS_SUPPORTS_CRC
	default n if !HAVE_DISTRO_XFS_SUPPORTS_CRC
	help
	  This will create a host to test the baseline of fstests using the
	  following configuration, which enables CRC, which was enabled by
	  default as of the v3.2.3 xfsprogs release:

	      [xfs]
	      MKFS_OPTIONS='-f -m crc=1,reflink=0,rmapbt=0, -i sparse=0'
	      FSTYP=xfs

if FSTESTS_XFS_SECTION_LOGDEV_ENABLED
config FSTESTS_XFS_SECTION_CRC_LOGDEV
	bool "Enable testing section: xfs_crc_logdev"
	help
	  This will create a host to test the baseline of fstests using the
	  following configuration which enables the usage of writing metadata
	  to an external log device.

	      [xfs_crc_logdev]
	      MKFS_OPTIONS="-f -m crc=1,reflink=0,rmapbt=0, -i sparse=0 -lsize=1g"
	      SCRATCH_LOGDEV=/dev/some-device
	      USE_EXTERNAL=yes
	      FSTYP=xfs
endif # FSTESTS_XFS_SECTION_LOGDEV_ENABLED

if FSTESTS_XFS_SECTION_RTDEV_ENABLED
config FSTESTS_XFS_SECTION_CRC_RTDEV
	bool "Enable testing section: xfs_crc_rtdev"
	help
	  This will create a host to test the baseline of fstests
	  using the realtime device. This is only useful if your
	  kernel actually is built with CONFIG_XFS_RT=y which most
	  distributions disable these days. This enables a host which
	  will use the following configuration:

	      [xfs_crc_rtdev]
	      FSTYP=xfs
	      TEST_DEV="/dev/some-dev"
	      TEST_RTDEV="/dev/some-rt-dev"
	      MKFS_OPTIONS="-f -m reflink=0,rmapbt=0, -d rtinherit=1"
	      SCRATCH_RTDEV=@FSTESTSSCRATCHRTDEV@
	      USE_EXTERNAL=yes

config FSTESTS_XFS_SECTION_CRC_RTDEV_EXTSIZE_28K
	bool "Enable testing section: xfs_crc_rtdev_extsize_28k"
	help
	  This will create a host to test the baseline of fstests
	  using the realtime device with real time extent size of
	  28k. This is only useful if your kernel actually is built
	  with CONFIG_XFS_RT=y which most distributions disable these
	  days. This enables a host which will use the following
	  configuration:

	      [xfs_crc_rtdev_extsize_28k]
	      FSTYP=xfs
	      TEST_DEV="/dev/some-dev"
	      TEST_RTDEV="/dev/some-rt-dev"
	      MKFS_OPTIONS="-f -m reflink=0,rmapbt=0, -d rtinherit=1 -r extsize=28k"
	      SCRATCH_RTDEV=@FSTESTSSCRATCHRTDEV@
	      USE_EXTERNAL=yes

config FSTESTS_XFS_SECTION_CRC_RTDEV_EXTSIZE_64K
	bool "Enable testing section: xfs_crc_rtdev_extsize_64k"
	help
	  This will create a host to test the baseline of fstests
	  using the realtime device with real time extent size of
	  64k. This is only useful if your kernel actually is built
	  with CONFIG_XFS_RT=y which most distributions disable these
	  days. This enables a host which will use the following
	  configuration:

	      [xfs_crc_rtdev_extsize_64k]
	      FSTYP=xfs
	      TEST_DEV="/dev/some-dev"
	      TEST_RTDEV="/dev/some-rt-dev"
	      MKFS_OPTIONS="-f -m reflink=0,rmapbt=0, -d rtinherit=1 -r extsize=64k"
	      SCRATCH_RTDEV=@FSTESTSSCRATCHRTDEV@
	      USE_EXTERNAL=yes

if FSTESTS_XFS_SECTION_LOGDEV_ENABLED
config FSTESTS_XFS_SECTION_CRC_LOGDEV_RTDEV
	bool "Enable testing section: xfs_crc_logdev_rtdev"
	help
	  This will create a host to test the baseline of fstests
	  using both an external journal and a realtime device as
	  well.  This is only useful if your kernel actually is built
	  with CONFIG_XFS_RT=y which most distributions disable these
	  days.

	      [xfs_crc_logdev_rtdev]
	      FSTYP=xfs
	      TEST_DEV="/dev/some-dev"
	      TEST_RTDEV="/dev/some-rt-dev"
	      MKFS_OPTIONS="-f -m reflink=0,rmapbt=0, -d rtinherit=1 -lsize=1g"
	      SCRATCH_RTDEV="/dev/some-rt-dev"
	      SCRATCH_LOGDEV=/dev/some-device
	      USE_EXTERNAL=yes
endif # FSTESTS_XFS_SECTION_LOGDEV_ENABLED
endif # FSTESTS_XFS_SECTION_RTDEV_ENABLED

config FSTESTS_XFS_SECTION_NOCRC_ENABLED
	bool "Enable testing sections which don't have CRC enabled"
	default n if HAVE_DISTRO_XFS_IGNORES_NOCRC
	default y if !HAVE_DISTRO_XFS_IGNORES_NOCRC
	help
	  Enabling this option allows you to select a hosts to test which
	  will allow you to test xfs without CRC enabled. Enable this if
	  you care to support filesystems created on older kernels. XFS had
	  CRC enabled by default as of the v3.2.3 xfsprogs release as of
	  xfsprogs commit 566ebd5ae5fa ("mkfs: default to CRC enabled
	  filesystems"), so all filesystems created with defaults prior
	  to this xfsprogs will have been created without CRC enabled.
	  You should enable this, so that you can ensure your kernel keeps
	  properly supporting filesystems created on older systems.

config FSTESTS_XFS_ENABLE_LBS
	bool "Enable testing LBS (large block devices) where block size > 4K"
	default n
	help
	  Enable this if you want to enable testing large block devices, that is,
	  where the block size is greater than 4k.

if FSTESTS_XFS_ENABLE_LBS

config FSTESTS_XFS_ENABLE_LBS_REAL
	bool "Enable testing real LBS"
	default n
	help
	  Enable this if you want to enable testing large block devices where
	  there is an assumption that the device has a physical block size
	  which matches the block size.

config FSTESTS_XFS_ENABLE_LBS_4KS
	bool "Enable testing LBS device with 4K sector size"
	depends on EXTRA_STORAGE_SUPPORTS_4K
	default n
	help
	  Enable this if you want to enable testing large block devices on
	  on drives which are only capable up to 4k physical block size.

endif

if FSTESTS_XFS_SECTION_NOCRC_ENABLED

config FSTESTS_XFS_SECTION_NOCRC
	bool "Enable testing section: xfs_nocrc"
	default y
	help
	  This will create a host to test the baseline of fstests using the
	  following configuration without CRC enabled. This is useful to test
	  older kernels which lacked CRC support.

	      [xfs_nocrc]
	      MKFS_OPTIONS='-f -m crc=0,reflink=0,rmapbt=0, -i sparse=0,'
	      FSTYP=xfs
	      [xfs]

config FSTESTS_XFS_SECTION_NOCRC_512
	bool "Enable testing section: xfs_nocrc_512"
	depends on EXTRA_STORAGE_SUPPORTS_512
	default y
	help
	  This will create a host to test the baseline of fstests using the
	  following configuration without CRC enabled using 512 bytes block size.
	  This is useful to test older kernels which lacked CRC support.

	      [xfs_nocrc_512]
	      MKFS_OPTIONS='-f -m crc=0,reflink=0,rmapbt=0, -i sparse=0, -b size=512,'
	      FSTYP=xfs

config FSTESTS_XFS_SECTION_NOCRC_1K
	bool "Enable testing section: xfs_nocrc_1k"
	depends on EXTRA_STORAGE_SUPPORTS_1K
	default y
	help
	  This will create a host to test the baseline of fstests using the
	  following configuration without CRC enabled using 1024 bytes (1 KiB)
          block size.
	  This is useful to test older kernels which lacked CRC support.

	      [xfs_nocrc_1k]
	      MKFS_OPTIONS='-f -m crc=0,reflink=0,rmapbt=0, -i sparse=0, -b size=1024,'
	      FSTYP=xfs

config FSTESTS_XFS_SECTION_NOCRC_2K
	bool "Enable testing section: xfs_nocrc_2k"
	depends on EXTRA_STORAGE_SUPPORTS_2K
	default y
	help
	  This will create a host to test the baseline of fstests using the
	  following configuration without CRC enabled using 2048 bytes (2 KiB)
          block size.
	  This is useful to test older kernels which lacked CRC support.

	      [xfs_nocrc_2k]
	      MKFS_OPTIONS='-f -m crc=0,reflink=0,rmapbt=0, -i sparse=0, -b size=2048,'
	      FSTYP=xfs

config FSTESTS_XFS_SECTION_NOCRC_4K
	bool "Enable testing section: xfs_nocrc_4k"
	depends on EXTRA_STORAGE_SUPPORTS_4K
	default y
	help
	  This will create a host to test the baseline of fstests using the
	  following configuration without CRC enabled using 4096 bytes (4 KiB)
          block size.
	  This is useful to test older kernels which lacked CRC support.

	      [xfs_nocrc_4k]
	      MKFS_OPTIONS='-f -m crc=0,reflink=0,rmapbt=0, -i sparse=0, -b size=4096,'
	      FSTYP=xfs

config FSTESTS_XFS_SECTION_NOCRC_8K
	bool "Enable testing section: xfs_nocrc_8k"
	default y
	depends on BROKEN
	depends on FSTESTS_XFS_ENABLE_LBS_REAL
	help
	  This will create a host to test the baseline of fstests using the
	  following configuration without CRC enabled using 8192 bytes (8 KiB)
          block size.
	  This is useful to test older kernels which lacked CRC support.

	      [xfs_nocrc_8k]
	      MKFS_OPTIONS='-f -m crc=0,reflink=0,rmapbt=0, -i sparse=0, -b size=8192,'
	      FSTYP=xfs

config FSTESTS_XFS_SECTION_NOCRC_8K_4KS
	bool "Enable testing section: xfs_nocrc_8k_4ks"
	default y
	depends on BROKEN
	depends on FSTESTS_XFS_ENABLE_LBS_4KS
	help
	  This will create a host to test the baseline of fstests using the
	  following configuration without CRC enabled using 8192 bytes (8 KiB)
          block size but with 4k sector size.
	  This is useful to test older kernels which lacked CRC support.

	      [xfs_nocrc_8k]
	      MKFS_OPTIONS='-f -m crc=0,reflink=0,rmapbt=0, -i sparse=0, -b size=8192, -s size=4k'
	      FSTYP=xfs

config FSTESTS_XFS_SECTION_NOCRC_16K
	bool "Enable testing section: xfs_nocrc_16k"
	default y
	depends on FSTESTS_XFS_ENABLE_LBS_REAL
	help
	  This will create a host to test the baseline of fstests using the
	  following configuration without CRC enabled using 16384 bytes (16 KiB)
          block size.
	  This is useful to test older kernels which lacked CRC support.

	      [xfs_nocrc_16k]
	      MKFS_OPTIONS='-f -m crc=0,reflink=0,rmapbt=0, -i sparse=0, -b size=16384,'
	      FSTYP=xfs

config FSTESTS_XFS_SECTION_NOCRC_16K_4KS
	bool "Enable testing section: xfs_nocrc_16k_4ks"
	default y
	depends on FSTESTS_XFS_ENABLE_LBS_4KS
	help
	  This will create a host to test the baseline of fstests using the
	  following configuration without CRC enabled using 16384 bytes (16 KiB)
          block size but with 4k sector size.
	  This is useful to test older kernels which lacked CRC support.

	      [xfs_nocrc_16k]
	      MKFS_OPTIONS='-f -m crc=0,reflink=0,rmapbt=0, -i sparse=0, -b size=16384, -s size=4k'
	      FSTYP=xfs

config FSTESTS_XFS_SECTION_NOCRC_32K
	bool "Enable testing section: xfs_nocrc_32k"
	default y
	depends on FSTESTS_XFS_ENABLE_LBS_REAL
	help
	  This will create a host to test the baseline of fstests using the
	  following configuration without CRC enabled using 32768 bytes (32 KiB)
          block size.
	  This is useful to test older kernels which lacked CRC support.

	      [xfs_nocrc_32k]
	      MKFS_OPTIONS='-f -m crc=0,reflink=0,rmapbt=0, -i sparse=0, -b size=32768,'
	      FSTYP=xfs

config FSTESTS_XFS_SECTION_NOCRC_32K_4KS
	bool "Enable testing section: xfs_nocrc_32k_4ks"
	default y
	depends on FSTESTS_XFS_ENABLE_LBS_4KS
	help
	  This will create a host to test the baseline of fstests using the
	  following configuration without CRC enabled using 32768 bytes (32 KiB)
          block size but on 4k sector size.
	  This is useful to test older kernels which lacked CRC support.

	      [xfs_nocrc_32k]
	      MKFS_OPTIONS='-f -m crc=0,reflink=0,rmapbt=0, -i sparse=0, -b size=32768, -s size=4k'
	      FSTYP=xfs

config FSTESTS_XFS_SECTION_NOCRC_64K
	bool "Enable testing section: xfs_nocrc_64k"
	default y
	depends on FSTESTS_XFS_ENABLE_LBS_REAL
	help
	  This will create a host to test the baseline of fstests using the
	  following configuration without CRC enabled using 65536 bytes (64 KiB)
          block size.
	  This is useful to test older kernels which lacked CRC support.

	      [xfs_nocrc_64k]
	      MKFS_OPTIONS='-f -m crc=0,reflink=0,rmapbt=0, -i sparse=0, -b size=65536,'
	      FSTYP=xfs

config FSTESTS_XFS_SECTION_NOCRC_64K_4KS
	bool "Enable testing section: xfs_nocrc_64k_4ks"
	default y
	depends on FSTESTS_XFS_ENABLE_LBS_4KS
	help
	  This will create a host to test the baseline of fstests using the
	  following configuration without CRC enabled using 65536 bytes (64 KiB)
          block size but on 4k sector size.
	  This is useful to test older kernels which lacked CRC support.

	      [xfs_nocrc_64k]
	      MKFS_OPTIONS='-f -m crc=0,reflink=0,rmapbt=0, -i sparse=0, -b size=65536, -s size=4k'
	      FSTYP=xfs

endif # FSTESTS_XFS_SECTION_NOCRC_ENABLED

config FSTESTS_XFS_SECTION_REFLINK_ENABLED
	bool "Enable testing sections which have reflink enabled"
	default y if HAVE_DISTRO_XFS_SUPPORTS_REFLINKS
	default n if !HAVE_DISTRO_XFS_SUPPORTS_REFLINKS
	help
	  Enabling this option allows you to select a host used to testing
	  reflink enabled filesystems. Enable this if you have support for
	  reflinks on your distribution and you support it.

	  Reflink support blessed as stable as of the v4.16 kernel release.

	  These filesystems configurations have reverse-mapping btree index
	  for each allocation group (rmapbt) enabled by default, unless the
	  section description for its entry explicitly mentions it is disabled.
	  The reverse-mapping btree index support is currently only used for
	  online filesystem checking, this however requires userspace tools
	  support, and that mechanism became feature-complete only as of the
	  v5.3 kernel release and xfsprogs v5.3 release, with a focus afterwards
	  towards stabilization and performance optimization.

if FSTESTS_XFS_SECTION_REFLINK_ENABLED

config FSTESTS_XFS_SECTION_REFLINK
	bool "Enable testing section: xfs_reflink"
	default y
	help
	  This will create a host to test the baseline of fstests using the
	  following configuration which enables reflinks.

	      [xfs_reflink]
	      MKFS_OPTIONS='-f -m reflink=1,rmapbt=1, -i sparse=1,'
	      FSTYP=xfs

if FSTESTS_XFS_SECTION_LOGDEV_ENABLED
config FSTESTS_XFS_SECTION_REFLINK_LOGDEV
	bool "Enable testing section: xfs_reflink_logdev"
	default y
	help
	  This will create a host to test the baseline of fstests using the
	  following configuration which enables the usage of writing metadata
	  to an external log device.

	      [xfs_reflink_logdev]
	      MKFS_OPTIONS="-f -m reflink=1,rmapbt=1, -i sparse=1 -lsize=1g"
	      SCRATCH_LOGDEV=/dev/some-device
	      USE_EXTERNAL=yes
	      FSTYP=xfs

endif # FSTESTS_XFS_SECTION_LOGDEV_ENABLED

config FSTESTS_XFS_SECTION_REFLINK_1024
	depends on EXTRA_STORAGE_SUPPORTS_1K
	bool "Enable testing section: xfs_reflink_1024"
	default y
	help
	  This will create a host to test the baseline of fstests using the
	  following configuration which enables reflink using 1024 byte
	  block size.

	      [xfs_reflink_1k]
	      MKFS_OPTIONS='-f -m reflink=1,rmapbt=1, -i sparse=1, -b size=1024'
	      FSTYP=xfs

config FSTESTS_XFS_SECTION_REFLINK_2K
	depends on EXTRA_STORAGE_SUPPORTS_2K
	bool "Enable testing section: xfs_reflink_2k"
	default y
	help
	  This will create a host to test the baseline of fstests using the
	  following configuration which enables reflink using 2048 bytes
	  block size.

	      [xfs_reflink_2k]
	      MKFS_OPTIONS='-f -m reflink=1,rmapbt=1, -i sparse=1, -b size=2048'
	      FSTYP=xfs

config FSTESTS_XFS_SECTION_REFLINK_4K
	bool "Enable testing section: xfs_reflink_4k"
	depends on EXTRA_STORAGE_SUPPORTS_4K
	default y
	help
	  This will create a host to test the baseline of fstests using the
	  following configuration which enables reflink using 4096 bytes
	  block size.

	      [xfs_reflink_4k]
	      MKFS_OPTIONS='-f -m reflink=1,rmapbt=1, -i sparse=1, -b size=4096'
	      FSTYP=xfs

config FSTESTS_XFS_SECTION_REFLINK_8K
	bool "Enable testing section: xfs_reflink_8k"
	depends on BROKEN
	depends on FSTESTS_XFS_ENABLE_LBS_REAL
	default y
	help
	  This will create a host to test the baseline of fstests using the
	  following configuration which enables reflink using 8192 bytes
	  block size.

	      [xfs_reflink_8k]
	      MKFS_OPTIONS='-f -m reflink=1,rmapbt=1, -i sparse=1, -b size=8192'
	      FSTYP=xfs

config FSTESTS_XFS_SECTION_REFLINK_8K_4KS
	bool "Enable testing section: xfs_reflink_8k_4ks"
	default y
	depends on FSTESTS_XFS_ENABLE_LBS_8KS
	help
	  This will create a host to test the baseline of fstests using the
	  following configuration which enables reflink using 8192 bytes
	  block size but on 4k sector size.

	      [xfs_reflink_8k]
	      MKFS_OPTIONS='-f -m reflink=1,rmapbt=1, -i sparse=1, -b size=8192 -s size=4k'
	      FSTYP=xfs

config FSTESTS_XFS_SECTION_REFLINK_16K
	bool "Enable testing section: xfs_reflink_16k"
	default y
	depends on FSTESTS_XFS_ENABLE_LBS_REAL
	help
	  This will create a host to test the baseline of fstests using the
	  following configuration which enables reflink using 16384 bytes
	  block size.

	      [xfs_reflink_16k]
	      MKFS_OPTIONS='-f -m reflink=1,rmapbt=1, -i sparse=1, -b size=16384'
	      FSTYP=xfs

config FSTESTS_XFS_SECTION_REFLINK_16K_4KS
	bool "Enable testing section: xfs_reflink_16k_4ks"
	default y
	depends on FSTESTS_XFS_ENABLE_LBS_4KS
	help
	  This will create a host to test the baseline of fstests using the
	  following configuration which enables reflink using 16384 bytes
	  block size but on 4k sector size.

	      [xfs_reflink_16k]
	      MKFS_OPTIONS='-f -m reflink=1,rmapbt=1, -i sparse=1, -b size=16384, -s size=4k'
	      FSTYP=xfs

config FSTESTS_XFS_SECTION_REFLINK_32K
	bool "Enable testing section: xfs_reflink_32k"
	default y
	depends on FSTESTS_XFS_ENABLE_LBS_REAL
	help
	  This will create a host to test the baseline of fstests using the
	  following configuration which enables reflink using 32768 bytes
	  block size.

	      [xfs_reflink_32k]
	      MKFS_OPTIONS='-f -m reflink=1,rmapbt=1, -i sparse=1, -b size=32768'
	      FSTYP=xfs

config FSTESTS_XFS_SECTION_REFLINK_32K_4KS
	bool "Enable testing section: xfs_reflink_32k_4ks"
	default y
	depends on FSTESTS_XFS_ENABLE_LBS_4KS
	help
	  This will create a host to test the baseline of fstests using the
	  following configuration which enables reflink using 32768 bytes
	  block size but on 4k sector size.

	      [xfs_reflink_32k]
	      MKFS_OPTIONS='-f -m reflink=1,rmapbt=1, -i sparse=1, -b size=32768, -s size=4k'
	      FSTYP=xfs

config FSTESTS_XFS_SECTION_REFLINK_64K
	bool "Enable testing section: xfs_reflink_64k"
	default y
	depends on FSTESTS_XFS_ENABLE_LBS_REAL
	help
	  This will create a host to test the baseline of fstests using the
	  following configuration which enables reflink using 16384 bytes
	  block size.

	      [xfs_reflink_64k]
	      MKFS_OPTIONS='-f -m reflink=1,rmapbt=1, -i sparse=1, -b size=65536'
	      FSTYP=xfs

config FSTESTS_XFS_SECTION_REFLINK_64K_4KS
	bool "Enable testing section: xfs_reflink_64k_4ks"
	default y
	depends on FSTESTS_XFS_ENABLE_LBS_4KS
	help
	  This will create a host to test the baseline of fstests using the
	  following configuration which enables reflink using 16384 bytes
	  block size but on 4k sector size.

	      [xfs_reflink_64k]
	      MKFS_OPTIONS='-f -m reflink=1,rmapbt=1, -i sparse=1, -b size=65536 -s size=4k'
	      FSTYP=xfs

config FSTESTS_XFS_SECTION_REFLINK_DIR_BSIZE_8K
	bool "Enable testing section: xfs_reflink_dir_bsize_8k"
	default y
	help
	  This will create a host to test the baseline of fstests using the
	  following configuration which enables reflink using 8k bytes
	  directory block size.

	      [xfs_reflink_dir_bsize_8k]
	      MKFS_OPTIONS='-f -m reflink=1,rmapbt=1, -i sparse=1, -n size=8k'
	      FSTYP=xfs

config FSTESTS_XFS_SECTION_REFLINK_NORMAPBT
	bool "Enable testing section: xfs_reflink_normapbt"
	default y
	help
	  This will create a host to test the baseline of fstests using the
	  following configuration which enables reflink but disables the
	  reverse-mapping btree index in each allocation group. One of the
	  uses (and currently only) for this reverse-mapping btree index is
	  to support online filesystem repairing. You may want to test this
	  configuration if your distribution recommends to disable online
	  filesystem checking or you don't want to support it but want to
	  support reflink support.

	  Reverse-mapping btree support for online filesystem checking became
	  feature-complete as of the v5.3 kernel release and xfsprogs v5.3
	  release, with a focus afterwards towards stabilization and performance
	  optimization.

	  If you have users which care about reflink support but do not want
	  online filesystem repair support, you can enable this to test this
	  filesystem configuration:

	      [xfs_normapbt]
	      MKFS_OPTIONS='-f -m reflink=1,rmapbt=0, -i sparse=1,'
	      FSTYP=xfs

config FSTESTS_XFS_SECTION_REFLINK_STRIPE_LEN
	bool "Enable testing section: xfs_reflink_stripe_len"
	default y
	help
	  This will create a host to test the baseline of fstests
	  using the following configuration which enables reflink
	  along with using stripe unit of 128k and stripe width of 4.

	      [xfs_reflink_stripe_len]
	      MKFS_OPTIONS='-f -m reflink=1,rmapbt=1, -i sparse=1, -d su=128k,sw=4'
	      FSTYP=xfs

endif # FSTESTS_XFS_SECTION_REFLINK_ENABLED

config FSTESTS_XFS_SECTION_BIGBLOCK
	bool "Enable testing section: xfs_bigblock"
	default y if HAVE_DISTRO_XFS_SUPPORTS_BIGBLOCKS
	default n if !HAVE_DISTRO_XFS_SUPPORTS_BIGBLOCKS
	depends on HAVE_ARCH_64K_PAGES
	help
	  This will test an XFS filesystem with a 64k block size. This can only
	  be used on architectures with a respective 64k page size support
	  any of the followings have been enabled on the target kernel tested:

	  For ppc64le:
	  CONFIG_PPC_64K_PAGES=y

	  For aarch64:
	  CONFIG_ARM64_64K_PAGES=y

	      [xfs_bigblock]
	      MKFS_OPTIONS='-f -b size=65536'
	      FSTYP=xfs

endif # FSTESTS_XFS_MANUAL_COVERAGE

if !FSTESTS_XFS_MANUAL_COVERAGE

config FSTESTS_XFS_ENABLE_LBS
	bool
	default n

config FSTESTS_XFS_SECTION_CRC
	bool
	default y

config FSTESTS_XFS_SECTION_NOCRC
	bool
	default y

config FSTESTS_XFS_SECTION_NOCRC_512
	bool
	default y

config FSTESTS_XFS_SECTION_REFLINK
	bool
	default y

config FSTESTS_XFS_SECTION_REFLINK_1024
	bool
	default y

config FSTESTS_XFS_SECTION_REFLINK_NORMAPBT
	bool
	default y

config FSTESTS_XFS_SECTION_LOGDEV_ENABLED
	bool
	default y

config FSTESTS_XFS_SECTION_RTDEV
	bool
	default n

config FSTESTS_XFS_SECTION_RTLOGDEV
	bool
	default n

config FSTESTS_XFS_SECTION_BIGBLOCK
	bool
	default y if HAVE_DISTRO_XFS_SUPPORTS_BIGBLOCKS
	default n if !HAVE_DISTRO_XFS_SUPPORTS_BIGBLOCKS
	depends on HAVE_ARCH_64K_PAGES

endif # !FSTESTS_XFS_MANUAL_COVERAGE
```
