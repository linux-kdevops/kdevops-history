## workflows/fstests/nfs/Kconfig
```kconfig
config FSTESTS_USE_KDEVOPS_NFSD
	bool "Test against the kdevops NFS server"
	select KDEVOPS_SETUP_NFSD
	default y
	help
	  Do you want to test against Linux knfsd as deployed by kdevops?
	  If so, select this option. If you want to test against another
	  (already-deployed and reachable) server, disable this and specify
	  the location.

config FSTESTS_NFS_SERVER_HOST
	string "Test Server hostname"
	default ""
	depends on !FSTESTS_USE_KDEVOPS_NFSD
	help
	  The NFS server hostname or address to test against. Note that
	  the clients will expect that an appropriate hierarchy is already
	  created for them to mount and use.
	  FIXME: document how to make that.

# Distributions actively maintaining btrfs support should select this and then
# be careful to select any of the other HAVE_DISTRO_NFS_* below so that
# testers can know what to test for.
config HAVE_DISTRO_NFS_PREFERS_MANUAL
	bool
	default n

config FSTESTS_NFS_MANUAL_COVERAGE
	bool "Enable manual coverage selection"
	default y if HAVE_DISTRO_NFS_PREFERS_MANUAL
	default n if !HAVE_DISTRO_NFS_PREFERS_MANUAL
	help
	  By default we aim to spawn enough hosts to cover testing the full
	  range of supported features upstream on the Linux kernel for nfs,
	  and for you to also be able to do development on each section
	  concurrently. Distributions however may override sensible defaults
	  and only support certain features. Enabling this option lets you
	  select and test only specific configurations.

	  By default we enables all tests, but certain distributions may
	  disable certain features and as such don't need to run certain
	  type of tests.

	  You can enable this to allow you to override the default test
	  coverage.

if FSTESTS_NFS_MANUAL_COVERAGE

config FSTESTS_NFS_SECTION_TLS
	bool "Enable testing section: nfs_tls"
	default n
	depends on KDEVOPS_SETUP_KTLS
	help
	  Enabling this will test with the xprtsec=tls mount option.

config FSTESTS_NFS_SECTION_V42
	bool "Enable testing section: nfs_v42"
	default y
	help
	  Enabling this will test NFSv4.2.

config FSTESTS_NFS_SECTION_V41
	bool "Enable testing section: nfs_v41"
	default n
	help
	  Enabling this will test NFSv4.1.

config FSTESTS_NFS_SECTION_V40
	bool "Enable testing section: nfs_v40"
	default n
	help
	  Enabling this will test NFSv4.0.

config FSTESTS_NFS_SECTION_V3
	bool "Enable testing section: nfs_v3"
	default n
	help
	  Enabling this will test NFSv3.

endif # FSTESTS_NFS_MANUAL_COVERAGE

if !FSTESTS_NFS_MANUAL_COVERAGE

config FSTESTS_NFS_SECTION_DEFAULT
	bool
	default y

config FSTESTS_NFS_SECTION_V3
	bool
	default n

endif # !FSTESTS_NFS_MANUAL_COVERAGE

choice
	prompt "Authentication flavor to use"
	default	FSTESTS_NFS_AUTH_KRB5
	depends on KDEVOPS_SETUP_KRB5
	help
	  This is the authentication flavor you want to test.  The selected
          option will get written to /etc/nfsmount.conf on the NFS clients.

config FSTESTS_NFS_AUTH_SYS
	bool "sys"

config FSTESTS_NFS_AUTH_KRB5
	bool "krb5"

config FSTESTS_NFS_AUTH_KRB5I
	bool "krb5i"

config FSTESTS_NFS_AUTH_KRB5P
	bool "krb5p"

endchoice

config FSTESTS_NFS_AUTH_FLAVOR
	string
	default "sys" if FSTESTS_NFS_AUTH_SYS
	default "krb5" if FSTESTS_NFS_AUTH_KRB5
	default "krb5i" if FSTESTS_NFS_AUTH_KRB5I
	default "krb5p" if FSTESTS_NFS_AUTH_KRB5P
```

## workflows/fstests/tmpfs/Kconfig
```kconfig
config FSTESTS_TMPFS_MANUAL_COVERAGE
	bool "Enable manual coverage selection"
	default y
	help
	  By default we aim to spawn enough hosts to cover testing the full
	  range of supported features upstream on the Linux kernel for tmpfs,
	  and for you to also be able to do development on each section
	  concurrently. Distributions however may override sensible defaults
	  and only support certain features. Enabling this option lets you
	  select and test only specific configurations.

	  By default we enables all tests, but certain distributions may
	  disable certain features and as such don't need to run certain
	  type of tests.

	  You can enable this to allow you to override the default test
	  coverage.

if FSTESTS_TMPFS_MANUAL_COVERAGE

config FSTESTS_TMPFS_SECTION_DEFAULT
	bool "Enable testing section default"
	default y
	help
	  Enabling this will test tmpfs with the default mount options.

config FSTESTS_TMPFS_ENABLE_NOSWAP
	bool "Enable testing section noswap"
	default n
	help
	  Enabling this will disable swap. By default swap is enabled.

if FSTESTS_TMPFS_ENABLE_NOSWAP

config FSTESTS_TMPFS_SECTION_NOSWAP_HUGE_NEVER
	bool "Enable testing section: tmpfs_noswap_huge_never"
	default n
	help
	  With swap disabled, never allocate huge pages.

config FSTESTS_TMPFS_SECTION_NOSWAP_HUGE_ALWAYS
	bool "Enable testing section: tmpfs_noswap_huge_always"
	default n
	help
	  With swap disabled, attempt to allocate huge page every time a new
	  page is needed.

config FSTESTS_TMPFS_SECTION_NOSWAP_HUGE_WITHIN_SIZE
	bool "Enable testing section: tmpfs_noswap_huge_within_size"
	default n
	help
	  With swap disabled, only allocate huge page if it will be fully
	  within i_size. Also respect madvise(2) hints.

config FSTESTS_TMPFS_SECTION_NOSWAP_HUGE_ADVISE
	bool "Enable testing section: tmpfs_noswap_huge_advise"
	default n
	help
	  With swap disabled, only allocate huge page if requested with madvise(2).

endif # FSTESTS_TMPFS_ENABLE_NOSWAP

config FSTESTS_TMPFS_ENABLE_HUGE
	bool "Enable testing section huge pages"
	default n
	help
	  Enabling this will enable you to test huge pages.

if FSTESTS_TMPFS_ENABLE_HUGE

config FSTESTS_TMPFS_SECTION_HUGE_ALWAYS
	bool "Enable testing section: tmpfs_huge_always"
	default n
	help
	  Attempt to allocate huge page every time a new page is needed.

config FSTESTS_TMPFS_SECTION_HUGE_WITHIN_SIZE
	bool "Enable testing section: tmpfs_huge_within_size"
	default n
	help
	  Only allocate huge page if it will be fully within i_size. Also respect
	  madvise(2) hints.

config FSTESTS_TMPFS_SECTION_HUGE_ADVISE
	bool "Enable testing section: tmpfs_huge_advise"
	default n
	help
	  Only allocate huge page if requested with madvise(2).

endif # FSTESTS_TMPFS_ENABLE_HUGE

endif # FSTESTS_TMPFS_MANUAL_COVERAGE

if !FSTESTS_TMPFS_MANUAL_COVERAGE

config FSTESTS_TMPFS_SECTION_DEFAULT
	bool
	default y

config FSTESTS_TMPFS_SECTION_NOSWAP
	bool

config FSTESTS_TMPFS_SECTION_NOSWAP_HUGE_NEVER
	bool

config FSTESTS_TMPFS_SECTION_NOSWAP_HUGE_ALWAYS
	bool

config FSTESTS_TMPFS_SECTION_NOSWAP_HUGE_WITHIN_SIZE
	bool

config FSTESTS_TMPFS_SECTION_NOSWAP_HUGE_ADVISE
	bool

config FSTESTS_TMPFS_SECTION_HUGE_ALWAYS
	bool

config FSTESTS_TMPFS_SECTION_HUGE_WITHIN_SIZE
	bool

config FSTESTS_TMPFS_SECTION_HUGE_ADVISE
	bool

endif # !FSTESTS_TMPFS_MANUAL_COVERAGE
```
